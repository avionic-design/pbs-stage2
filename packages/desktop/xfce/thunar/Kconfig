## packages/desktop/xfce/thunar/Kconfig
```kconfig
config PACKAGE_DESKTOP_XFCE_THUNAR
	bool "thunar"
	select PACKAGE_DESKTOP_XFCE_XFCE4_PANEL
	default n
```

## packages/desktop/xfce/xfce-utils/Kconfig
```kconfig
config PACKAGE_DESKTOP_XFCE_XFCE_UTILS
	bool "xfce-utils"
	select PACKAGE_DESKTOP_XFCE_LIBXFCE4UTIL
```

## packages/desktop/xfce/xfce4-panel/Kconfig
```kconfig
config PACKAGE_DESKTOP_XFCE_XFCE4_PANEL
	bool "xfce4-panel"
	select PACKAGE_LIBS_LIBWNCK
	select PACKAGE_DESKTOP_XFCE_EXO
	select PACKAGE_DESKTOP_XFCE_GARCON
	select PACKAGE_DESKTOP_XFCE_LIBXFCE4UI
```

## packages/desktop/xfce/xfce4-session/Kconfig
```kconfig
config PACKAGE_DESKTOP_XFCE_XFCE4_SESSION
	bool "xfce4-session"
	select PACKAGE_DESKTOP_XFCE_LIBXFCE4UI
	select PACKAGE_XORG_APP_ICEAUTH
	select PACKAGE_XORG_LIB_SM
```

## packages/desktop/xfce/xfce4-settings/Kconfig
```kconfig
config PACKAGE_DESKTOP_XFCE_XFCE4_SETTINGS
	bool "xfce4-settings"
	select PACKAGE_DESKTOP_XFCE_XFCONF
```

## packages/desktop/xfce/xfconf/Kconfig
```kconfig
config PACKAGE_DESKTOP_XFCE_XFCONF
	bool "xfconf"
	select PACKAGE_LIBS_DBUS_GLIB
	select PACKAGE_DESKTOP_XFCE_XFCE4UTIL
	default n
```

## packages/desktop/xfce/xfdesktop/Kconfig
```kconfig
config PACKAGE_DESKTOP_XFCE_XFDESKTOP
	bool "xfdesktop"
	select PACKAGE_LIBS_LIBWNCK
	select PACKAGE_DESKTOP_XFCE_LIBXFCE4UI
	select PACKAGE_DESKTOP_XFCE_THUNAR
	select PACKAGE_DESKTOP_XFCE_XFCE4_PANEL
```

## packages/desktop/xfce/xfwm4/Kconfig
```kconfig
config PACKAGE_DESKTOP_XFCE_XFWM4
	bool "xfwm4"
	select PACKAGE_LIBS_LIBWNCK
	select PACKAGE_DESKTOP_XFCE_LIBXFCE4UI
	default n
```

## packages/devel/Kconfig
```kconfig
menu "Development Tools"

config VIRTUAL_DEVEL_LIBC
	bool "C runtime library"
	default n
	select VIRTUAL_KERNEL_LINUX_LIBC
	select PACKAGE_DEVEL_GLIBC if GLIBC
	select PACKAGE_DEVEL_UCLIBC if UCLIBC

source "packages/devel/flex/Kconfig"
source "packages/devel/gdb/Kconfig"
source "packages/devel/glibc/Kconfig"
source "packages/devel/lua/Kconfig"
source "packages/devel/python/Kconfig"
source "packages/devel/strace/Kconfig"
source "packages/devel/uclibc/Kconfig"

endmenu
```

## packages/devel/file/Kconfig
```kconfig
config PACKAGE_DEVEL_FILE
	bool "file"
	select PACKAGE_BUILD_TOOLS_FILE
	select PACKAGE_LIBS_ZLIB
	help
	  The file command is used to identify a particular file according to the
	  type of data contained by the file.  File can identify many different
	  file types, including ELF binaries, system libraries, RPM packages, and
	  different graphics formats.
```

## packages/devel/flex/Kconfig
```kconfig
config PACKAGE_DEVEL_FLEX
	bool "flex"
	select VIRTUAL_DEVEL_LIBC
	select PACKAGE_BUILD_TOOLS_AUTOCONF
	select PACKAGE_BUILD_TOOLS_AUTOMAKE
```

## packages/devel/gdb/Kconfig
```kconfig
config PACKAGE_DEVEL_GDB
	bool "gdb: GNU debugger"
	select PACKAGE_BUILD_TOOLS_TEXINFO
	select PACKAGE_LIBS_NCURSES
```

## packages/devel/glibc/Kconfig
```kconfig
if GLIBC

config PACKAGE_DEVEL_GLIBC
	bool
	select VIRTUAL_KERNEL_LINUX_LIBC
	select PACKAGE_DEVEL_GCC_LIBS
	select STABLE_ABI

config LIBC
	string
	default "gnu"

endif
```

## packages/devel/klibc/Kconfig
```kconfig
if KLIBC

config PACKAGE_DEVEL_KLIBC
	bool
	default n

config LIBC
	string
	default "klibc"

endif
```

## packages/devel/lua/Kconfig
```kconfig
source "packages/devel/lua/cgilua/Kconfig"
source "packages/devel/lua/lua/Kconfig"
source "packages/devel/lua/luafilesystem/Kconfig"
source "packages/devel/lua/rings/Kconfig"
source "packages/devel/lua/wsapi/Kconfig"
```

## packages/devel/lua/cgilua/Kconfig
```kconfig
config PACKAGE_DEVEL_LUA_CGILUA
	bool "CGILua"
	select PACKAGE_DEVEL_LUA
	help
	  CGILua is a tool for creating dynamic Web pages and manipulating input
	  data from Web forms. CGILua allows the separation of logic and data
	  handling from the generation of pages, making it easy to develop web
	  applications with Lua.
```

## packages/devel/lua/lua/Kconfig
```kconfig
config PACKAGE_DEVEL_LUA
	bool "lua"
	select PACKAGE_LIBS_READLINE
	help
	  Lua is a powerful, light-weight programming language designed for
	  extending applications. Lua is also frequently used as a
	  general-purpose, stand-alone language. Lua is free software.
```

## packages/devel/lua/luafilesystem/Kconfig
```kconfig
config PACKAGE_DEVEL_LUA_LUAFILESYSTEM
	bool "luafilesystem"
	select PACKAGE_DEVEL_LUA
	help
	  LuaFileSystem is a Lua library developed to complement the set of
	  functions related to file systems offered by the standard Lua
	  distribution.
```

## packages/devel/lua/luasql/Kconfig
```kconfig
config PACKAGE_DEVEL_LUA_LUASQL
	bool "LuaSQL"
	select PACKAGE_DEVEL_LUA
	select PACKAGE_LIBS_SQLITE
	help
	  LuaSQL is a simple interface from Lua to a DBMS.
```

## packages/devel/lua/wsapi/Kconfig
```kconfig
config PACKAGE_DEVEL_LUA_WSAPI
	bool "WSAPI"
	select PACKAGE_DEVEL_LUA_LUAFILESYSTEM
	select PACKAGE_DEVEL_LUA_RINGS
	help
	  WSAPI is an API that abstracts the web server from Lua web
	  applications. By coding against WSAPI your application can run on any
	  of the supported servers and interfaces (currently CGI, FastCGI and
	  Xavante, on Windows and UNIX-based systems).
```

## packages/devel/python/Kconfig
```kconfig
config PACKAGE_DEVEL_PYTHON
	bool "python"
	select PACKAGE_BUILD_TOOLS_PYTHON
	select PACKAGE_LIBS_BZIP2
	select PACKAGE_LIBS_LIBFFI
	select PACKAGE_LIBS_OPENSSL
	select PACKAGE_LIBS_READLINE
	select PACKAGE_LIBS_ZLIB
	default n
```

## packages/devel/strace/Kconfig
```kconfig
config PACKAGE_DEVEL_STRACE
	bool "strace"
	select VIRTUAL_DEVEL_LIBC
	default n
```
