## packages/desktop/Kconfig
```kconfig
menu "Desktop Environments"

source "packages/desktop/evdev-calibrate/Kconfig"
source "packages/desktop/gnome/Kconfig"
source "packages/desktop/gtk-engines/Kconfig"
source "packages/desktop/icons/Kconfig"
source "packages/desktop/nodm/Kconfig"
source "packages/desktop/plymouth/Kconfig"
source "packages/desktop/shared-mime-info/Kconfig"
source "packages/desktop/xfce/Kconfig"

endmenu
```

## packages/desktop/evdev-calibrate/Kconfig
```kconfig
config PACKAGE_DESKTOP_EVDEV_CALIBRATE
	bool "evdev-calibrate"
	select PACKAGE_LIBS_CAIRO
	select PACKAGE_XORG_LIB_XI
```

## packages/desktop/gnome/Kconfig
```kconfig
menu "GNOME"

source "packages/desktop/gnome/gnome-menus/Kconfig"
source "packages/desktop/gnome/gnome-shell/Kconfig"
source "packages/desktop/gnome/mutter/Kconfig"

endmenu
```

## packages/desktop/gnome/gnome-menus/Kconfig
```kconfig
config PACKAGE_DESKTOP_GNOME_GNOME_MENUS
	bool "gnome-menus"
	select PACKAGE_LIBS_GLIB
```

## packages/desktop/gnome/gnome-shell/Kconfig
```kconfig
config PACKAGE_DESKTOP_GNOME_GNOME_SHELL
	bool "gnome-shell"
	select PACKAGE_LIBS_GJS
	select PACKAGE_DESKTOP_GNOME_GNOME_MENUS
	select PACKAGE_DESKTOP_GNOME_MUTTER
	default n
```

## packages/desktop/gnome/mutter/Kconfig
```kconfig
config PACKAGE_DESKTOP_GNOME_MUTTER
	bool "mutter"
	select PACKAGE_LIBS_CLUTTER
	select VIRTUAL_LIBS_GTK
```

## packages/desktop/gtk3-theme-evolve/Kconfig
```kconfig
config PACKAGE_DESKTOP_GTK3_THEME_EVOLVE
	bool "gtk3-theme-evolve"
	select PACKAGE_LIBS_GTK3
```

## packages/desktop/icons/Kconfig
```kconfig
menu "Icons"

source "packages/desktop/icons/hicolor/Kconfig"
source "packages/desktop/icons/tango/Kconfig"

endmenu
```

## packages/desktop/icons/hicolor/Kconfig
```kconfig
config PACKAGE_DESKTOP_ICONS_HICOLOR
	bool "hicolor"
	select PACKAGE_BUILD_TOOLS_AUTOCONF
	select PACKAGE_BUILD_TOOLS_AUTOMAKE
```

## packages/desktop/icons/tango/Kconfig
```kconfig
config PACKAGE_DESKTOP_ICONS_TANGO
	bool "tango"
	select PACKAGE_BUILD_TOOLS_ICON_NAMING_UTILS
	default n
```

## packages/desktop/plymouth/Kconfig
```kconfig
config PACKAGE_DESKTOP_PLYMOUTH
	bool "plymouth"
	select PACKAGE_LIBS_LIBDRM
	select PACKAGE_LIBS_LIBPNG
```

## packages/desktop/shared-mime-info/Kconfig
```kconfig
config PACKAGE_DESKTOP_SHARED_MIME_INFO
	bool "shared-mime-info"
	select PACKAGE_BUILD_TOOLS_AUTOCONF
	select PACKAGE_BUILD_TOOLS_AUTOMAKE
	select PACKAGE_BUILD_TOOLS_SHARED_MIME_INFO
	select VIRTUAL_DEVEL_LIBC
	default n
```

## packages/desktop/wayland/Kconfig
```kconfig
menu "Wayland"

source "packages/desktop/wayland/wayland/Kconfig"
source "packages/desktop/wayland/wayland-protocols/Kconfig"
source "packages/desktop/wayland/weston/Kconfig"

endmenu
```

## packages/desktop/wayland/wayland-protocols/Kconfig
```kconfig
config PACKAGE_DESKTOP_WAYLAND_WAYLAND_PROTOCOLS
	bool "wayland-protocols"
	help
	  wayland-protocols contains Wayland protocols that add functionality
	  not available in the Wayland core protocol. Such protocols either add
	  completely new functionality, or extend the functionality of some
	  other protocol either in Wayland core, or some other protocol in
	  wayland-protocols.
```

## packages/desktop/wayland/wayland/Kconfig
```kconfig
config PACKAGE_DESKTOP_WAYLAND_WAYLAND
	select PACKAGE_BUILD_TOOLS_DOXYGEN
	select PACKAGE_BUILD_TOOLS_LIBXSLT
	select PACKAGE_BUILD_TOOLS_WAYLAND
	select PACKAGE_BUILD_TOOLS_XMLTO
	bool "wayland"
```

## packages/desktop/wayland/weston/Kconfig
```kconfig
config PACKAGE_DESKTOP_WAYLAND_WESTON
	bool "weston"
	select PACKAGE_BUILD_TOOLS_DOXYGEN
	select PACKAGE_BUILD_TOOLS_WAYLAND
	select PACKAGE_LIBS_MESA
	select PACKAGE_LIBS_MESA_GBM
	select PACKAGE_LIBS_MESA_WAYLAND
	select PACKAGE_LIBS_LIBINPUT
	select PACKAGE_LIBS_LIBXKBCOMMON
	select PACKAGE_DESKTOP_WAYLAND_WAYLAND_PROTOCOLS
```

## packages/desktop/xfce/Kconfig
```kconfig
menu "XFCE"

source "packages/desktop/xfce/exo/Kconfig"
source "packages/desktop/xfce/garcon/Kconfig"
source "packages/desktop/xfce/libxfce4ui/Kconfig"
source "packages/desktop/xfce/libxfce4util/Kconfig"
source "packages/desktop/xfce/thunar/Kconfig"
source "packages/desktop/xfce/xfce4-panel/Kconfig"
source "packages/desktop/xfce/xfce4-session/Kconfig"
source "packages/desktop/xfce/xfce4-settings/Kconfig"
source "packages/desktop/xfce/xfce-utils/Kconfig"
source "packages/desktop/xfce/xfconf/Kconfig"
source "packages/desktop/xfce/xfdesktop/Kconfig"
source "packages/desktop/xfce/xfwm4/Kconfig"

endmenu
```

## packages/desktop/xfce/garcon/Kconfig
```kconfig
config PACKAGE_DESKTOP_XFCE_GARCON
	bool "garcon"
	select PACKAGE_DESKTOP_XFCE_LIBXFCE4UTIL
```

## packages/desktop/xfce/libxfce4menu/Kconfig
```kconfig
config PACKAGE_DESKTOP_XFCE_LIBXFCE4MENU
	bool "libxfce4menu"
	select PACKAGE_DESKTOP_XFCE_LIBXFCE4UTIL
	default n
```

## packages/desktop/xfce/libxfce4ui/Kconfig
```kconfig
config PACKAGE_DESKTOP_XFCE_LIBXFCE4UI
	bool "libxfce4ui"
	select PACKAGE_DESKTOP_XFCE_LIBXFCE4UTIL
	select PACKAGE_DESKTOP_XFCE_XFCONF
	select PACKAGE_LIBS_LIBGLADE
```

## packages/desktop/xfce/libxfce4util/Kconfig
```kconfig
config PACKAGE_DESKTOP_XFCE_LIBXFCE4UTIL
	bool "libxfce4util"
	select PACKAGE_LIBS_GLIB
```

## packages/desktop/xfce/libxfcegui4/Kconfig
```kconfig
config PACKAGE_DESKTOP_XFCE_LIBXFCEGUI4
	bool "libxfcegui4"
	select PACKAGE_LIBS_LIBGLADE
	select PACKAGE_DESKTOP_XFCE_LIBXFCE4UTIL
	select PACKAGE_DESKTOP_XFCE_XFCONF
	default n
```
