## packages/xorg/app/xinput/Kconfig
```kconfig
config PACKAGE_XORG_APP_XINPUT
	bool "xinput"
	select PACKAGE_XORG_LIB_XI
	select PACKAGE_XORG_LIB_XINERAMA
```

## packages/xorg/app/xkbcomp/Kconfig
```kconfig
config PACKAGE_XORG_APP_XKBCOMP
	bool "xkbcomp"
	select PACKAGE_XORG_LIB_XKBFILE
	default n
```

## packages/xorg/app/xprop/Kconfig
```kconfig
config PACKAGE_XORG_APP_XPROP
	bool "xprop"
	select PACKAGE_XORG_LIB_X11
	default n
```

## packages/xorg/app/xrandr/Kconfig
```kconfig
config PACKAGE_XORG_APP_XRANDR
	bool "xrandr"
	select PACKAGE_BUILD_TOOLS_AUTOCONF
	select PACKAGE_BUILD_TOOLS_AUTOMAKE
	select PACKAGE_XORG_LIB_XRANDR
	select PACKAGE_XORG_LIB_XCURSOR
	help
	  Query and changed resolution and output during runtand output.
	  NOTE: you'll need to have the xorg-macros installed in order to build.
```

## packages/xorg/app/xscope/Kconfig
```kconfig
config PACKAGE_XORG_APP_XSCOPE
	bool "xscope"
	select PACKAGE_XORG_LIB_XTRANS
	select PACKAGE_XORG_PROTO_X
```

## packages/xorg/app/xsetpointer/Kconfig
```kconfig
config PACKAGE_XORG_APP_XSETPOINTER
	bool "xsetpointer"
	select PACKAGE_XORG_LIB_XI
```

## packages/xorg/app/xsetroot/Kconfig
```kconfig
config PACKAGE_XORG_APP_XSETROOT
	bool "xsetroot"
	select PACKAGE_XORG_DATA_XBITMAPS
```

## packages/xorg/apps/Kconfig
```kconfig
menu "X.Org - Applications"

config PACKAGE_XORG_APPS_XTERM
	bool "xterm"
	select PACKAGE_LIBS_NCURSES
	select PACKAGE_XORG_LIB_XAW
	default n

endmenu
```

## packages/xorg/data/Kconfig
```kconfig
menu "X.Org - Data"

source "packages/xorg/data/xbitmaps/Kconfig"
source "packages/xorg/data/xkeyboard-config/Kconfig"

endmenu
```

## packages/xorg/data/xkeyboard-config/Kconfig
```kconfig
config PACKAGE_XORG_DATA_XKEYBOARD_CONFIG
	bool "xkeyboard-config"
	select VIRTUAL_DEVEL_LIBC
	select PACKAGE_BUILD_TOOLS_XORG_APP_XKBCOMP
```

## packages/xorg/driver/Kconfig
```kconfig
menu "X.Org - Drivers"

comment "Input Drivers"

source "packages/xorg/driver/xf86-input-evdev/Kconfig"
source "packages/xorg/driver/xf86-input-evtouch/Kconfig"
source "packages/xorg/driver/xf86-input-keyboard/Kconfig"
source "packages/xorg/driver/xf86-input-mouse/Kconfig"

comment "Video Drivers"

source "packages/xorg/driver/xf86-video-fbdev/Kconfig"
source "packages/xorg/driver/xf86-video-iegd/Kconfig"
source "packages/xorg/driver/xf86-video-intel/Kconfig"
source "packages/xorg/driver/xf86-video-psb/Kconfig"
source "packages/xorg/driver/xf86-video-vesa/Kconfig"

endmenu
```

## packages/xorg/driver/xf86-input-evdev/Kconfig
```kconfig
config PACKAGE_XORG_DRIVER_INPUT_EVDEV
	bool "evdev"
	select PACKAGE_LIBS_MTDEV
	select PACKAGE_XORG_XORG_SERVER
	select PACKAGE_LIBS_LIBEVDEV
```

## packages/xorg/driver/xf86-input-evtouch/Kconfig
```kconfig
config PACKAGE_XORG_DRIVER_INPUT_EVTOUCH
	bool "evtouch"
	select PACKAGE_XORG_XORG_SERVER
	default n
```

## packages/xorg/driver/xf86-input-keyboard/Kconfig
```kconfig
config PACKAGE_XORG_DRIVER_INPUT_KEYBOARD
	bool "keyboard"
	select PACKAGE_XORG_XORG_SERVER
	default n
```

## packages/xorg/driver/xf86-input-mouse/Kconfig
```kconfig
config PACKAGE_XORG_DRIVER_INPUT_MOUSE
	bool "mouse"
	select PACKAGE_XORG_XORG_SERVER
```

## packages/xorg/driver/xf86-video-fbdev/Kconfig
```kconfig
config PACKAGE_XORG_DRIVER_VIDEO_FBDEV
	bool "fbdev"
	select PACKAGE_XORG_XORG_SERVER
	select PACKAGE_XORG_XORG_SERVER_DGA
```

## packages/xorg/driver/xf86-video-iegd/Kconfig
```kconfig
config PACKAGE_XORG_DRIVER_VIDEO_IEGD
	bool "iegd - Intel Embedded Graphics Driver"
	select PACKAGE_XORG_XORG_SERVER
	select XORG_IEGD
```

## packages/xorg/driver/xf86-video-intel/Kconfig
```kconfig
config PACKAGE_XORG_DRIVER_VIDEO_INTEL
	bool "intel"
	select PACKAGE_XORG_LIB_XVMC
	select PACKAGE_XORG_PROTO_XINERAMA
	select PACKAGE_XORG_XORG_SERVER

if PACKAGE_XORG_DRIVER_VIDEO_INTEL

choice
	prompt "acceleration backend"

config PACKAGE_XORG_DRIVER_VIDEO_INTEL_SNA
	bool "SNA"

config PACKAGE_XORG_DRIVER_VIDEO_INTEL_UXA
	bool "UXA"

endchoice

config PACKAGE_XORG_DRIVER_VIDEO_INTEL_DEBUG
	bool "enable debugging support"

if PACKAGE_XORG_DRIVER_VIDEO_INTEL_DEBUG

config PACKAGE_XORG_DRIVER_VIDEO_INTEL_DEBUG_VALGRIND
	bool "enable valgrind support"
	select PACKAGE_DEVEL_VALGRIND

endif

endif
```

## packages/xorg/driver/xf86-video-modesetting/Kconfig
```kconfig
config PACKAGE_XORG_DRIVER_VIDEO_MODESETTING
	bool "modesetting"
	select PACKAGE_LIBS_LIBDRM
	select PACKAGE_XORG_XORG_SERVER
```

## packages/xorg/driver/xf86-video-opentegra/Kconfig
```kconfig
config PACKAGE_XORG_DRIVER_VIDEO_OPENTEGRA
	bool "opentegra"
	select PACKAGE_LIBS_LIBDRM
	select PACKAGE_XORG_XORG_SERVER
```
