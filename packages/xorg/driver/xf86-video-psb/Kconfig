## packages/xorg/driver/xf86-video-psb/Kconfig
```kconfig
config PACKAGE_XORG_DRIVER_VIDEO_PSB
	bool "psb"
	select PACKAGE_LIBS_LIBDRM_POULSBO
	select PACKAGE_XORG_LIB_XRENDER
	select PACKAGE_XORG_LIB_XV
	select PACKAGE_XORG_PROTO_XF86DRI
	select PACKAGE_XORG_XORG_SERVER
```

## packages/xorg/driver/xf86-video-vesa/Kconfig
```kconfig
config PACKAGE_XORG_DRIVER_VIDEO_VESA
	bool "vesa"
	select PACKAGE_XORG_XORG_SERVER
```

## packages/xorg/fonts/util/Kconfig
```kconfig
config PACKAGE_XORG_FONTS_UTIL
	bool "util"
	help
	  X.Org X11 font utilities required for font installation,
	  conversion and generation.
```

## packages/xorg/lib/Kconfig
```kconfig
menu "X.Org - Libraries"

source "packages/xorg/lib/fontenc/Kconfig"
source "packages/xorg/lib/ice/Kconfig"
source "packages/xorg/lib/pciaccess/Kconfig"
source "packages/xorg/lib/pthread-stubs/Kconfig"
source "packages/xorg/lib/sm/Kconfig"
source "packages/xorg/lib/x11/Kconfig"
source "packages/xorg/lib/xau/Kconfig"
source "packages/xorg/lib/xaw/Kconfig"
source "packages/xorg/lib/xcb/Kconfig"
source "packages/xorg/lib/xcb-util/Kconfig"
source "packages/xorg/lib/xcb-util-image/Kconfig"
source "packages/xorg/lib/xcb-util-keysyms/Kconfig"
source "packages/xorg/lib/xcb-util-wm/Kconfig"
source "packages/xorg/lib/xcomposite/Kconfig"
source "packages/xorg/lib/xcursor/Kconfig"
source "packages/xorg/lib/xdamage/Kconfig"
source "packages/xorg/lib/xdmcp/Kconfig"
source "packages/xorg/lib/xext/Kconfig"
source "packages/xorg/lib/xfixes/Kconfig"
source "packages/xorg/lib/xfont/Kconfig"
source "packages/xorg/lib/xft/Kconfig"
source "packages/xorg/lib/xi/Kconfig"
source "packages/xorg/lib/xinerama/Kconfig"
source "packages/xorg/lib/xkbfile/Kconfig"
source "packages/xorg/lib/xmu/Kconfig"
source "packages/xorg/lib/xp/Kconfig"
source "packages/xorg/lib/xpm/Kconfig"
source "packages/xorg/lib/xrandr/Kconfig"
source "packages/xorg/lib/xrender/Kconfig"
source "packages/xorg/lib/xres/Kconfig"
source "packages/xorg/lib/xt/Kconfig"
source "packages/xorg/lib/xtst/Kconfig"
source "packages/xorg/lib/xtrans/Kconfig"
source "packages/xorg/lib/xv/Kconfig"
source "packages/xorg/lib/xvmc/Kconfig"
source "packages/xorg/lib/xxf86vm/Kconfig"

endmenu
```

## packages/xorg/lib/ice/Kconfig
```kconfig
config PACKAGE_XORG_LIB_ICE
	bool "ICE"
	select PACKAGE_XORG_LIB_XTRANS
	default n
```

## packages/xorg/lib/pciaccess/Kconfig
```kconfig
config PACKAGE_XORG_LIB_PCIACCESS
	bool "pciaccess"
	select VIRTUAL_DEVEL_LIBC
	default n
```

## packages/xorg/lib/pthread-stubs/Kconfig
```kconfig
config PACKAGE_XORG_LIB_PTHREAD_STUBS
	bool "pthread-stubs"
	select VIRTUAL_DEVEL_LIBC
```

## packages/xorg/lib/x11/Kconfig
```kconfig
config PACKAGE_XORG_LIB_X11
	bool "x11"
	select PACKAGE_XORG_PROTO_INPUT
	select PACKAGE_XORG_PROTO_KB
	select PACKAGE_XORG_PROTO_XEXT
	select PACKAGE_XORG_LIB_XCB
	select PACKAGE_XORG_LIB_XTRANS
```

## packages/xorg/lib/xau/Kconfig
```kconfig
config PACKAGE_XORG_LIB_XAU
	bool "xau"
	select VIRTUAL_DEVEL_LIBC
	select PACKAGE_XORG_PROTO_X
	select PACKAGE_XORG_UTIL_UTIL_MACROS
```

## packages/xorg/lib/xaw/Kconfig
```kconfig
config PACKAGE_XORG_LIB_XAW
	bool "xaw - X Athena Widgets"
	select PACKAGE_XORG_LIB_XEXT
	select PACKAGE_XORG_LIB_XMU
	select PACKAGE_XORG_LIB_XPM
	default n
```

## packages/xorg/lib/xcb-util-cursor/Kconfig
```kconfig
config PACKAGE_XORG_LIB_XCB_UTIL_CURSOR
	bool "XCB utilities - cursor"
	select PACKAGE_XORG_LIB_XCB_UTIL
	select PACKAGE_XORG_LIB_XCB_UTIL_RENDERUTIL
```

## packages/xorg/lib/xcb-util-image/Kconfig
```kconfig
config PACKAGE_XORG_LIB_XCB_UTIL_IMAGE
	bool "XCB utilities - image"
	select PACKAGE_XORG_LIB_XCB_UTIL
```

## packages/xorg/lib/xcb-util-keysyms/Kconfig
```kconfig
config PACKAGE_XORG_LIB_XCB_UTIL_KEYSYMS
	bool "XCB utilities - keysyms"
	select PACKAGE_XORG_LIB_XCB_UTIL
```

## packages/xorg/lib/xcb-util-renderutil/Kconfig
```kconfig
config PACKAGE_XORG_LIB_XCB_UTIL_RENDERUTIL
	bool "XCB utilities - renderutil"
	select PACKAGE_XORG_LIB_XCB_UTIL
```

## packages/xorg/lib/xcb-util-wm/Kconfig
```kconfig
config PACKAGE_XORG_LIB_XCB_UTIL_WM
	bool "XCB utilities - WM"
	select PACKAGE_XORG_LIB_XCB_UTIL
```

## packages/xorg/lib/xcb-util/Kconfig
```kconfig
config PACKAGE_XORG_LIB_XCB_UTIL
	bool "XCB util"
	select PACKAGE_BUILD_TOOLS_AUTOCONF
	select PACKAGE_BUILD_TOOLS_AUTOMAKE
	select PACKAGE_XORG_LIB_XCB
	default n
```

## packages/xorg/lib/xcb/Kconfig
```kconfig
config PACKAGE_XORG_LIB_XCB
	bool "xcb"
	select PACKAGE_BUILD_TOOLS_PYTHON
	select PACKAGE_BUILD_TOOLS_LIBXSLT
	select PACKAGE_XORG_PROTO_XCB
	select PACKAGE_XORG_LIB_PTHREAD_STUBS
	select PACKAGE_XORG_LIB_XAU
	select PACKAGE_XORG_LIB_XDMCP
```

## packages/xorg/lib/xcomposite/Kconfig
```kconfig
config PACKAGE_XORG_LIB_XCOMPOSITE
	bool "xcomposite"
	select PACKAGE_XORG_LIB_XFIXES
	select PACKAGE_XORG_PROTO_COMPOSITE
```

## packages/xorg/lib/xcursor/Kconfig
```kconfig
config PACKAGE_XORG_LIB_XCURSOR
	bool "libXcursor"
	select PACKAGE_XORG_LIB_XFIXES
	select PACKAGE_XORG_LIB_XRENDER
```

## packages/xorg/lib/xdamage/Kconfig
```kconfig
config PACKAGE_XORG_LIB_XDAMAGE
	bool "xdamage"
	select PACKAGE_XORG_PROTO_DAMAGE
	select PACKAGE_XORG_LIB_XFIXES
```

## packages/xorg/lib/xext/Kconfig
```kconfig
config PACKAGE_XORG_LIB_XEXT
	bool "xext"
	select PACKAGE_XORG_PROTO_XEXT
	select PACKAGE_XORG_LIB_X11
	select PACKAGE_XORG_LIB_XAU
	default n
```
