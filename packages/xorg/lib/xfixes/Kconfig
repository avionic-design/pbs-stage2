## packages/xorg/lib/xfixes/Kconfig
```kconfig
config PACKAGE_XORG_LIB_XFIXES
	bool "xfixes"
	select VIRTUAL_DEVEL_LIBC
	select PACKAGE_XORG_LIB_X11
	select PACKAGE_XORG_PROTO_FIXES
	select PACKAGE_XORG_UTIL_UTIL_MACROS
	default n
```

## packages/xorg/lib/xfont/Kconfig
```kconfig
config PACKAGE_XORG_LIB_XFONT
	bool "xfont"
	select PACKAGE_LIBS_FREETYPE
	select PACKAGE_XORG_LIB_FONTENC
	select PACKAGE_XORG_PROTO_FONTS
```

## packages/xorg/lib/xfont2/Kconfig
```kconfig
config PACKAGE_XORG_LIB_XFONT2
	bool "xfont2"
	select PACKAGE_LIBS_FREETYPE
	select PACKAGE_XORG_LIB_FONTENC
	select PACKAGE_XORG_PROTO_FONTS
	help
	  libXfont provides the core of the legacy X11 font system, handling the
	  index files (fonts.dir, fonts.alias, fonts.scale), the various font
	  file formats, and rasterizing them.   It is used by the X servers, the
	  X Font Server (xfs), and some font utilities (bdftopcf for instance),
	  but should not be used by normal X11 clients.  X11 clients access
	  fonts via either the new API's in libXft, or the legacy API's in
	  libX11.
```

## packages/xorg/lib/xft/Kconfig
```kconfig
config PACKAGE_XORG_LIB_XFT
	bool "xft"
	select PACKAGE_LIBS_FONTCONFIG
	select PACKAGE_LIBS_FREETYPE
	select PACKAGE_XORG_LIB_X11
	select PACKAGE_XORG_LIB_XEXT
	select PACKAGE_XORG_LIB_XRENDER
```

## packages/xorg/lib/xi/Kconfig
```kconfig
config PACKAGE_XORG_LIB_XI
	bool "xi"
	select PACKAGE_XORG_PROTO_INPUT
	select PACKAGE_XORG_LIB_XEXT
```

## packages/xorg/lib/xinerama/Kconfig
```kconfig
config PACKAGE_XORG_LIB_XINERAMA
	bool "xinerama"
	select PACKAGE_XORG_PROTO_XINERAMA
	select PACKAGE_XORG_LIB_XEXT
	default n
```

## packages/xorg/lib/xkbfile/Kconfig
```kconfig
config PACKAGE_XORG_LIB_XKBFILE
	bool "xkbfile"
	select PACKAGE_XORG_PROTO_KB
	select PACKAGE_XORG_LIB_X11
```

## packages/xorg/lib/xmu/Kconfig
```kconfig
config PACKAGE_XORG_LIB_XMU
	bool "xmu"
	select PACKAGE_XORG_LIB_XEXT
	select PACKAGE_XORG_LIB_XT
```

## packages/xorg/lib/xp/Kconfig
```kconfig
config PACKAGE_XORG_LIB_XP
	bool "xp"
	select VIRTUAL_DEVEL_LIBC
	select PACKAGE_XORG_PROTO_PRINT
```

## packages/xorg/lib/xrandr/Kconfig
```kconfig
config PACKAGE_XORG_LIB_XRANDR
	bool "xrandr"
	select PACKAGE_XORG_PROTO_RANDR
	select PACKAGE_XORG_LIB_XEXT
	default n
```

## packages/xorg/lib/xrender/Kconfig
```kconfig
config PACKAGE_XORG_LIB_XRENDER
	bool "xrender"
	select PACKAGE_XORG_PROTO_RENDER
	select PACKAGE_XORG_LIB_X11
	default n
```

## packages/xorg/lib/xres/Kconfig
```kconfig
config PACKAGE_XORG_LIB_XRES
	bool "xres"
	select PACKAGE_XORG_PROTO_RESOURCE
	select PACKAGE_XORG_LIB_XEXT
	default n
```

## packages/xorg/lib/xshmfence/Kconfig
```kconfig
config PACKAGE_XORG_LIB_XSHMFENCE
	bool "xshmfence"
	select PACKAGE_XORG_UTIL_MACROS
	select PACKAGE_XORG_PROTO_X
```

## packages/xorg/lib/xss/Kconfig
```kconfig
config PACKAGE_XORG_LIB_XSS
	bool "libXScrnSaver"
	select PACKAGE_XORG_LIB_XEXT
	help
	  X.Org X11 libXss runtime library.
```

## packages/xorg/lib/xtst/Kconfig
```kconfig
config PACKAGE_XORG_LIB_XTST
	bool "xtst"
	select PACKAGE_XORG_PROTO_RECORD
	select PACKAGE_XORG_LIB_XEXT
	select PACKAGE_XORG_LIB_XI
```

## packages/xorg/lib/xv/Kconfig
```kconfig
config PACKAGE_XORG_LIB_XV
	bool "xv"
	select PACKAGE_XORG_LIB_X11
	select PACKAGE_XORG_PROTO_VIDEO
```

## packages/xorg/lib/xxf86vm/Kconfig
```kconfig
config PACKAGE_XORG_LIB_XXF86VM
	bool "xxf86vm"
	select PACKAGE_XORG_PROTO_VIDMODE
	select PACKAGE_XORG_LIB_XEXT
```

## packages/xorg/proto/Kconfig
```kconfig
menu "X.Org - Protocols"

source "packages/xorg/proto/bigreqs/Kconfig"
source "packages/xorg/proto/composite/Kconfig"
source "packages/xorg/proto/damage/Kconfig"
source "packages/xorg/proto/dga/Kconfig"
source "packages/xorg/proto/dri/Kconfig"
source "packages/xorg/proto/dri2/Kconfig"
source "packages/xorg/proto/dri3/Kconfig"
source "packages/xorg/proto/evie/Kconfig"
source "packages/xorg/proto/fixes/Kconfig"
source "packages/xorg/proto/fontcache/Kconfig"
source "packages/xorg/proto/fonts/Kconfig"
source "packages/xorg/proto/gl/Kconfig"
source "packages/xorg/proto/input/Kconfig"
source "packages/xorg/proto/kb/Kconfig"
source "packages/xorg/proto/print/Kconfig"
source "packages/xorg/proto/randr/Kconfig"
source "packages/xorg/proto/record/Kconfig"
source "packages/xorg/proto/render/Kconfig"
source "packages/xorg/proto/resource/Kconfig"
source "packages/xorg/proto/scrnsaver/Kconfig"
source "packages/xorg/proto/trap/Kconfig"
source "packages/xorg/proto/video/Kconfig"
source "packages/xorg/proto/vidmode/Kconfig"
source "packages/xorg/proto/x/Kconfig"
source "packages/xorg/proto/xcb/Kconfig"
source "packages/xorg/proto/xcmisc/Kconfig"
source "packages/xorg/proto/xext/Kconfig"
source "packages/xorg/proto/xinerama/Kconfig"

endmenu
```
