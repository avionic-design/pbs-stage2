## packages/xorg/util/Kconfig
```kconfig
menu "X.Org - Utilities"

source "packages/xorg/util/util-macros/Kconfig"

endmenu
```

## packages/xorg/xorg-server/Kconfig
```kconfig
config PACKAGE_XORG_XORG_SERVER
	bool "xorg-server"
	select PACKAGE_LIBS_LIBDRM if XORG_DRI
	select PACKAGE_LIBS_MESA if XORG_DRI
	select PACKAGE_LIBS_OPENSSL
	select PACKAGE_LIBS_PIXMAN
	select PACKAGE_XORG_LIB_FONTENC
	select PACKAGE_XORG_LIB_PCIACCESS
	select PACKAGE_XORG_LIB_XDMCP
	select PACKAGE_XORG_LIB_XFONT
	select PACKAGE_XORG_LIB_XKBFILE
	select PACKAGE_XORG_PROTO_BIGREQS
	select PACKAGE_XORG_PROTO_COMPOSITE
	select PACKAGE_XORG_PROTO_DAMAGE
	select PACKAGE_XORG_PROTO_DGA
	select PACKAGE_XORG_PROTO_DRI if XORG_DRI
	select PACKAGE_XORG_PROTO_DRI2 if XORG_DRI
	select PACKAGE_XORG_PROTO_FIXES
	select PACKAGE_XORG_PROTO_FONTS
	select PACKAGE_XORG_PROTO_GL
	select PACKAGE_XORG_PROTO_PRINT if XORG_PRINT
	select PACKAGE_XORG_PROTO_RANDR
	select PACKAGE_XORG_PROTO_RECORD
	select PACKAGE_XORG_PROTO_RENDER
	select PACKAGE_XORG_PROTO_RESOURCE
	select PACKAGE_XORG_PROTO_SCRNSAVER
	select PACKAGE_XORG_PROTO_VIDEO if XORG_XV
	select PACKAGE_XORG_PROTO_XCMISC
	select PACKAGE_XORG_PROTO_XINERAMA if XORG_XINERAMA
	select VIRTUAL_UDEV

if PACKAGE_XORG_XORG_SERVER

config XORG_AIGLX
	bool "AIGLX support"

config XORG_DRI
	bool "DRI support"

config XORG_GLX
	bool "GLX support"

config XORG_XV
	bool "XVideo support"

config XORG_XINERAMA
	bool "Xinerama support"

config XORG_PRINT
	bool "Printing support"

endif
```

## platform/toolchain/Kconfig
```kconfig
choice CONFIG_ARCH
	prompt "Architecture"

endchoice

choice
	prompt "Toolchain"

config TOOLCHAIN_BLACKFIN_LINUX_UCLIBC
	bool "arm-linux-gnueabi"

config TOOLCHAIN_MIPS_LINUX_UCLIBC
	bool "mips-linux-uclibc"

config TOOLCHAIN_MIPSEL_LINUX_UCLIBC
	bool "mipsel-linux-uclibc"

config TOOLCHAIN_X86_64_LINUX_GNU
	bool "x86_64-linux-gnu"

config TOOLCHAIN_X86_64_LINUX_UCLIBC
	bool "x86_64-linux-uclibc"

endchoice
```

## platforms/Kconfig
```kconfig
config BUILD_INITRD
	bool
	select PACKAGE_BUILD_TOOLS_CPIO
	select PACKAGE_BUILD_TOOLS_DTC if PACKAGE_KERNEL_LINUX_DTB
	select PACKAGE_BUILD_TOOLS_UBOOT if ARCH_HAS_UBOOT

menu "Platform"

choice PLATFORM
	prompt "Platform Selection"

	glob_source "platforms/*/Kconfig.choice"

endchoice

glob_source "platforms/*/Kconfig"

if BUILD_INITRD && ARCH_HAS_UBOOT

config KERNEL_LOAD_ADDRESS
	hex "Kernel load address"
	default 0x81000000 if ARCH_TEGRA_124_SOC
	default 0x80008000 if ARCH_TEGRA_3x_SOC
	default 0x00008000 if ARCH_TEGRA_2x_SOC

config KERNEL_ENTRY_ADDRESS
	hex "Kernel entry address"
	default 0x81000000 if ARCH_TEGRA_124_SOC
	default 0x80008000 if ARCH_TEGRA_3x_SOC
	default 0x00008000 if ARCH_TEGRA_2x_SOC

config INITRD_LOAD_ADDRESS
	hex "Initrd load address"
	default 0x82100000 if ARCH_TEGRA_124_SOC
	default 0x82100000 if ARCH_TEGRA_3x_SOC
	default 0x02100000 if ARCH_TEGRA_2x_SOC

config FDT_LOAD_ADDRESS
	hex "Flattened Device Treee load address"
	default 0x82000000 if ARCH_TEGRA_124_SOC
	default 0 # For platforms that don't need an explicit address

endif

endmenu
```

## platforms/generic/Kconfig
```kconfig
source "platforms/generic/initrd/Kconfig"
source "platforms/generic/install/Kconfig"
source "platforms/generic/empty/Kconfig"
```

## platforms/generic/initrd/Kconfig
```kconfig
config PLATFORM_GENERIC_INITRD
	bool
	select BUILD_INITRD
	select PACKAGE_CORE_BUSYBOX
	select PACKAGE_CORE_UDEV
	select PACKAGE_CORE_UTIL_LINUX
```

## platforms/generic/install/Kconfig
```kconfig
config PLATFORM_GENERIC_INSTALL
	bool
	select PACKAGE_CORE_BUSYBOX
	select PACKAGE_CORE_UDEV
	select PACKAGE_CORE_UTIL_LINUX
```

## platforms/generic/nosy/Kconfig
```kconfig
config PLATFORM_GENERIC_NOSY
	bool "No-OS-Yet bringup Image"
	select BUILD_INITRD
	select PACKAGE_CORE_BASE_FILES
	select PACKAGE_CORE_BUSYBOX
	select PACKAGE_CORE_PCIUTILS
	select PACKAGE_MULTIMEDIA_ALSA_UTILS
	select PACKAGE_UTIL_I2C_TOOLS
	select PACKAGE_UTIL_MTD_UTILS
	# We need to disable UBI to support to avoid pulling util-linux in
	select PACKAGE_UTIL_MTD_UTILS_WITHOUT_UBI
	select PACKAGE_UTIL_ADAK
```

## toolchains/Kconfig
```kconfig
source "toolchains/packages/Kconfig"

if !TOOLCHAIN
config CROSS_COMPILE
	string "cross-compilation toolchain"
	default ""
endif
```

## toolchains/packages/Kconfig
```kconfig
config TOOLCHAIN
	bool "build toolchain"
	default n

if TOOLCHAIN

#
# C runtime library
#
choice
	prompt "C runtime library"

config UCLIBC
	bool "uclibc: uClibc"

config GLIBC
	bool "glibc: GNU libc"

config KLIBC_KLIBC
	bool "klibc"

endchoice

source "toolchains/packages/uclibc/Kconfig"
source "toolchains/packages/glibc/Kconfig"
source "toolchains/packages/klibc/Kconfig"

endif
```
