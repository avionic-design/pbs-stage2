## packages/vendor/ti/dmai/Kconfig
```kconfig
config PACKAGE_VENDOR_TI_DMAI
	bool "DMAI"
	select PACKAGE_MULTIMEDIA_ALSA_CORE
	select PACKAGE_VENDOR_TI_CODEC_ENGINE
	select PACKAGE_VENDOR_TI_DVSDK
	select PACKAGE_VENDOR_TI_DM365_MMAP
	select PACKAGE_VENDOR_TI_DM365_CODECS
```

## packages/vendor/ti/ffmpeg-csc/Kconfig
```kconfig
config PACKAGE_VENDOR_TI_FFMPEG_CSC
	bool "ffmpeg for CSC"
	select PACKAGE_VENDOR_TI_CODEC_ENGINE
	select PACKAGE_VENDOR_TI_DVSDK
	select PACKAGE_VENDOR_TI_DM365_CODECS
	select PACKAGE_VENDOR_TI_DM365_MMAP

config FFMPEG_CSC_BRANCH
	string "ffmpeg csc repository branch"
	default "csc"
	depends on PACKAGE_VENDOR_TI_FFMPEG_CSC
```

## packages/vendor/ti/framework-components/Kconfig
```kconfig
config PACKAGE_VENDOR_TI_FRAMEWORK_COMPONENTS
	bool "Framework Components"
	select PACKAGE_VENDOR_TI_XDCTOOLS
	select PACKAGE_VENDOR_TI_XDAIS
	select PACKAGE_VENDOR_TI_LINUXUTILS
```

## packages/vendor/ti/linuxutils/Kconfig
```kconfig
config PACKAGE_VENDOR_TI_LINUXUTILS
	bool "TI Linuxutils"
	select VIRTUAL_KERNEL_LINUX_LIBC
```

## packages/virtual/Kconfig
```kconfig
menu "Virtual Packages"

source "packages/virtual/gtk/Kconfig"
source "packages/virtual/multimedia/Kconfig"
source "packages/virtual/opengl/Kconfig"
source "packages/virtual/udev/Kconfig"

endmenu
```

## packages/virtual/gtk/Kconfig
```kconfig
config VIRTUAL_LIBS_GTK
	bool
	select PACKAGE_LIBS_GTK if VIRTUAL_LIBS_GTK_GTK2
	select PACKAGE_LIBS_GTK3 if VIRTUAL_LIBS_GTK_GTK3

choice
	prompt "Gtk+ Version"

config VIRTUAL_LIBS_GTK_GTK2
	bool "2.0"

config VIRTUAL_LIBS_GTK_GTK3
	bool "3.0"

endchoice
```

## packages/virtual/multimedia/Kconfig
```kconfig
menu "libav"

config VIRTUAL_LIBAV
	bool
	select PACKAGE_MULTIMEDIA_FFMPEG if LIBAV_FFMPEG
	select PACKAGE_MULTIMEDIA_LIBAV if LIBAV_LIBAV

# choose the libav implementation
choice LIBAV
	prompt "libav implementation"
	help
	  Select the package which shall provide the libav.

config LIBAV_FFMPEG
	bool "ffmpeg"

config LIBAV_LIBAV
	bool "libav"

endchoice

endmenu
```

## packages/virtual/opengl/Kconfig
```kconfig
menu "OpenGL"

config HAVE_OPENGL
	bool

config HAVE_OPENGL_ES
	bool

config VIRTUAL_OPENGL
	bool
	select PACKAGE_LIBS_MESA if OPENGL_MESA

config VIRTUAL_OPENGL_ES
	bool
	select PACKAGE_LIBS_MESA if OPENGL_MESA
	select PACKAGE_LIBS_MESA_OPENGL_ES2 if OPENGL_MESA
	select PACKAGE_VENDOR_NVIDIA_TEGRA2_L4T if OPENGL_NVIDIA_L4T_T2
	select PACKAGE_VENDOR_NVIDIA_TEGRA3_L4T if OPENGL_NVIDIA_L4T_T3

# choose the OpenGL implementation
choice OPENGL
	prompt "OpenGL implementation"

config OPENGL_MESA
	bool "Mesa 3D"

config OPENGL_NVIDIA_L4T_T2
	bool "NVIDIA Linux4Tegra (Tegra2)"
	select HAVE_OPENGL_ES

config OPENGL_NVIDIA_L4T_T3
	bool "NVIDIA Linux4Tegra (Tegra3)"
	select HAVE_OPENGL_ES

endchoice

source "packages/virtual/opengl/mesa/Kconfig"

endmenu
```

## packages/virtual/opengl/mesa/Kconfig
```kconfig
if OPENGL_MESA

config OPENGL_MESA_EGL
	bool "EGL"

config OPENGL_MESA_OPENGL_ES1
	bool "OpenGL ES v1"
	select OPENGL_MESA_EGL

config OPENGL_MESA_OPENGL_ES2
	bool "OpenGL ES v2"
	select OPENGL_MESA_EGL
	select HAVE_OPENGL_ES

config OPENGL_MESA_OPENGL
	bool "OpenGL"
	select HAVE_OPENGL

endif
```

## packages/virtual/udev/Kconfig
```kconfig
config VIRTUAL_UDEV
	bool
	select PACKAGE_CORE_UDEV if UDEV_UDEV
	select PACKAGE_CORE_SYSTEMD if UDEV_SYSTEMD

config VIRTUAL_UDEV_GLIB
	bool
	select PACKAGE_CORE_UDEV_GLIB if UDEV_UDEV
	select PACKAGE_CORE_SYSTEMD if UDEV_SYSTEMD

choice UDEV
	prompt "udev implementation"

config UDEV_UDEV
	bool "udev"

config UDEV_SYSTEMD
	bool "systemd"

endchoice
```

## packages/web/Kconfig
```kconfig
menu "World-Wide Web Utilities"

source "packages/web/flashplugin/Kconfig"
source "packages/web/freerdp/Kconfig"
source "packages/web/libvncserver/Kconfig"
source "packages/web/mozilla/Kconfig"
source "packages/web/nspluginwrapper/Kconfig"
source "packages/web/rdesktop/Kconfig"
source "packages/web/webkit-gtk/Kconfig"
source "packages/web/x11vnc/Kconfig"

endmenu
```

## packages/web/flashplugin/Kconfig
```kconfig
config PACKAGE_WEB_FLASHPLUGIN
	bool "flashplugin"
	depends on ARCH_X86 || ARCH_X86_64
	select PACKAGE_LIBS_GTK
	select PACKAGE_LIBS_NSS
	default n
```

## packages/web/freerdp/Kconfig
```kconfig
config PACKAGE_WEB_FREERDP
	bool "freerdp"
	select PACKAGE_LIBS_OPENSSL
	select PACKAGE_XORG_LIB_XCURSOR
	select PACKAGE_XORG_LIB_XDAMAGE
	select PACKAGE_XORG_LIB_XKBFILE
	select PACKAGE_XORG_LIB_XINERAMA
	select PACKAGE_XORG_LIB_XV
	default n
```

## packages/web/libvncserver/Kconfig
```kconfig
config PACKAGE_WEB_LIBVNCSERVER
	bool "libvncserver"
	select PACKAGE_BUILD_TOOLS_AUTOCONF
	select PACKAGE_BUILD_TOOLS_LIBGCRYPT
	select PACKAGE_LIBS_GNUTLS
	select PACKAGE_LIBS_LIBGCRYPT
	select PACKAGE_LIBS_LIBJPEG
	select PACKAGE_LIBS_SDL_CORE
	select PACKAGE_LIBS_ZLIB
```

## packages/web/mozilla/Kconfig
```kconfig
menu "Mozilla"

source "packages/web/mozilla/firefox/Kconfig"
source "packages/web/mozilla/xulrunner/Kconfig"

endmenu
```

## packages/web/mozilla/firefox/Kconfig
```kconfig
config PACKAGE_WEB_MOZILLA_FIREFOX
	bool "Mozilla Firefox"
	select PACKAGE_BUILD_TOOLS_GLIB
	select PACKAGE_BUILD_TOOLS_LIBIDL
	select VIRTUAL_LIBS_GTK
	select PACKAGE_LIBS_LIBIDL
	select PACKAGE_LIBS_LIBNOTIFY
	select PACKAGE_MULTIMEDIA_ALSA_CORE
```

## packages/web/mozilla/xulrunner/Kconfig
```kconfig
config PACKAGE_WEB_MOZILLA_XULRUNNER
	bool "Mozilla XUL Runner"
	select PACKAGE_BUILD_TOOLS_GLIB
	select PACKAGE_BUILD_TOOLS_LIBIDL
	select PACKAGE_LIBS_GTK
	select PACKAGE_LIBS_LIBIDL
	select PACKAGE_LIBS_LIBNOTIFY
	select PACKAGE_MULTIMEDIA_ALSA_CORE
	select PACKAGE_XORG_LIB_XT
	default n
```

## packages/web/nspluginwrapper/Kconfig
```kconfig
config PACKAGE_WEB_NSPLUGINWRAPPER
	bool "nspluginwrapper"
	depends on ARCH_X86 || ARCH_X86_64
	select PACKAGE_LIBS_CURL
	select PACKAGE_LIBS_GLIB
	select PACKAGE_LIBS_GTK
	select PACKAGE_XORG_LIB_X11
	select PACKAGE_XORG_LIB_XT
```

## packages/web/rdesktop/Kconfig
```kconfig
config PACKAGE_WEB_RDESKTOP
	bool "rdesktop"
	select PACKAGE_BUILD_TOOLS_AUTOCONF
	select PACKAGE_BUILD_TOOLS_AUTOMAKE
	select PACKAGE_XORG_LIB_XRANDR
	default n
```

## packages/web/webkit-gtk/Kconfig
```kconfig
config PACKAGE_WEB_WEBKIT_GTK
	bool "webkit-gtk"
	select PACKAGE_BUILD_TOOLS_FLEX
	select PACKAGE_BUILD_TOOLS_BISON
	select PACKAGE_BUILD_TOOLS_GTK_DOC
	select PACKAGE_BUILD_TOOLS_RUBY
	select PACKAGE_DESKTOP_SHARED_MIME_INFO
	select PACKAGE_LIBS_GLIB_NETWORKING
	select VIRTUAL_LIBS_GTK if !PACKAGE_WEB_WEBKIT_GTK_ENABLE_WEBKIT2
	select PACKAGE_LIBS_GTK3 if PACKAGE_WEB_WEBKIT_GTK_ENABLE_WEBKIT2
	select PACKAGE_LIBS_ICU if PACKAGE_WEB_WEBKIT_GTK_UNICODE_BACKEND_ICU
	select PACKAGE_LIBS_LIBSOUP
	select PACKAGE_LIBS_LIBXML2
	select PACKAGE_LIBS_LIBXSLT
	select PACKAGE_LIBS_SQLITE
	select PACKAGE_MULTIMEDIA_GSTREAMER_0_10_PLUGINS_BASE if PACKAGE_WEB_WEBKIT_GTK_ENABLE_VIDEO
	select PACKAGE_XORG_LIB_XT
	select PACKAGE_MULTIMEDIA_GSTREAMER_0_10_PLUGINS_NVXVIMAGESINK if PLATFORM_AVIONIC_DESIGN_MEDCOM_WIDE

if PACKAGE_WEB_WEBKIT_GTK

choice PACKAGE_WEB_WEBKIT_GTK_UNICODE_BACKEND
	prompt "Unicode backend"

config PACKAGE_WEB_WEBKIT_GTK_UNICODE_BACKEND_GLIB
	bool "GLib"

config PACKAGE_WEB_WEBKIT_GTK_UNICODE_BACKEND_ICU
	bool "ICU"

endchoice

config PACKAGE_WEB_WEBKIT_GTK_ENABLE_VIDEO
	bool "HTML5 <video> tag support"
	help
	  Enables support for HTML5 video tag.

config PACKAGE_WEB_WEBKIT_GTK_ENABLE_ACCELERATED_COMPOSITING
	bool "Accelerated Compositing"
	help
	  Enables support for accelerated compositing.

config PACKAGE_WEB_WEBKIT_GTK_ENABLE_WEBGL
	bool "WebGL support"
	select VIRTUAL_OPENGL_ES
	help
	  Enables support for WebGL and 3D rendering.

config PACKAGE_WEB_WEBKIT_GTK_ENABLE_FS_API
	bool "Enable FilesystemAPI support"
	help
	  Enables support for HTML5 Filesystem API.

config PACKAGE_WEB_WEBKIT_GTK_ENABLE_ANIM_API
	bool "Enable Webkit AnimationAPI support"
	help
	  Enables support for Webkit Animation API.

config PACKAGE_WEB_WEBKIT_GTK_ENABLE_WEBKIT2
	bool "Enable Webkit2 support"
	help
	  Enables support for Webkit2.

endif
```

## packages/web/webkit/Kconfig
```kconfig
config PACKAGE_WEB_WEBKIT
	bool "webkit"
	select PACKAGE_LIBS_ENCHANT
	select PACKAGE_LIBS_GTK
	select PACKAGE_LIBS_ICU
	select PACKAGE_LIBS_LIBSOUP_GIT
	select PACKAGE_LIBS_LIBXML2
	select PACKAGE_LIBS_LIBXSLT
	select PACKAGE_LIBS_SQLITE
	default n
```

## packages/web/x11vnc/Kconfig
```kconfig
config PACKAGE_WEB_X11VNC
	bool "x11vnc"
	select PACKAGE_WEB_LIBVNCSERVER
	default n
```

## packages/wm/Kconfig
```kconfig
menu "Window Managers"

source "packages/wm/awesome/Kconfig"
source "packages/wm/dwm/Kconfig"
source "packages/wm/i3/Kconfig"
source "packages/wm/i3status/Kconfig"
source "packages/wm/icewm/Kconfig"
source "packages/wm/matchbox/Kconfig"
source "packages/wm/metacity/Kconfig"
source "packages/wm/openbox/Kconfig"

endmenu
```
