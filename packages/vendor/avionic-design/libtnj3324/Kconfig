## packages/vendor/avionic-design/libtnj3324/Kconfig
```kconfig
config PACKAGE_VENDOR_AVIONIC_DESIGN_LIBTNJ3324
	bool "libtnj3324"
	select VIRTUAL_DEVEL_LIBC
	help
	  This library control the analog tv tuner TNJ3324 from
	  Shenzhen Tena Electronics Co Ltd.
```

## packages/vendor/avionic-design/medatom-utils/Kconfig
```kconfig
config PACKAGE_VENDOR_AVIONIC_DESIGN_MEDATOM_UTILS
	bool "Med@tom utilities"
	select PACKAGE_LIBS_CURL
	select PACKAGE_UTIL_ADAK
```

## packages/vendor/avionic-design/medcom-wide/Kconfig
```kconfig
menu "Medcom Wide"

source "packages/vendor/avionic-design/medcom-wide/utils/Kconfig"

endmenu
```

## packages/vendor/avionic-design/medcom-wide/utils/Kconfig
```kconfig
config PACKAGE_VENDOR_AVIONIC_DESIGN_MEDCOM_WIDE_UTILS
	bool "Medcom Wide utilities"
	select PACKAGE_LIBS_CURL
```

## packages/vendor/avionic-design/platform-test/Kconfig
```kconfig
config PACKAGE_VENDOR_AVIONIC_DESIGN_PLATFORM_TEST
	bool "platform-test"
	select PACKAGE_SHELLS_BASH
	help
	  A simple platform testing framework for AD hardware.
```

## packages/vendor/avionic-design/ptip/Kconfig
```kconfig
menu "PT-IP"

source "packages/vendor/avionic-design/ptip/murnau/Kconfig"
source "packages/vendor/avionic-design/ptip/classic/Kconfig"
source "packages/vendor/avionic-design/ptip/devbusd/Kconfig"

endmenu
```

## packages/vendor/avionic-design/ptip/classic/Kconfig
```kconfig
config PACKAGE_VENDOR_AVIONIC_DESIGN_PTIP_CLASSIC
	bool "PT-IP Classic"
	select PACKAGE_VENDOR_AVIONIC_DESIGN_PTIP_DEVBUSD
	select PACKAGE_LIBS_FREETYPE
	select PACKAGE_LIBS_LIBXML2
	select PACKAGE_LIBS_CURL
	select PACKAGE_MULTIMEDIA_LINPHONE
	select PACKAGE_MULTIMEDIA_LINPHONE_SPEEX
	select PACKAGE_LIBS_GETTEXT
```

## packages/vendor/avionic-design/ptip/devbusd/Kconfig
```kconfig
config PACKAGE_VENDOR_AVIONIC_DESIGN_PTIP_DEVBUSD
	bool "devbusd"
	select VIRTUAL_DEVEL_LIBC
	default n
```

## packages/vendor/avionic-design/ptip/murnau/Kconfig
```kconfig
config PACKAGE_VENDOR_AVIONIC_DESIGN_PTIP_MURNAU
	bool "PT-IP Murnau"
	select VIRTUAL_DEVEL_LIBC
	select PACKAGE_BUILD_TOOLS_AUTOCONF
	select PACKAGE_BUILD_TOOLS_AUTOMAKE
	default n
```

## packages/vendor/avionic-design/remote-control/Kconfig
```kconfig
config PACKAGE_VENDOR_AVIONIC_DESIGN_REMOTE_CONTROL
	bool "remote-control"
	select PACKAGE_BUILD_TOOLS_DOCBOOK_XSL
	select PACKAGE_LIBS_GTKOSK
	select PACKAGE_LIBS_LIBGLADE
	select PACKAGE_LIBS_LIBNL
	select PACKAGE_LIBS_LIBSH
	select PACKAGE_LIBS_LIBXML2 if PACKAGE_VENDOR_AVIONIC_DESIGN_REMOTE_CONTROL_SMARTCARD_INFO
	select PACKAGE_LIBS_ZLIB if PACKAGE_VENDOR_AVIONIC_DESIGN_REMOTE_CONTROL_SMARTCARD_INFO
	select PACKAGE_LIBS_PCSC_LITE if PACKAGE_VENDOR_AVIONIC_DESIGN_REMOTE_CONTROL_SMARTCARD_LIBPCSCLITE
	select PACKAGE_LIBS_LIBSMARTCARD if PACKAGE_VENDOR_AVIONIC_DESIGN_REMOTE_CONTROL_SMARTCARD_LIBSMARTCARD
	select PACKAGE_LIBS_LIBGPIO if PACKAGE_VENDOR_AVIONIC_DESIGN_REMOTE_CONTROL_GPIO_SYSFS
	select PACKAGE_LIBS_PULSEAUDIO if PACKAGE_VENDOR_AVIONC_DESIGN_REMOTE_CONTROL_AUDIO_PULSE
	select PACKAGE_LIBS_SYSFSUTILS if PACKAGE_VENDOR_AVIONIC_DESIGN_REMOTE_CONTROL_BACKLIGHT_SYSFS
	select PACKAGE_MULTIMEDIA_ALSA_CORE if PACKAGE_VENDOR_AVIONIC_DESIGN_REMOTE_CONTROL_AUDIO_ALSA
	select PACKAGE_MULTIMEDIA_LINPHONE if PACKAGE_VENDOR_AVIONIC_DESIGN_REMOTE_CONTROL_VOIP_LINPHONE
	select PACKAGE_MULTIMEDIA_VLC if PACKAGE_VENDOR_AVIONIC_DESIGN_REMOTE_CONTROL_VIDEO_VLC
	select PACKAGE_MULTIMEDIA_GSTREAMER_PLUGINS_BASE if PACKAGE_VENDOR_AVIONIC_DESIGN_REMOTE_CONTROL_VIDEO_GST
	select PACKAGE_VENDOR_AVIONIC_DESIGN_DBUS_WATCHDOG if PACKAGE_VENDOR_AVIONIC_DESIGN_REMOTE_CONTROL_WATCHDOG
	select PACKAGE_LIBS_POPPLER
	select PACKAGE_WEB_WEBKIT_GTK
	select VIRTUAL_UDEV_GLIB

if PACKAGE_VENDOR_AVIONIC_DESIGN_REMOTE_CONTROL

choice
	prompt "Audio (UCM) Support"

	config PACKAGE_VENDOR_AVIONIC_DESIGN_REMOTE_CONTROL_AUDIO_NONE
		bool "Not supported"

	config PACKAGE_VENDOR_AVIONIC_DESIGN_REMOTE_CONTROL_AUDIO_ALSA
		bool "ALSA UCM"
		help
		  Use ALSA Use Case Manager to provide audio states.

	config PACKAGE_VENDOR_AVIONIC_DESIGN_REMOTE_CONTROL_AUDIO_PULSE
		bool "PulseAudio (using UCM)"
		help
		  Use pulseaudio backend, where pulseaudio is using alsa ucm
		  configurations files to generate its ports.

endchoice

choice
	prompt "Backlight Support"

	config PACKAGE_VENDOR_AVIONIC_DESIGN_REMOTE_CONTROL_BACKLIGHT_NONE
		bool "Not supported"

	config PACKAGE_VENDOR_AVIONIC_DESIGN_REMOTE_CONTROL_BACKLIGHT_DPMS
		bool "DPMS"

	config PACKAGE_VENDOR_AVIONIC_DESIGN_REMOTE_CONTROL_BACKLIGHT_SYSFS
		bool "SysFS"

	config PACKAGE_VENDOR_AVIONIC_DESIGN_REMOTE_CONTROL_BACKLIGHT_MEDATOM
		bool "Avionic Design Medatom"

endchoice

choice
	prompt "Video Playback Support"

	config PACKAGE_VENDOR_AVIONIC_DESIGN_REMOTE_CONTROL_VIDEO_NONE
		bool "Not supported"

	config PACKAGE_VENDOR_AVIONIC_DESIGN_REMOTE_CONTROL_VIDEO_VLC
		bool "Use VideoLanClient"

	config PACKAGE_VENDOR_AVIONIC_DESIGN_REMOTE_CONTROL_VIDEO_GST
		bool "Use GStreamer"

endchoice

menu "SmartCard/RFID Support"

	config PACKAGE_VENDOR_AVIONIC_DESIGN_REMOTE_CONTROL_SMARTCARD_LIBSMARTCARD
		bool "Use libsmartcard"

	config PACKAGE_VENDOR_AVIONIC_DESIGN_REMOTE_CONTROL_SMARTCARD_LIBPCSCLITE
		bool "Use PC/SC lite"

	config PACKAGE_VENDOR_AVIONIC_DESIGN_REMOTE_CONTROL_SMARTCARD_INFO
		bool "Support for reading smartcard info"
endmenu

choice
	prompt "VoIP Support"

	config PACKAGE_VENDOR_AVIONIC_DESIGN_REMOTE_CONTROL_VOIP_NONE
		bool "Not supported"

	config PACKAGE_VENDOR_AVIONIC_DESIGN_REMOTE_CONTROL_VOIP_LINPHONE
		bool "Use Linphone"

endchoice

choice
	prompt "Mixer Support"

	config PACKAGE_VENDOR_AVIONIC_DESIGN_REMOTE_CONTROL_MIXER_NONE
		bool "Not supported"

	config PACKAGE_VENDOR_AVIONIC_DESIGN_REMOTE_CONTROL_MIXER_ALSA
		bool "ALSA"

endchoice

choice
	prompt "GPIO Support"

	config PACKAGE_VENDOR_AVIONIC_DESIGN_REMOTE_CONTROL_GPIO_NONE
		bool "Not supported"

	config PACKAGE_VENDOR_AVIONIC_DESIGN_REMOTE_CONTROL_GPIO_GPIODEV
		bool "/dev/gpio-* device support"

	config PACKAGE_VENDOR_AVIONIC_DESIGN_REMOTE_CONTROL_GPIO_SYSFS
		bool "sysfs (Linux kernel gpiolib) support"

endchoice

config PACKAGE_VENDOR_AVIONIC_DESIGN_REMOTE_CONTROL_JAVASCRIPT
	bool "JavaScript binding"

if PACKAGE_VENDOR_AVIONIC_DESIGN_REMOTE_CONTROL_JAVASCRIPT

config PACKAGE_VENDOR_AVIONIC_DESIGN_REMOTE_CONTROL_JAVASCRIPT_IR
	bool "JavaScript binding - IR support"
	depends on PACKAGE_VENDOR_AVIONIC_DESIGN_REMOTE_CONTROL_JAVASCRIPT

config PACKAGE_VENDOR_AVIONIC_DESIGN_REMOTE_CONTROL_JAVASCRIPT_APP_WATCHDOG
	bool "JavaScript binding - Watchdog support"
	depends on PACKAGE_VENDOR_AVIONIC_DESIGN_REMOTE_CONTROL_JAVASCRIPT

config PACKAGE_VENDOR_AVIONIC_DESIGN_REMOTE_CONTROL_JAVASCRIPT_LCD
	bool "JavaScript binding - LCD Display Control"
	depends on PACKAGE_VENDOR_AVIONIC_DESIGN_REMOTE_CONTROL_JAVASCRIPT
	depends on PLATFORM_AVIONIC_DESIGN_PLUTUX
	help
	  The JavaScript Binding to control the LCD-TV via RS232.
	  This is a plutux only option.

endif

config PACKAGE_VENDOR_AVIONIC_DESIGN_REMOTE_CONTROL_WATCHDOG
	bool "D-Bus Watchdog suppport"

endif
```

## packages/vendor/avionic-design/rum/Kconfig
```kconfig
config PACKAGE_VENDOR_AVIONIC_DESIGN_RUM
	bool "rum"
	select PACKAGE_CORE_LM_SENSORS
	select PACKAGE_LIBS_JSON_GLIB
	select PACKAGE_LIBS_LIBSOUP
	help
	  The Remote-Unit-Manager is a simple HTTP server providing
	  information about discovered devices and allowing these
	  devices to be controlled remotely via a JSON-based interface.
```

## packages/vendor/nvidia/Kconfig
```kconfig
menu "NVIDIA"

source "packages/vendor/nvidia/tegra2/Kconfig"
source "packages/vendor/nvidia/tegra3/Kconfig"

endmenu
```

## packages/vendor/nvidia/tegra2/Kconfig
```kconfig
if ARCH_TEGRA_2x_SOC

menu "NVIDIA Tegra2"

source "packages/vendor/nvidia/tegra2/l4t/Kconfig"

source "packages/vendor/nvidia/tegra2/samples/Kconfig"

endmenu

endif
```

## packages/vendor/nvidia/tegra2/common/Kconfig
```kconfig
config PACKAGE_VENDOR_NVIDIA_TEGRA2_COMMON
	bool "Vibrante Common Files"
	help
	  This package contains the common libraries and the resource manager required to
	  use the hw accelleration.
```

## packages/vendor/nvidia/tegra2/egl/Kconfig
```kconfig
config PACKAGE_VENDOR_NVIDIA_TEGRA2_EGL
	bool "Vibrante EGL"
	select PACKAGE_VENDOR_NVIDIA_TEGRA2_COMMON
```

## packages/vendor/nvidia/tegra2/flashplayer/Kconfig
```kconfig
config PACKAGE_VENDOR_NVIDIA_TEGRA2_FLASHPLAYER
	bool "Flashplayer"
	select PACKAGE_LIBS_NSS
	help
	  This package contains the flashplayer for tegra2. The files are taken
	  from Vibrante but working also under L4T.
```

## packages/vendor/nvidia/tegra2/l4t/Kconfig
```kconfig
config PACKAGE_VENDOR_NVIDIA_TEGRA2_L4T
	bool "Linux4Tegra (L4T) binaries"
	select STABLE_API
	help
	  Provides the binary drivers and OpenGL ES2 implementation for Tegra2/3.
```

## packages/vendor/nvidia/tegra2/opengles/Kconfig
```kconfig
config PACKAGE_VENDOR_NVIDIA_TEGRA2_OPENGLES
	bool "Vibrante OpenGLES"
	select PACKAGE_VENDOR_NVIDIA_TEGRA2_EGL
	select PACKAGE_VENDOR_NVIDIA_TEGRA2_XORG
	help
	  This package provides the libraries and header to use opengles v1 and v2.
```

## packages/vendor/nvidia/tegra2/samples/Kconfig
```kconfig
menu "Samples"

source "packages/vendor/nvidia/tegra2/samples/gst-media-player/Kconfig"

endmenu
```

## packages/vendor/nvidia/tegra2/samples/gst-media-player/Kconfig
```kconfig
config PACKAGE_VENDOR_NVIDIA_TEGRA2_SAMPLES_GSTMEDIAPLAYER
	bool "GstMediaPlayer"
	select PACKAGE_MULTIMEDIA_GSTREAMER_CORE
	select PACKAGE_MULTIMEDIA_GSTREAMER_PLUGINS_BASE
	select PACKAGE_VENDOR_NVIDIA_TEGRA2_XORG
	help
	  This is the sample application from nvidia using gstreamer.
```

## packages/vendor/nvidia/tegra2/xorg/Kconfig
```kconfig
config PACKAGE_VENDOR_NVIDIA_TEGRA2_XORG
	bool "Vibrante XOrg Server & Driver"
	select PACKAGE_VENDOR_NVIDIA_TEGRA2_COMMON
	select PACKAGE_XORG_XORG_SERVER
	default n
	help
	  This package contains the xserver modified and build by nvidia.
```

## packages/vendor/nvidia/tegra3/Kconfig
```kconfig
if ARCH_TEGRA_3x_SOC

menu "NVIDIA Tegra3"

source "packages/vendor/nvidia/tegra3/l4t/Kconfig"

endmenu

endif
```

## packages/vendor/nvidia/tegra3/l4t/Kconfig
```kconfig
config PACKAGE_VENDOR_NVIDIA_TEGRA3_L4T
	bool "Linux4Tegra (L4T) binaries"
	select STABLE_API
	help
	  Provides the binary drivers and OpenGL ES2 implementation for Tegra3.
```

## packages/vendor/ti/Kconfig
```kconfig
menu "TI software"

source "packages/vendor/ti/xdctools/Kconfig"
source "packages/vendor/ti/xdais/Kconfig"
source "packages/vendor/ti/linuxutils/Kconfig"
source "packages/vendor/ti/dvsdk/Kconfig"
source "packages/vendor/ti/framework-components/Kconfig"
source "packages/vendor/ti/codec-engine/Kconfig"
source "packages/vendor/ti/dmai/Kconfig"
source "packages/vendor/ti/ffmpeg-csc/Kconfig"

endmenu
```

## packages/vendor/ti/codec-engine/Kconfig
```kconfig
config PACKAGE_VENDOR_TI_CODEC_ENGINE
	bool "Codec Engine"
	select PACKAGE_VENDOR_TI_FRAMEWORK_COMPONENTS
```
