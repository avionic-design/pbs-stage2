## packages/wm/awesome/Kconfig
```kconfig
config PACKAGE_WM_AWESOME
	bool "awesome"
	select PACKAGE_BUILD_TOOLS_CMAKE
	select PACKAGE_DEVEL_LUA
	select PACKAGE_LIBS_LIBXDG_BASEDIR
	select PACKAGE_LIBS_IMLIB2
	select PACKAGE_LIBS_LIBEV
	select PACKAGE_LIBS_STARTUP_NOTIFICATION
	select PACKAGE_XORG_LIB_XCB_UTIL_IMAGE
	select PACKAGE_XORG_LIB_XCB_UTIL_WM
	select PACKAGE_XORG_LIB_XCB_UTIL_KEYSYMS
	default n
```

## packages/wm/dwm/Kconfig
```kconfig
config PACKAGE_WM_DWM
	bool "dwm"
	select PACKAGE_XORG_LIB_X11
	select PACKAGE_XORG_LIB_XFT
	select PACKAGE_XORG_LIB_XINERAMA
	help
	  dwm is a dynamic window manager for X. It is designed for easy and
	  static manipulation directly in the sourcecode.
	  Due to this different patchsets are provided for different
	  functionality.

if PACKAGE_WM_DWM

choice PACKAGE_WM_DWM_PATCHSET
	prompt "Patchset"
	default PACKAGE_WM_DWM_PATCH_REMOTE_CONTROL if PACKAGE_VENDOR_AVIONIC_DESIGN_REMOTE_CONTROL
	help
	  Select a patchset for dwm. If unsure, say 'none'.

config PACKAGE_WM_DWM_PATCH_NONE
	bool "none"
	help
	  No patchset, meaning the dwm master branch.

config PACKAGE_WM_DWM_PATCH_REMOTE_CONTROL
	bool "remote-control"
	help
	  Patchset for using dwm as window manager to run along remote-control.

endchoice

endif
```

## packages/wm/i3/Kconfig
```kconfig
config PACKAGE_WM_I3
	bool "i3"
	select PACKAGE_LIBS_YAJL
	select PACKAGE_XORG_LIB_X11
```

## packages/wm/icewm/Kconfig
```kconfig
config PACKAGE_WM_ICEWM
	bool "icewm"
	select PACKAGE_BUILD_TOOLS_AUTOCONF
	select PACKAGE_BUILD_TOOLS_AUTOMAKE
	select PACKAGE_XORG_LIB_XRANDR
```

## packages/wm/libmatchbox/Kconfig
```kconfig
config PACKAGE_WM_LIBMATCHBOX
	bool "libmatchbox"
	select PACKAGE_XORG_LIB_XFT
	default n
```

## packages/wm/matchbox/Kconfig
```kconfig
menu "matchbox"

source "packages/wm/matchbox/keyboard/Kconfig"
source "packages/wm/matchbox/libfakekey/Kconfig"
source "packages/wm/matchbox/libmatchbox/Kconfig"
source "packages/wm/matchbox/window-manager/Kconfig"

endmenu
```

## packages/wm/matchbox/keyboard/Kconfig
```kconfig
config PACKAGE_WM_MATCHBOX_KEYBOARD
	bool "keyboard"
	select PACKAGE_WM_MATCHBOX_LIBFAKEKEY
```

## packages/wm/matchbox/libfakekey/Kconfig
```kconfig
config PACKAGE_WM_MATCHBOX_LIBFAKEKEY
	bool "libfakekey"
	select PACKAGE_XORG_LIB_XTST
	select PACKAGE_WM_MATCHBOX_LIBMATCHBOX
```

## packages/wm/matchbox/libmatchbox/Kconfig
```kconfig
config PACKAGE_WM_MATCHBOX_LIBMATCHBOX
	bool "libmatchbox"
	select PACKAGE_BUILD_TOOLS_AUTOCONF
	select PACKAGE_BUILD_TOOLS_AUTOMAKE
	select PACKAGE_XORG_LIB_XFT
```

## packages/wm/matchbox/window-manager/Kconfig
```kconfig
config PACKAGE_WM_MATCHBOX_WINDOW_MANAGER
	bool "window manager"
	select PACKAGE_WM_MATCHBOX_LIBMATCHBOX
```

## packages/wm/metacity/Kconfig
```kconfig
config PACKAGE_WM_METACITY
	bool "metacity"
	select PACKAGE_LIBS_GCONF
	select PACKAGE_LIBS_LIBCANBERRA
	select PACKAGE_LIBS_PANGO
	select PACKAGE_UTIL_GNOME_DOC_UTILS
	select PACKAGE_XORG_LIB_XCOMPOSITE
```

## packages/wm/openbox/Kconfig
```kconfig
config PACKAGE_WM_OPENBOX
	bool "openbox"
	select PACKAGE_LIBS_GLIB
	select PACKAGE_LIBS_PANGO
	select PACKAGE_LIBS_IMLIB2
	select PACKAGE_LIBS_XML2
	select PACKAGE_XORG_LIBS_XCURSOR
	select PACKAGE_XORG_LIBS_XFIXES
	select PACKAGE_XORG_LIBS_SM
```

## packages/xorg/Kconfig
```kconfig
menu "X.Org - X11 Windowing System"

config XORG_IEGD
	bool

source "packages/xorg/proto/Kconfig"
source "packages/xorg/lib/Kconfig"
source "packages/xorg/driver/Kconfig"
source "packages/xorg/app/Kconfig"
source "packages/xorg/data/Kconfig"
source "packages/xorg/util/Kconfig"

source "packages/xorg/xorg-server/Kconfig"

endmenu
```

## packages/xorg/app/Kconfig
```kconfig
menu "X.Org - Applications"

source "packages/xorg/app/evtest/Kconfig"
source "packages/xorg/app/iceauth/Kconfig"
source "packages/xorg/app/setxkbmap/Kconfig"
source "packages/xorg/app/twm/Kconfig"
source "packages/xorg/app/xauth/Kconfig"
source "packages/xorg/app/xbacklight/Kconfig"
source "packages/xorg/app/xev/Kconfig"
source "packages/xorg/app/xinit/Kconfig"
source "packages/xorg/app/xinput/Kconfig"
source "packages/xorg/app/xinput-calibrator/Kconfig"
source "packages/xorg/app/xkbcomp/Kconfig"
source "packages/xorg/app/xprop/Kconfig"
source "packages/xorg/app/xrandr/Kconfig"
source "packages/xorg/app/xrdb/Kconfig"
source "packages/xorg/app/xset/Kconfig"
source "packages/xorg/app/xsetpointer/Kconfig"
source "packages/xorg/app/xsetroot/Kconfig"
source "packages/xorg/app/xterm/Kconfig"
source "packages/xorg/app/xwininfo/Kconfig"

endmenu
```

## packages/xorg/app/evtest/Kconfig
```kconfig
config PACKAGE_XORG_APP_EVTEST
	bool "evtest"
	select PACKAGE_BUILD_TOOLS_AUTOCONF
	select PACKAGE_BUILD_TOOLS_AUTOMAKE
	select PACKAGE_XORG_LIB
	help
	  evtest displays information on the input device specified on the command line, including all the events supported by the device. It then monitors the device and displays all the events layer events generated.
```

## packages/xorg/app/setxkbmap/Kconfig
```kconfig
config PACKAGE_XORG_APP_SETXKBMAP
	bool "setxkbmap"
	select PACKAGE_XORG_LIB_XKBFILE
```

## packages/xorg/app/xbacklight/Kconfig
```kconfig
config PACKAGE_XORG_APP_XBACKLIGHT
	bool "xbacklight"
	select PACKAGE_XORG_LIB_XRANDR
	default n
```

## packages/xorg/app/xinit/Kconfig
```kconfig
config PACKAGE_XORG_APP_XINIT
	bool "xinit"
	select VIRTUAL_DEVEL_LIBC
	default n
```

## packages/xorg/app/xinput-calibrator/Kconfig
```kconfig
config PACKAGE_XORG_APP_XINPUT_CALIBRATOR
	bool "xinput-calibrator"
	select PACKAGE_LIBS_GTKMM
	select PACKAGE_XORG_LIB_XI
```
