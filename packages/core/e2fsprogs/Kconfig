## packages/core/e2fsprogs/Kconfig
```kconfig
config PACKAGE_CORE_E2FSPROGS
	bool "e2fsprogs"
	select VIRTUAL_DEVEL_LIBC
	select PACKAGE_BUILD_TOOLS_AUTOCONF
	select PACKAGE_BUILD_TOOLS_AUTOMAKE
	select PACKAGE_CORE_UTIL_LINUX if !PACKAGE_CORE_E2FSPROGS_USE_INTERNAL
	help
	  The e2fsprogs package contains a number of utilities for creating,
	  checking, modifying, and correcting any inconsistencies in second,
	  third and fourth extended (ext2/ext3/ext4) filesystems.

config PACKAGE_CORE_E2FSPROGS_USE_INTERNAL
	bool "Use internal uuid implementation"
	depends on PACKAGE_CORE_E2FSPROGS
	help
	  The e2fsprogs can provide its one version of uuidd, libuuid and
	  libblkid. Which is also provided by util-linux package, to avoid
	  clashes, we should use only one.
```

## packages/core/gzip/Kconfig
```kconfig
config PACKAGE_CORE_GZIP
	bool "gzip"
	select VIRTUAL_DEVEL_LIBC
	help
	  GNU Gzip is a popular data compression program originally written by
	  Jean-loup Gailly for the GNU project.
```

## packages/core/lm-sensors/Kconfig
```kconfig
config PACKAGE_CORE_LM_SENSORS
	bool "lm-sensors"
	select VIRTUAL_DEVEL_LIBC
	default n
```

## packages/core/rsyslog/Kconfig
```kconfig
config PACKAGE_CORE_RSYSLOG
	bool "rsyslog"
	select PACKAGE_LIBS_LIBEE
	select PACKAGE_LIBS_ZLIB
	select PACKAGE_LIBS_LIBLOGGING
	select PACKAGE_LIBS_JSON_C
	select PACKAGE_CORE_UTIL_LINUX
```

## packages/core/sed/Kconfig
```kconfig
config PACKAGE_CORE_SED
	bool "sed"
	select VIRTUAL_DEVEL_LIBC
	select PACKAGE_BUILD_TOOLS_AUTOCONF
	select PACKAGE_BUILD_TOOLS_AUTOMAKE
	default n
```

## packages/core/start-stop-daemon/Kconfig
```kconfig
config PACKAGE_CORE_START_STOP_DAEMON
	bool "start-stop-daemon"
	select VIRTUAL_DEVEL_LIBC
	default n
```

## packages/core/sysklogd/Kconfig
```kconfig
config PACKAGE_CORE_SYSKLOGD
	bool "sysklogd"
	select VIRTUAL_DEVEL_LIBC
	default n
```

## packages/core/syslinux/Kconfig
```kconfig
config PACKAGE_CORE_SYSLINUX
	bool "syslinux"
	select PACKAGE_BUILD_TOOLS_NASM
	select PACKAGE_CORE_UTIL_LINUX
	depends on ARCH_X86 || ARCH_X86_64
```

## packages/core/syslog-ng/Kconfig
```kconfig
config PACKAGE_CORE_SYSLOG_NG
	bool "syslog-ng"
	select PACKAGE_LIBS_GLIB
	select PACKAGE_LIBS_EVENTLOG
	help
	  syslog-ng, as the name shows, is a syslogd replacement, but with new
	  functionality for the new generation. The original syslogd allows
	  messages only to be sorted based on priority/facility pairs; syslog-ng
	  adds the possibility to filter based on message contents using regular
	  expressions. The new configuration scheme is intuitive and powerful.
	  Forwarding logs over TCP and remembering all forwarding hops makes it
	  ideal for firewalled environments.
```

## packages/core/systemd/Kconfig
```kconfig
config PACKAGE_CORE_SYSTEMD
	bool "systemd"
	select PACKAGE_BUILD_TOOLS_GETTEXT
	select PACKAGE_BUILD_TOOLS_GPERF
	select PACKAGE_BUILD_TOOLS_LIBGCRYPT
	select PACKAGE_BUILD_TOOLS_INTLTOOL
	select PACKAGE_BUILD_TOOLS_VALA
	select PACKAGE_KERNEL_KMOD
	select PACKAGE_CORE_USBUTILS
	select PACKAGE_CORE_UTIL_LINUX
	select PACKAGE_LIBS_BOOTSTRAP_DBUS
	select PACKAGE_LIBS_GLIB if UDEV_SYSTEMD
	select PACKAGE_LIBS_LIBCAP
	select PACKAGE_LIBS_XZ
	help
	  systemd is a system and service manager for Linux, compatible with SysV and
	  LSB init scripts. systemd provides aggressive parallelization capabilities,
	  uses socket and D-Bus activation for starting services, offers on-demand
	  starting of daemons, keeps track of processes using Linux cgroups, supports
	  snapshotting and restoring of the system state, maintains mount and
	  automount points and implements an elaborate transactional dependency-based
	  service control logic. It can work as a drop-in replacement for sysvinit.

config PACKAGE_CORE_SYSTEMD_ENABLE_BINFMT
	bool "Enable binfmt support"
	depends on PACKAGE_CORE_SYSTEMD
	default y
	help
	  Enables support for automounting binfmt format handlers.
```

## packages/core/sysvinit/Kconfig
```kconfig
config PACKAGE_CORE_SYSVINIT
	bool "sysvinit"
	select VIRTUAL_DEVEL_LIBC
	default n
```

## packages/core/udev/Kconfig
```kconfig
config PACKAGE_CORE_UDEV
	bool "udev"
	select PACKAGE_BUILD_TOOLS_GPERF
	select PACKAGE_KERNEL_KMOD
	select PACKAGE_LIBS_GLIB if PACKAGE_CORE_UDEV_GLIB
	select PACKAGE_CORE_UTIL_LINUX

config PACKAGE_CORE_UDEV_GLIB
	bool "GLib binding"
	depends on PACKAGE_CORE_UDEV
```

## packages/core/upstart/Kconfig
```kconfig
config PACKAGE_CORE_UPSTART
	bool "upstart"
	select PACKAGE_BUILD_TOOLS_LIBNIH
	select PACKAGE_LIBS_DBUS
	select PACKAGE_LIBS_LIBNIH
```

## packages/core/usbutils/Kconfig
```kconfig
config PACKAGE_CORE_USBUTILS
	bool "usbutils"
	select PACKAGE_CORE_UDEV if !PACKAGE_CORE_SYSTEMD
	select PACKAGE_LIBS_LIBUSB
```

## packages/core/util-linux/Kconfig
```kconfig
config PACKAGE_CORE_UTIL_LINUX
	bool "util-linux-ng"
	select PACKAGE_BUILD_TOOLS_AUTOCONF
	select PACKAGE_BUILD_TOOLS_AUTOMAKE
	select PACKAGE_BUILD_TOOLS_GETTEXT
	select PACKAGE_LIBS_NCURSES if PACKAGE_CORE_UTIL_LINUX_NCURSES
	select PACKAGE_LIBS_PAM if PACKAGE_CORE_UTIL_LINUX_PAM

if PACKAGE_CORE_UTIL_LINUX

config PACKAGE_CORE_UTIL_LINUX_NCURSES
	bool "ncurses support"
	default y

config PACKAGE_CORE_UTIL_LINUX_PAM
	bool "PAM support"

endif
```
