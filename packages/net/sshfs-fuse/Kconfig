## packages/net/sshfs-fuse/Kconfig
```kconfig
config PACKAGE_NET_FUSE_SSHFS
	bool "sshfs-fuse"
	select PACKAGE_LIBS_FUSE
	select PACKAGE_LIBS_GLIB
	select PACKAGE_NET_OPENSSH
	default n
	help
	  This is a filesystem client based on the SSH File Transfer Protocol.
	  Since most SSH servers already support this protocol it is very easy to set
	  up: i.e. on the server side there's nothing to do.  On the client side
	  mounting the filesystem is as easy as logging into the server with ssh.
```

## packages/net/switchctrl/Kconfig
```kconfig
config PACKAGE_NET_SWITCHCTRL
	bool "switchctrl"
	select VIRTUAL_DEVEL_LIBC
	default n
```

## packages/net/tunctl/Kconfig
```kconfig
config PACKAGE_NET_TUNCTL
	bool "tunctl"
	default n
	help
	  tunctl is a tool to set up and maintain persistent TUN/TAP network
	  interfaces, enabling user applications access to the wire side of a
	  virtual nework interface. Such interfaces is useful for connecting VPN
	  software, virtualization, emulation and a number of other similar
	  applications to the network stack.
```

## packages/net/updated/Kconfig
```kconfig
config PACKAGE_NET_UPDATED
	bool "updated"
	select PACKAGE_BUILD_TOOLS_AUTOCONF
	select PACKAGE_BUILD_TOOLS_AUTOMAKE
	default n
```

## packages/net/wireless-tools/Kconfig
```kconfig
config PACKAGE_NET_WIRELESS_TOOLS
	bool "wireless-tools"
	select VIRTUAL_DEVEL_LIBC
	default n
```

## packages/net/wpa-supplicant/Kconfig
```kconfig
config PACKAGE_NET_WPA_SUPPLICANT
	bool "wpa-supplicant"
	select VIRTUAL_DEVEL_LIBC
	select PACKAGE_LIBS_OPENSSL
	select PACKAGE_LIBS_LIBNL
```

## packages/sound/Kconfig
```kconfig
menu "Sound Utilities"

config PACKAGE_SOUND_ALSA_LIB
	bool "alsa-lib"
	select VIRTUAL_DEVEL_LIBC
	default n

config PACKAGE_SOUND_ALSA_UTILS
	bool "alsa-utils"
	select VIRTUAL_DEVEL_LIBC
	default n

endmenu
```

## packages/ti/Kconfig
```kconfig
menu "TI sotfware"

source "packages/ti/xdctools/Kconfig"
source "packages/ti/xdais/Kconfig"
source "packages/ti/linuxutils/Kconfig"
source "packages/ti/dvsdk/Kconfig"
source "packages/ti/framework-components/Kconfig"
source "packages/ti/codec-engine/Kconfig"
source "packages/ti/dmai/Kconfig"
source "packages/ti/ffmpeg-csc/Kconfig"

endmenu
```

## packages/ti/codec-engine/Kconfig
```kconfig
config PACKAGE_TI_CODEC_ENGINE
	bool "Codec Engine"
	select PACKAGE_TI_FRAMEWORK_COMPONENTS
	default n
```

## packages/ti/dmai/Kconfig
```kconfig
config PACKAGE_TI_DMAI
	bool "DMAI"
	select PACKAGE_MULTIMEDIA_ALSA_CORE
	select PACKAGE_TI_CODEC_ENGINE
	select PACKAGE_TI_DVSDK
	select PACKAGE_TI_DM365_MMAP
	select PACKAGE_TI_DM365_CODECS
```

## packages/ti/dvsdk/Kconfig
```kconfig
config PACKAGE_TI_DVSDK
	bool "dvsdk"

if PACKAGE_TI_DVSDK

config PACKAGE_TI_DM365_MMAP
	bool "DM365 mmap driver"
	select VIRTUAL_KERNEL_LINUX_LIBC

config PACKAGE_TI_DM365_CODECS
	bool "DM365 codecs"

endif
```

## packages/ti/ffmpeg-csc/Kconfig
```kconfig
config PACKAGE_TI_FFMPEG_CSC
	bool "ffmpeg for CSC"
	select PACKAGE_TI_CODEC_ENGINE
	select PACKAGE_TI_DVSDK
	select PACKAGE_TI_DM365_CODECS
	select PACKAGE_TI_DM365_MMAP

config FFMPEG_CSC_BRANCH
	string "ffmpeg csc repository branch"
	default "csc"
	depends on PACKAGE_TI_FFMPEG_CSC
```

## packages/ti/framework-components/Kconfig
```kconfig
config PACKAGE_TI_FRAMEWORK_COMPONENTS
	bool "Framework Components"
	select PACKAGE_TI_XDCTOOLS
	select PACKAGE_TI_XDAIS
	select PACKAGE_TI_LINUXUTILS
```

## packages/ti/linuxutils/Kconfig
```kconfig
config PACKAGE_TI_LINUXUTILS
	bool "TI Linuxutils"
	select VIRTUAL_KERNEL_LINUX_LIBC
	default n
```

## packages/toolchain/Kconfig
```kconfig
menuconfig TOOLCHAIN
	bool "Toolchain"

if TOOLCHAIN

menu "Language support"

config TOOLCHAIN_LANG_C
	bool "C"
	default y

config TOOLCHAIN_LANG_CXX
	bool "C++"
	default y

config TOOLCHAIN_LANG_OBJC
	bool "Objective-C"
	default n

config TOOLCHAIN_LANG_OBJCXX
	bool "Objective-C++"
	default n

config TOOLCHAIN_LANG_JAVA
	bool "Java"
	default n

endmenu

source "packages/toolchain/binutils/Kconfig"
source "packages/toolchain/gcc-core/Kconfig"
source "packages/toolchain/gcc/Kconfig"
source "packages/toolchain/gdb/Kconfig"
source "packages/toolchain/glibc-cleanup/Kconfig"
source "packages/toolchain/glibc-headers/Kconfig"
source "packages/toolchain/glibc/Kconfig"
source "packages/toolchain/gmp/Kconfig"
source "packages/toolchain/linux-headers/Kconfig"
source "packages/toolchain/make/Kconfig"
source "packages/toolchain/mpc/Kconfig"
source "packages/toolchain/mpfr/Kconfig"
source "packages/toolchain/pkgconfig/Kconfig"
source "packages/toolchain/uclibc-cleanup/Kconfig"
source "packages/toolchain/uclibc-headers/Kconfig"
source "packages/toolchain/uclibc/Kconfig"

endif
```

## packages/toolchain/gcc-core/Kconfig
```kconfig
config PACKAGE_TOOLCHAIN_GCC_CORE
	bool "bootstrap GCC"
	select PACKAGE_TOOLCHAIN_BINUTILS
	select PACKAGE_TOOLCHAIN_GLIBC_HEADERS if GLIBC
	select PACKAGE_TOOLCHAIN_UCLIBC_HEADERS if UCLIBC
	select PACKAGE_TOOLCHAIN_NEWLIB_HEADERS if OS_NONE
	select PACKAGE_TOOLCHAIN_GMP
	select PACKAGE_TOOLCHAIN_MPFR
	select PACKAGE_TOOLCHAIN_MPC
	default n
```

## packages/toolchain/gcc/Kconfig
```kconfig
config PACKAGE_TOOLCHAIN_GCC
	bool "GCC"
	select PACKAGE_TOOLCHAIN_GLIBC if GLIBC
	select PACKAGE_TOOLCHAIN_UCLIBC if UCLIBC
	select PACKAGE_TOOLCHAIN_NEWLIB if OS_NONE
	default n
```
