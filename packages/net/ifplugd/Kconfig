## packages/net/ifplugd/Kconfig
```kconfig
config PACKAGE_NET_IFPLUGD
	bool "ifplugd"
	select PACKAGE_LIBS_LIBDAEMON
	default n
```

## packages/net/iperf/Kconfig
```kconfig
config PACKAGE_NET_IPERF
	bool "iperf"
	select VIRTUAL_DEVEL_LIBC
	help
	  iperf is a network bandwidth measurement tool. This selects the old
	  iperf package from the original codebase. If you do not have to
	  support legacy code, you probably want to select iperf3 instead.
```

## packages/net/iperf3/Kconfig
```kconfig
config PACKAGE_NET_IPERF3
	bool "iperf3"
	select VIRTUAL_DEVEL_LIBC
	select PACKAGE_BUILD_TOOLS_AUTOCONF
	select PACKAGE_BUILD_TOOLS_AUTOMAKE
	help
	  iperf3 is a network bandwidth measurement tool. This selects
	  the fully recoded version 3 of iperf, which is incompatible
	  with the old version 2 line.
```

## packages/net/iptables/Kconfig
```kconfig
config PACKAGE_NET_IPTABLES
	bool "iptables"
	select VIRTUAL_DEVEL_LIBC
	select PACKAGE_BUILD_TOOLS_AUTOCONF
	select PACKAGE_BUILD_TOOLS_AUTOMAKE
	select PACKAGE_BUILD_TOOLS_BISON if PACKAGE_NET_IPTABLES_NFTABLES_COMPAT
	select PACKAGE_BUILD_TOOLS_FLEX if PACKAGE_NET_IPTABLES_NFTABLES_COMPAT
	select PACKAGE_LIBS_LIBMNL if PACKAGE_NET_IPTABLES_NFTABLES_COMPAT
	select PACKAGE_LIBS_LIBNFTNL if PACKAGE_NET_IPTABLES_NFTABLES_COMPAT

if PACKAGE_NET_IPTABLES
	config PACKAGE_NET_IPTABLES_NFTABLES_COMPAT
	bool "nftables compat utilities"
	help
	  Build nftables compatibility utilities. Only really useful if
	  nftables itself will be built as well.
endif
```

## packages/net/iw/Kconfig
```kconfig
config PACKAGE_NET_IW
	bool "iw"
	select PACKAGE_LIBS_LIBNL
	help
	  iw is a new nl80211 based CLI configuration utility for wireless devices.
	  It supports almost all new drivers that have been added to the kernel recently.
```

## packages/net/lighttpd/Kconfig
```kconfig
config PACKAGE_NET_LIGHTTPD
	bool "lighttpd"
	select PACKAGE_LIBS_ZLIB
	select PACKAGE_LIBS_PCRE
```

## packages/net/lldpd/Kconfig
```kconfig
config PACKAGE_NET_LLDPD
	bool "lldpd"
	select PACKAGE_BUILD_TOOLS_AUTOCONF
	select PACKAGE_BUILD_TOOLS_AUTOMAKE
	select PACKAGE_LIBS_LIBEVENT

if PACKAGE_NET_LLDPD

config PACKAGE_NET_LLDPD_SNMP
	bool "SNMP support"
	select PACKAGE_NET_NET_SNMP

config PACKAGE_NET_LLDPD_XML
	bool "XML output support"
	select PACKAGE_LIBS_LIBXML2

endif
```

## packages/net/net-snmp/Kconfig
```kconfig
config PACKAGE_NET_NET_SNMP
	bool "net-snmp"
	select PACKAGE_BUILD_TOOLS_AUTOCONF
	select PACKAGE_BUILD_TOOLS_AUTOMAKE
	select PACKAGE_LIBS_OPENSSL
```

## packages/net/netcat/Kconfig
```kconfig
config PACKAGE_NET_NETCAT
	bool "netcat"
	select VIRTUAL_DEVEL_LIBC
	select PACKAGE_BUILD_TOOLS_AUTOCONF
	select PACKAGE_BUILD_TOOLS_AUTOMAKE
	default n
```

## packages/net/network-manager/Kconfig
```kconfig
config PACKAGE_NET_NETWORK_MANAGER
	bool "network-manager"
	select PACKAGE_CORE_UDEV
	select PACKAGE_CORE_UDEV_GLIB
	select PACKAGE_CORE_UTIL_LINUX
	select PACKAGE_LIBS_DBUS_GLIB
	select PACKAGE_LIBS_GNUTLS
	select PACKAGE_LIBS_LIBNL
	select PACKAGE_LIBS_POLKIT
	select PACKAGE_NET_WIRELESS_TOOLS
	default n
```

## packages/net/nftables/Kconfig
```kconfig
config PACKAGE_NET_NFTABLES
	bool "nftables"
	select VIRTUAL_DEVEL_LIBC
	select PACKAGE_LIBS_LIBMNL
	select PACKAGE_LIBS_LIBNFTNL
	help
	  nftables replaces the popular {ip,ip6,arp,eb}tables. This software
	  provides a new in-kernel packet classification framework that is based
	  on a network-specific Virtual Machine (VM) and a new nft userspace
	  command line tool. nftables reuses the existing Netfilter subsystems
	  such as the existing hook infrastructure, the connection tracking
	  system, NAT, userspace queueing and logging subsystem. Requires a
	  Kernel >= 3.13.
```

## packages/net/ntpd/Kconfig
```kconfig
config PACKAGE_NET_NTPD
	bool "ntpd"
	select VIRTUAL_DEVEL_LIBC
	select PACKAGE_BUILD_TOOLS_AUTOCONF
	select PACKAGE_BUILD_TOOLS_AUTOMAKE
```

## packages/net/ntpdate/Kconfig
```kconfig
config PACKAGE_NET_NTPDATE
	bool "ntpdate"
	select VIRTUAL_DEVEL_LIBC
	default n
```

## packages/net/openntpd/Kconfig
```kconfig
config PACKAGE_NET_OPENNTPD
	bool "openntpd"
	select VIRTUAL_DEVEL_LIBC
	select PACKAGE_BUILD_TOOLS_AUTOCONF
	select PACKAGE_BUILD_TOOLS_AUTOMAKE
	default n
```

## packages/net/openssh/Kconfig
```kconfig
config PACKAGE_NET_OPENSSH
	bool "OpenSSH"
	select PACKAGE_BUILD_TOOLS_AUTOCONF
	select PACKAGE_BUILD_TOOLS_AUTOMAKE
	select PACKAGE_LIBS_OPENSSL
```

## packages/net/rc/Kconfig
```kconfig
config PACKAGE_NET_RC
	bool "rc"
	select PACKAGE_BUILD_TOOLS_LIBRPC
	select PACKAGE_LIBS_LIBRPC
	select PACKAGE_LIBS_LIBGLADE
	select PACKAGE_MULTIMEDIA_LINPHONE
	select PACKAGE_MULTIMEDIA_VLC
	select PACKAGE_WEB_WEBKIT_GTK
	default n
```

## packages/net/remote-control/Kconfig
```kconfig
config PACKAGE_NET_REMOTE_CONTROL
	bool "remote-control"
	select PACKAGE_BUILD_TOOLS_LIBRPC
	select PACKAGE_BUILD_TOOLS_LIBTOOL
	select PACKAGE_LIBS_GTKOSK
	select PACKAGE_LIBS_LIBGLADE
	select PACKAGE_LIBS_LIBRPC
	select PACKAGE_LIBS_LIBSH
	select PACKAGE_LIBS_LIBSMARTCARD if PACKAGE_NET_REMOTE_CONTROL_SMARTCARD_LIBSMARTCARD
	select PACKAGE_LIBS_LIBCCID if PACKAGE_NET_REMOTE_CONTROL_SMARTCARD_LIBCCID
	select PACKAGE_LIBS_LIBMODEM if PACKAGE_NET_REMOTE_CONTROL_MODEM_LIBMODEM
	select PACKAGE_MULTIMEDIA_LINPHONE if PACKAGE_NET_REMOTE_CONTROL_VOIP_LINPHONE
	select PACKAGE_MULTIMEDIA_VLC if PACKAGE_NET_REMOTE_CONTROL_VIDEO_VLC
	select PACKAGE_MULTIMEDIA_GSTREAMER_PLUGINS_BASE if PACKAGE_NET_REMOTE_CONTROL_VIDEO_GST
	select PACKAGE_WEB_WEBKIT_GTK
	default n

choice
	prompt "Backlight Support"
	depends on PACKAGE_NET_REMOTE_CONTROL

	config PACKAGE_NET_REMOTE_CONTROL_BACKLIGHT_NONE
		bool "Not supported"

	config PACKAGE_NET_REMOTE_CONTROL_BACKLIGHT_DPMS
		bool "DPMS"

	config PACKAGE_NET_REMOTE_CONTROL_BACKLIGHT_MEDATOM
		bool "Avionic Design Medatom"

endchoice

choice
	prompt "Video Playback Support"
	depends on PACKAGE_NET_REMOTE_CONTROL

	config PACKAGE_NET_REMOTE_CONTROL_VIDEO_NONE
		bool "Not supported"

	config PACKAGE_NET_REMOTE_CONTROL_VIDEO_VLC
		bool "Use VideoLanClient"

	config PACKAGE_NET_REMOTE_CONTROL_VIDEO_GST
		bool "Use GStreamer"

endchoice

choice
	prompt "SmartCard/RFID Support"
	depends on PACKAGE_NET_REMOTE_CONTROL

	config PACKAGE_NET_REMOTE_CONTROL_SMARTCARD_NONE
		bool "Not supported"

	config PACKAGE_NET_REMOTE_CONTROL_SMARTCARD_LIBSMARTCARD
		bool "Use libsmartcard"

	config PACKAGE_NET_REMOTE_CONTROL_SMARTCARD_LIBCCID
		bool "Use libccid"
endchoice

choice
	prompt "VoIP Support"
	depends on PACKAGE_NET_REMOTE_CONTROL

	config PACKAGE_NET_REMOTE_CONTROL_VOIP_NONE
		bool "Not supported"

	config PACKAGE_NET_REMOTE_CONTROL_VOIP_LINPHONE
		bool "Use Linphone"

endchoice

choice
	prompt "Modem Support"
	depends on PACKAGE_NET_REMOTE_CONTROL

	config PACKAGE_NET_REMOTE_CONTROL_MODEM_NONE
		bool "Not supported"

	config PACKAGE_NET_REMOTE_CONTROL_MODEM_LIBMODEM
		bool "Use libmodem"

endchoice
```

## packages/net/rp-pppoe/Kconfig
```kconfig
config PACKAGE_NET_RP_PPPOE
	bool "rp-pppoe"
	select VIRTUAL_DEVEL_LIBC
	default n
```

## packages/net/rum/Kconfig
```kconfig
config PACKAGE_NET_RUM
	bool "rum"
	select PACKAGE_LIBS_JSON_GLIB
	select PACKAGE_LIBS_LIBSOUP
	select PACKAGE_LIBS_XDGMIME
	default n
```
