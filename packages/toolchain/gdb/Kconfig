## packages/toolchain/glibc-cleanup/Kconfig
```kconfig
config PACKAGE_TOOLCHAIN_GLIBC_CLEANUP
	bool "GNU C library - cleanup"
	depends on GLIBC
	select PACKAGE_TOOLCHAIN_GCC
```

## packages/toolchain/glibc-headers/Kconfig
```kconfig
config PACKAGE_TOOLCHAIN_GLIBC_HEADERS
	bool "GNU C library - headers"
	depends on GLIBC
	select PACKAGE_TOOLCHAIN_LINUX_HEADERS
	default n
```

## packages/toolchain/glibc/Kconfig
```kconfig
config PACKAGE_TOOLCHAIN_GLIBC
	bool "GNU C library"
	depends on GLIBC
	select PACKAGE_TOOLCHAIN_GCC_CORE
```

## packages/toolchain/klibc-cleanup/Kconfig
```kconfig
config PACKAGE_TOOLCHAIN_KLIBC_CLEANUP
	bool "klibc - cleanup"
	depends on KLIBC
	select PACKAGE_TOOLCHAIN_GCC
	default n
```

## packages/toolchain/klibc-headers/Kconfig
```kconfig
config PACKAGE_TOOLCHAIN_KLIBC_HEADERS
	bool "klibc - headers"
	depends on KLIBC
	select PACKAGE_TOOLCHAIN_LINUX_HEADERS
	default n
```

## packages/toolchain/klibc/Kconfig
```kconfig
config PACKAGE_TOOLCHAIN_KLIBC
	bool "klibc"
	depends on KLIBC
	select PACKAGE_TOOLCHAIN_GCC_CORE
	default n
```

## packages/toolchain/mpc/Kconfig
```kconfig
config PACKAGE_TOOLCHAIN_MPC
	bool "MPC - multiple precision complex floating-point library"
	select PACKAGE_TOOLCHAIN_GMP
	select PACKAGE_TOOLCHAIN_MPFR
	default n
```

## packages/toolchain/mpfr/Kconfig
```kconfig
config PACKAGE_TOOLCHAIN_MPFR
	bool "MPFR - multiple precision floating-point library"
	select PACKAGE_TOOLCHAIN_GMP
```

## packages/toolchain/newlib-headers/Kconfig
```kconfig
config PACKAGE_TOOLCHAIN_NEWLIB_HEADERS
	bool "newlib headers"
	depends on OS_NONE
```

## packages/toolchain/newlib/Kconfig
```kconfig
config PACKAGE_TOOLCHAIN_NEWLIB
	bool "newlib"
	depends on OS_NONE
	select PACKAGE_TOOLCHAIN_GCC_CORE
	default n
```

## packages/toolchain/uclibc-cleanup/Kconfig
```kconfig
config PACKAGE_TOOLCHAIN_UCLIBC_CLEANUP
	bool "uClibc - cleanup"
	depends on UCLIBC
	select PACKAGE_TOOLCHAIN_GCC
```

## packages/toolchain/uclibc-headers/Kconfig
```kconfig
config PACKAGE_TOOLCHAIN_UCLIBC_HEADERS
	bool "uClibc - headers"
	depends on UCLIBC
	select PACKAGE_TOOLCHAIN_LINUX_HEADERS
	default n
```

## packages/toolchain/uclibc/Kconfig
```kconfig
config PACKAGE_TOOLCHAIN_UCLIBC
	bool "uClibc"
	depends on UCLIBC
	select PACKAGE_TOOLCHAIN_GCC_CORE
	default n
```

## packages/util/Kconfig
```kconfig
menu "Miscellaneous Utilities"

source "packages/util/adak/Kconfig"
source "packages/util/c-ray/Kconfig"
source "packages/util/dfu-programmer/Kconfig"
source "packages/util/flashrom/Kconfig"
source "packages/util/flashtool/Kconfig"
source "packages/util/gnome-doc-utils/Kconfig"
source "packages/util/htop/Kconfig"
source "packages/util/i2c-tools/Kconfig"
source "packages/util/irkey/Kconfig"
source "packages/util/medatom-utils/Kconfig"
source "packages/util/mesa-demos/Kconfig"
source "packages/util/mtd-utils/Kconfig"
source "packages/util/superiotool/Kconfig"
source "packages/util/synergy/Kconfig"
source "packages/util/xpath/Kconfig"

endmenu
```
