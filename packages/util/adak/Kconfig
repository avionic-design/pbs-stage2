## packages/util/adak/Kconfig
```kconfig
config PACKAGE_UTIL_ADAK
	bool "Avionic Design Army Knife"
	select VIRTUAL_DEVEL_LIBC
	select PACKAGE_BUILD_TOOLS_AUTOCONF
	select PACKAGE_BUILD_TOOLS_AUTOMAKE
	default n
```

## packages/util/c-ray/Kconfig
```kconfig
config PACKAGE_UTIL_CRAY
	bool "c-ray"
	select VIRTUAL_DEVEL_LIBC
	help
	  Simple raytracer and CPU benchmark.
```

## packages/util/dfu-programmer/Kconfig
```kconfig
config PACKAGE_UTIL_DFU_PROGRAMMER
	bool "DFU Programmer"
	select PACKAGE_LIBS_LIBUSB
```

## packages/util/flashrom/Kconfig
```kconfig
config PACKAGE_UTIL_FLASHROM
	bool "flashrom"
	select PACKAGE_CORE_PCIUTILS
	select PACKAGE_LIBS_ZLIB
	depends on ARCH_X86 || ARCH_X86_64
	default n
```

## packages/util/flashtool/Kconfig
```kconfig
config PACKAGE_UTIL_FLASHTOOL
	bool "flashtool"
	select PACKAGE_LIBS_LIBSH
	select PACKAGE_LIBS_READLINE
	default n
```

## packages/util/gnome-doc-utils/Kconfig
```kconfig
config PACKAGE_UTIL_GNOME_DOC_UTILS
	bool "gnome-doc-utils"
	select PACKAGE_LIBS_LIBXML2
	select PACKAGE_LIBS_LIBXSLT
	default n
```

## packages/util/irkey/Kconfig
```kconfig
config PACKAGE_UTIL_IRKEY
	bool "IRKey"
	select VIRTUAL_DEVEL_LIBC
	help
	  This is a service to generate input events from a ir-remote.
```

## packages/util/medatom-utils/Kconfig
```kconfig
config PACKAGE_UTIL_MEDATOM_UTILS
	bool "Med@tom utilities"
	select PACKAGE_LIBS_CURL
	select PACKAGE_UTIL_ADAK
```

## packages/util/mesa-demos/Kconfig
```kconfig
config PACKAGE_UTIL_MESA_DEMOS
	bool "mesa-demos"
	select PACKAGE_LIBS_GLEW
	select PACKAGE_LIBS_GLU
	select PACKAGE_LIBS_FREEGLUT
```

## packages/util/mtd-utils/Kconfig
```kconfig
config PACKAGE_UTIL_MTD_UTILS
	bool "mtd-utils"
	select PACKAGE_CORE_UTIL_LINUX if !PACKAGE_UTIL_MTD_UTILS_WITHOUT_UBI
	select PACKAGE_LIBS_LZO if !PACKAGE_UTIL_MTD_UTILS_WITHOUT_LZO
	select PACKAGE_LIBS_ZLIB

if PACKAGE_UTIL_MTD_UTILS

config PACKAGE_UTIL_MTD_UTILS_WITHOUT_LZO
	bool "mtd-utils without LZO support"

config PACKAGE_UTIL_MTD_UTILS_WITHOUT_UBI
	bool "mtd-utils without UBI support"

endif
```

## packages/util/socat/Kconfig
```kconfig
config PACKAGE_UTIL_SOCAT
	bool "socat"
	help
	  socat is a relay for bidirectional data transfer between two
	  independent data channels.  Each of these data channels may be a file,
	  pipe, device (serial line etc. or a pseudo terminal), a socket (UNIX,
	  IP4, IP6 - raw, UDP, TCP), an SSL socket, proxy CONNECT connection, a
	  file descriptor (stdin etc.), the GNU line editor (readline), a
	  program, or a combination of two of these.


if PACKAGE_UTIL_SOCAT

config PACKAGE_UTIL_SOCAT_WITH_OPENSSL
	depends on PACKAGE_LIBS_OPENSSL
	bool "openssl support"
	default y

config PACKAGE_UTIL_SOCAT_WITH_READLINE
	depends on PACKAGE_LIBS_READLINE
	bool "readline support"
	default y

endif
```

## packages/util/synergy/Kconfig
```kconfig
config PACKAGE_UTIL_SYNERGY
	bool "synergy"
	select PACKAGE_BUILD_TOOLS_CMAKE
	select PACKAGE_XORG_LIB_XRANDR
	select PACKAGE_XORG_LIB_XTST
	select PACKAGE_LIBS_CURL
```

## packages/vendor/Kconfig
```kconfig
menu "Vendor-specific Utilities"

source "packages/vendor/avionic-design/Kconfig"
source "packages/vendor/nvidia/Kconfig"
source "packages/vendor/ti/Kconfig"

endmenu
```

## packages/vendor/avionic-design/Kconfig
```kconfig
menu "Avionic Design GmbH"

source "packages/vendor/avionic-design/dbus-watchdog/Kconfig"
source "packages/vendor/avionic-design/libalsaloop/Kconfig"
source "packages/vendor/avionic-design/libtnj3324/Kconfig"
source "packages/vendor/avionic-design/medcom-wide/Kconfig"
source "packages/vendor/avionic-design/ptip/Kconfig"
source "packages/vendor/avionic-design/remote-control/Kconfig"
source "packages/vendor/avionic-design/rum/Kconfig"
source "packages/vendor/avionic-design/comnet/Kconfig"

endmenu
```

## packages/vendor/avionic-design/comnet/Kconfig
```kconfig
menu "Comnet"

source "packages/vendor/avionic-design/comnet/anica/Kconfig"

endmenu
```

## packages/vendor/avionic-design/comnet/anica/Kconfig
```kconfig
menu "Comnet Anica"

source "packages/vendor/avionic-design/comnet/anica/gw_eval/Kconfig"
source "packages/vendor/avionic-design/comnet/anica/au_eval/Kconfig"

endmenu
```

## packages/vendor/avionic-design/comnet/anica/au_eval/Kconfig
```kconfig
config PACKAGE_VENDOR_AVIONIC_DESIGN_COMNET_ANICA_AU_EVAL
	bool "Comnet Anica AUM-IP Evaluation"
	select PACKAGE_VENDOR_AVIONIC_DESIGN_COMNET
	select PACKAGE_VENDOR_AVIONIC_DESIGN_COMNET_ANICA
	select PACKAGE_MULTIMEDIA_LIBEXOSIP2
	select PACKAGE_MULTIMEDIA_ORTP
	select PACKAGE_MULTIMEDIA_FFMPEG
	select PACKAGE_DEVEL_CHECK
```

## packages/vendor/avionic-design/comnet/anica/gw_eval/Kconfig
```kconfig
config PACKAGE_VENDOR_AVIONIC_DESIGN_COMNET_ANICA_GW_EVAL
	bool "Comnet Anica VoIPG Evaluation"
	select PACKAGE_VENDOR_AVIONIC_DESIGN_COMNET
	select PACKAGE_VENDOR_AVIONIC_DESIGN_COMNET_ANICA
	select PACKAGE_MULTIMEDIA_LIBEXOSIP2
	select PACKAGE_MULTIMEDIA_ORTP
	select PACKAGE_DEVEL_CHECK
```

## packages/vendor/avionic-design/dbus-watchdog/Kconfig
```kconfig
config PACKAGE_VENDOR_AVIONIC_DESIGN_DBUS_WATCHDOG
	bool "dbus-watchdog"
	select PACKAGE_LIBS_DBUS
	select PACKAGE_LIBS_LIBATOMIC
	select PACKAGE_LIBS_LIBEV
```

## packages/vendor/avionic-design/libalsaloop/Kconfig
```kconfig
config PACKAGE_VENDOR_AVIONIC_DESIGN_LIBALSALOOP
	bool "libalsaloop"
	select PACKAGE_MULTIMEDIA_ALSA_CORE
	select PACKAGE_MULTIMEDIA_LIBSAMPLERATE
	help
	  This package provides a library which wraps ALSA's loop API to
	  simplify it's usage.
```
