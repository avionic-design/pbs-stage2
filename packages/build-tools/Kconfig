## packages/build-tools/Kconfig
```kconfig
menu "Build tools"

source "packages/build-tools/autoconf/Kconfig"
source "packages/build-tools/automake/Kconfig"
source "packages/build-tools/bison/Kconfig"
source "packages/build-tools/cmake/Kconfig"
source "packages/build-tools/cpio/Kconfig"
source "packages/build-tools/dbus/Kconfig"
source "packages/build-tools/dbus-glib/Kconfig"
source "packages/build-tools/docbook-xml/Kconfig"
source "packages/build-tools/docbook-xsl/Kconfig"
source "packages/build-tools/dtc/Kconfig"
source "packages/build-tools/expat/Kconfig"
source "packages/build-tools/flex/Kconfig"
source "packages/build-tools/file/Kconfig"
source "packages/build-tools/gdk-pixbuf/Kconfig"
source "packages/build-tools/gettext/Kconfig"
source "packages/build-tools/glib/Kconfig"
source "packages/build-tools/glibc/Kconfig"
source "packages/build-tools/gperf/Kconfig"
source "packages/build-tools/gtk-doc/Kconfig"
source "packages/build-tools/icon-naming-utils/Kconfig"
source "packages/build-tools/icu/Kconfig"
source "packages/build-tools/intltool/Kconfig"
source "packages/build-tools/kmod/Kconfig"
source "packages/build-tools/libffi/Kconfig"
source "packages/build-tools/libgcrypt/Kconfig"
source "packages/build-tools/libgpg-error/Kconfig"
source "packages/build-tools/libidl/Kconfig"
source "packages/build-tools/libnih/Kconfig"
source "packages/build-tools/libpng/Kconfig"
source "packages/build-tools/librpc/Kconfig"
source "packages/build-tools/libtool/Kconfig"
source "packages/build-tools/libxml2/Kconfig"
source "packages/build-tools/libxslt/Kconfig"
source "packages/build-tools/makedepend/Kconfig"
source "packages/build-tools/orbit/Kconfig"
source "packages/build-tools/orc/Kconfig"
source "packages/build-tools/pkgconfig/Kconfig"
source "packages/build-tools/python/Kconfig"
source "packages/build-tools/python3/Kconfig"
source "packages/build-tools/ruby/Kconfig"
source "packages/build-tools/shared-mime-info/Kconfig"
source "packages/build-tools/squashfs/Kconfig"
source "packages/build-tools/texinfo/Kconfig"
source "packages/build-tools/u-boot/Kconfig"
source "packages/build-tools/vala/Kconfig"
source "packages/build-tools/wayland/Kconfig"
source "packages/build-tools/xorg/Kconfig"
source "packages/build-tools/xproto/Kconfig"
source "packages/build-tools/zlib/Kconfig"

endmenu
```

## packages/build-tools/antlr3.2/Kconfig
```kconfig
config PACKAGE_BUILD_TOOLS_ANTLR3_2
	bool "antlr3, 3.2 branch"
	select PACKAGE_BUILD_TOOLS_JAVA_STRINGTEMPLATE
	select PACKAGE_BUILD_TOOLS_JAVA_LIBANTLR
	help
	  ANTLR stands for (AN)other (T)ool for (L)anguage (R)ecognition and
	  generates LL(*) recursive-descent parsers. ANTLR is a language tool
	  that provides a framework for constructing recognizers, compilers, and
	  translators from grammatical descriptions containing actions.
```

## packages/build-tools/autoconf/Kconfig
```kconfig
config PACKAGE_BUILD_TOOLS_AUTOCONF
	bool "autoconf"
	select PACKAGE_BUILD_TOOLS_LIBTOOL
	select PACKAGE_BUILD_TOOLS_PKGCONFIG
```

## packages/build-tools/automake/Kconfig
```kconfig
config PACKAGE_BUILD_TOOLS_AUTOMAKE
	bool "automake"
	select PACKAGE_BUILD_TOOLS_AUTOCONF
```

## packages/build-tools/cpio/Kconfig
```kconfig
config PACKAGE_BUILD_TOOLS_CPIO
	bool "cpio"
	select PACKAGE_BUILD_TOOLS_GETTEXT
	help
	  GNU cpio copies files into or out of a cpio or tar archive.
	  The archive can be another file on the disk, a magnetic tape,
	  or a pipe.
```

## packages/build-tools/dbus-glib/Kconfig
```kconfig
config PACKAGE_BUILD_TOOLS_DBUS_GLIB
	bool "dbus-glib"
	select PACKAGE_BUILD_TOOLS_DBUS
	select PACKAGE_BUILD_TOOLS_GLIB
	select PACKAGE_BUILD_TOOLS_EXPAT
```

## packages/build-tools/dbus/Kconfig
```kconfig
config PACKAGE_BUILD_TOOLS_DBUS
	bool "dbus"
	select PACKAGE_BUILD_TOOLS_LIBTOOL
	select PACKAGE_BUILD_TOOLS_EXPAT
```

## packages/build-tools/docbook-xml/Kconfig
```kconfig
config PACKAGE_BUILD_TOOLS_DOCBOOK_XML
	bool "DocBook XML"
	select PACKAGE_BUILD_TOOLS_LIBXML2
	help
	  DocBook is a semantic markup language for technical documentation.
	  It was originally intended for writing technical documents related
	  to computer hardware and software but it can be used for any other
	  sort of documentation
```

## packages/build-tools/docbook-xsl/Kconfig
```kconfig
config PACKAGE_BUILD_TOOLS_DOCBOOK_XSL
	bool "DocBook XSL"
	select PACKAGE_BUILD_TOOLS_DOCBOOK_XML
	help
	  The DocBook XSL stylesheets are a set of stylesheets for use with
	  an XSLT engine (such as xsltproc or Saxon) for transforming DocBook
	  XML documents into other DocBookOutputFormats, such as HTML, PDF,
	  Microsoft HTML Help, and man pages.
```

## packages/build-tools/doxygen/Kconfig
```kconfig
config PACKAGE_BUILD_TOOLS_DOXYGEN
	bool "doxygen"
	select PACKAGE_BUILD_TOOLS_BISON
	select PACKAGE_BUILD_TOOLS_CMAKE
	select PACKAGE_BUILD_TOOLS_FLEX
	select PACKAGE_BUILD_TOOLS_PYTHON
	help
	  Doxygen is the de facto standard tool for generating documentation
	  from annotated C++ sources, but it also supports other popular
	  programming languages such as C, Objective-C, C-Sharp, PHP, Java,
	  Python, IDL (Corba, Microsoft, and UNO/OpenOffice flavors), Fortran,
	  VHDL, Tcl, and to some extent D.
```

## packages/build-tools/dtc/Kconfig
```kconfig
config PACKAGE_BUILD_TOOLS_DTC
	bool "dtc - device tree compiler"
	select PACKAGE_BUILD_TOOLS_BISON
	default n
```

## packages/build-tools/file/Kconfig
```kconfig
config PACKAGE_BUILD_TOOLS_FILE
	bool "file"
	select PACKAGE_BUILD_TOOLS_AUTOCONF
	select PACKAGE_BUILD_TOOLS_AUTOMAKE
	help
	  The file command is used to identify a particular file according to the
	  type of data contained by the file.  File can identify many different
	  file types, including ELF binaries, system libraries, RPM packages, and
	  different graphics formats.
```

## packages/build-tools/flex/Kconfig
```kconfig
config PACKAGE_BUILD_TOOLS_FLEX
	bool "flex"
	select PACKAGE_BUILD_TOOLS_AUTOMAKE
	select PACKAGE_BUILD_TOOLS_GETTEXT
```

## packages/build-tools/gdk-pixbuf/Kconfig
```kconfig
config PACKAGE_BUILD_TOOLS_GDK_PIXBUF
	bool "gdk-pixbuf"
	select PACKAGE_BUILD_TOOLS_GLIB
```

## packages/build-tools/glib/Kconfig
```kconfig
config PACKAGE_BUILD_TOOLS_GLIB
	bool "glib"
	select PACKAGE_BUILD_TOOLS_DBUS
	select PACKAGE_BUILD_TOOLS_LIBFFI
	select PACKAGE_BUILD_TOOLS_PYTHON
```

## packages/build-tools/glibc/Kconfig
```kconfig
config PACKAGE_BUILD_TOOLS_GLIBC
	bool "glibc tools"

config PACKAGE_BUILD_TOOLS_GLIBC_LOCALES
	bool "glibc locales"
	depends on PACKAGE_BUILD_TOOLS_GLIBC
	select WITH_BUILD_TOOLS_LOCALES
```

## packages/build-tools/gtk-doc/Kconfig
```kconfig
config PACKAGE_BUILD_TOOLS_GTK_DOC
	bool "gtk-doc"
	select PACKAGE_BUILD_TOOLS_LIBXSLT
	select PACKAGE_BUILD_TOOLS_DOCBOOK_XSL
	select PACKAGE_BUILD_ITSTOOL
```
