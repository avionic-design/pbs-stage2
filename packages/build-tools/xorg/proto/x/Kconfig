## packages/build-tools/xorg/proto/xcb/Kconfig
```kconfig
config PACKAGE_BUILD_TOOLS_XORG_PROTO_XCB
	bool "xcb"
	select PACKAGE_BUILD_TOOLS_PYTHON
```

## packages/build-tools/xorg/util/Kconfig
```kconfig
menu "X.Org - Utilities"

source "packages/build-tools/xorg/util/util-macros/Kconfig"

endmenu
```

## packages/build-tools/yasm/Kconfig
```kconfig
config PACKAGE_BUILD_TOOLS_YASM
	bool "yasm"
	select BUILD_TOOLS_GETTEXT
	select BUILD_TOOLS_PYTHON
	help
	  Yasm is a modular assembler and a complete rewrite of the NASM
	  assembler under the 'new' BSD License.
```

## packages/console/Kconfig
```kconfig
menu "Console Utilities"

source "packages/console/fbset/Kconfig"
source "packages/console/kbd/Kconfig"
source "packages/console/minicom/Kconfig"
source "packages/console/tmux/Kconfig"

endmenu
```

## packages/console/console-tools/Kconfig
```kconfig
config PACKAGE_CONSOLE_CONSOLE_TOOLS
	bool "console-tools"
	select VIRTUAL_DEVEL_LIBC
	default n
```

## packages/console/minicom/Kconfig
```kconfig
config PACKAGE_CONSOLE_MINICOM
	bool "minicom"
	select PACKAGE_LIBS_NCURSES
	select PACKAGE_LIBS_ICONV if !PACKAGE_DEVEL_GLIBC
	default n
```

## packages/console/tmux/Kconfig
```kconfig
config PACKAGE_CONSOLE_TMUX
	bool "tmux"
	select VIRTUAL_DEVEL_LIBC
	select PACKAGE_LIBS_LIBEVENT
	default n
	help
	  tmux is a terminal multiplexer: it enables a number of terminals (or windows),
	  each running a separate program, to be created, accessed, and controlled from
	  a single screen. tmux may be detached from a screen and continue running in
	  the background, then later reattached.
```

## packages/core/Kconfig
```kconfig
menu "Core System"

source "packages/core/acpitool/Kconfig"
source "packages/core/base-files/Kconfig"
source "packages/core/busybox/Kconfig"
source "packages/core/coreutils/Kconfig"
source "packages/core/cpufrequtils/Kconfig"
source "packages/core/diffutils/Kconfig"
source "packages/core/dmidecode/Kconfig"
source "packages/core/dpkg/Kconfig"
source "packages/core/e2fsprogs/Kconfig"
source "packages/core/grep/Kconfig"
source "packages/core/less/Kconfig"
source "packages/core/lm-sensors/Kconfig"
source "packages/core/logrotate/Kconfig"
source "packages/core/pciutils/Kconfig"
source "packages/core/procps/Kconfig"
source "packages/core/psmisc/Kconfig"
source "packages/core/rsyslog/Kconfig"
source "packages/core/sed/Kconfig"
source "packages/core/sudo/Kconfig"
source "packages/core/syslinux/Kconfig"
source "packages/core/syslog-ng/Kconfig"
source "packages/core/systemd/Kconfig"
source "packages/core/udev/Kconfig"
source "packages/core/upstart/Kconfig"
source "packages/core/upstart-init-dev/Kconfig"
source "packages/core/usbutils/Kconfig"
source "packages/core/util-linux/Kconfig"

endmenu
```

## packages/core/acpitool/Kconfig
```kconfig
config PACKAGE_CORE_ACPITOOL
	bool "acpitool"
	select VIRTUAL_DEVEL_LIBC
	select PACKAGE_BUILD_TOOLS_AUTOCONF
	select PACKAGE_BUILD_TOOLS_AUTOMAKE
	default n
```

## packages/core/busybox.git/Kconfig
```kconfig
config PACKAGE_CORE_BUSYBOX_GIT
	bool "busybox (git)"
	select VIRTUAL_DEVEL_LIBC
	default n
```

## packages/core/busybox/Kconfig
```kconfig
menuconfig PACKAGE_CORE_BUSYBOX
	bool "busybox"
	select VIRTUAL_DEVEL_LIBC

if PACKAGE_CORE_BUSYBOX

config PACKAGE_CORE_BUSYBOX_MODUTILS
	bool "modutils"
	default y if !PACKAGE_KERNEL_KMOD

config PACKAGE_CORE_BUSYBOX_BZ
	bool "bzip2"
	default y if !PACKAGE_LIBS_BZ

config PACKAGE_CORE_BUSYBOX_GZIP
	bool "gzip"
	default y if !PACKAGE_CORE_GZIP

config PACKAGE_CORE_BUSYBOX_XZ
	bool "xz"
	default y if !PACKAGE_LIBS_XZ

config PACKAGE_CORE_BUSYBOX_UTIL_LINUX
	bool "util linux"
	default y if !PACKAGE_CORE_UTIL_LINUX

config PACKAGE_CORE_BUSYBOX_COREUTILS
	bool "coreutils"
	default y if !PACKAGE_CORE_COREUTILS

config PACKAGE_CORE_BUSYBOX_PROCPS
	bool "procps"
	default y if !PACKAGE_CORE_PROCPS

config PACKAGE_CORE_BUSYBOX_PSMISC
	bool "psmisc"
	default y if !PACKAGE_CORE_PSMISC

config PACKAGE_CORE_BUSYBOX_BRIDGE_UTILS
	bool "bridge utils"
	default y if !PACKAGE_NET_BRIDGE_UTILS

config PACKAGE_CORE_BUSYBOX_NTPD
	bool "ntpd"
	default y if !PACKAGE_NET_NTPD

config PACKAGE_CORE_BUSYBOX_NET_TOOLS
	bool "net-tools"
	default y if !PACKAGE_NET_NET_TOOLS

config PACKAGE_CORE_BUSYBOX_I2C_TOOLS
	bool "i2c tools"
	default y if !PACKAGE_UTIL_I2C_TOOLS

config PACKAGE_CORE_BUSYBOX_E2FSPROGS
	bool "e2fsprogs"
	default y if !PACKAGE_CORE_E2FSPROGS

config PACKAGE_CORE_BUSYBOX_LESS
	bool "less"
	default y if !PACKAGE_CORE_LESS

endif
```

## packages/core/coreutils/Kconfig
```kconfig
config PACKAGE_CORE_COREUTILS
	bool "coreutils"
	select VIRTUAL_DEVEL_LIBC
	select PACKAGE_BUILD_TOOLS_AUTOCONF
	select PACKAGE_BUILD_TOOLS_AUTOMAKE
	select PACKAGE_BUILD_TOOLS_GETTEXT
	help
	  These are the GNU core utilities. This package is the combination of
	  the old GNU fileutils, sh-utils, and textutils packages.
```

## packages/core/cpufrequtils/Kconfig
```kconfig
config PACKAGE_CORE_CPUFREQUTILS
	bool "cpufrequtils"
	depends on ARCH_X86 || ARCH_X86_64
	select VIRTUAL_DEVEL_LIBC
```

## packages/core/diffutils/Kconfig
```kconfig
config PACKAGE_CORE_DIFFUTILS
	bool "diffutils"
	select VIRTUAL_DEVEL_LIBC
	default n
```

## packages/core/dpkg/Kconfig
```kconfig
config PACKAGE_CORE_DPKG
	bool "dpkg"
	select VIRTUAL_DEVEL_LIBC
	select PACKAGE_BUILD_TOOLS_AUTOCONF
	select PACKAGE_BUILD_TOOLS_AUTOMAKE
	default n
```
