## packages/build-tools/python/Kconfig
```kconfig
config PACKAGE_BUILD_TOOLS_PYTHON
	bool "python"
	select PACKAGE_BUILD_TOOLS_OPENSSL
	select PACKAGE_BUILD_TOOLS_EXPAT
	select PACKAGE_BUILD_TOOLS_LIBFFI
```

## packages/build-tools/python3/Kconfig
```kconfig
config PACKAGE_BUILD_TOOLS_PYTHON3
	bool "python3"
	select PACKAGE_BUILD_TOOLS_LIBFFI
```

## packages/build-tools/shared-mime-info/Kconfig
```kconfig
config PACKAGE_BUILD_TOOLS_SHARED_MIME_INFO
	bool "shared-mime-info"
	select PACKAGE_BUILD_TOOLS_LIBXML2
```

## packages/build-tools/squashfs/Kconfig
```kconfig
config PACKAGE_BUILD_TOOLS_SQUASHFS
	bool "squashfs"
	select PACKAGE_BUILD_TOOLS_ZLIB
	select PACKAGE_BUILD_TOOLS_LZO
	help
	  Squashfs is a highly compressed read-only filesystem for Linux. This package
	  contains the utilities for manipulating squashfs filesystems.
```

## packages/build-tools/systemd/Kconfig
```kconfig
config PACKAGE_BUILD_TOOLS_SYSTEMD
	bool "systemd"
	select PACKAGE_BUILD_TOOLS_GETTEXT
	select PACKAGE_BUILD_TOOLS_GPERF
	select PACKAGE_BUILD_TOOLS_INTLTOOL
	select PACKAGE_BUILD_TOOLS_LIBCAP
	select PACKAGE_BUILD_TOOLS_UTIL_LINUX
	help
	  Build tools package for systemd.
```

## packages/build-tools/u-boot/Kconfig
```kconfig
config PACKAGE_BUILD_TOOLS_UBOOT
	bool "U-Boot utilities"
	select PACKAGE_BUILD_TOOLS_DTC if PACKAGE_BUILD_TOOLS_UBOOT_FIT
	select PACKAGE_BUILD_TOOLS_OPENSSL if PACKAGE_BUILD_TOOLS_UBOOT_FIT_SIG

if PACKAGE_BUILD_TOOLS_UBOOT

config PACKAGE_BUILD_TOOLS_UBOOT_FIT
	bool "Enable FIT support"
	default y

if PACKAGE_BUILD_TOOLS_UBOOT_FIT

config PACKAGE_BUILD_TOOLS_UBOOT_FIT_SIG
	bool "Enable FIT signatures support"

endif

endif
```

## packages/build-tools/util-linux/Kconfig
```kconfig
config PACKAGE_BUILD_TOOLS_UTIL_LINUX
	bool "util-linux-ng"
	select PACKAGE_BUILD_TOOLS_GETTEXT
	help
	  Build tools util-linux, libraries only.
```

## packages/build-tools/vala/Kconfig
```kconfig
config PACKAGE_BUILD_TOOLS_VALA
	bool "vala"
	select PACKAGE_BUILD_TOOLS_FLEX
	select PACKAGE_BUILD_TOOLS_BISON
	select PACKAGE_BUILD_TOOLS_GLIB
```

## packages/build-tools/wayland/Kconfig
```kconfig
config PACKAGE_BUILD_TOOLS_WAYLAND
	select PACKAGE_BUILD_TOOLS_LIBXSLT
	bool "wayland"
```

## packages/build-tools/xmlto/Kconfig
```kconfig
config PACKAGE_BUILD_TOOLS_XMLTO
	bool "xmlto"
	select PACKAGE_BUILD_TOOLS_LIBXSLT
	help
	  xmlto is a front-end to an XSL toolchain. It chooses an appropriate
	  stylesheet for the conversion you want and applies it using an
	  external XSLT processor. It also performs any necessary
	  post-processing.
```

## packages/build-tools/xorg/Kconfig
```kconfig
menu "X.Org - X11 Windowing System"

source "packages/build-tools/xorg/app/Kconfig"
source "packages/build-tools/xorg/lib/Kconfig"
source "packages/build-tools/xorg/proto/Kconfig"
source "packages/build-tools/xorg/util/Kconfig"

endmenu
```

## packages/build-tools/xorg/app/Kconfig
```kconfig
menu "X.Org - Applications"

source "packages/build-tools/xorg/app/xkbcomp/Kconfig"

endmenu
```

## packages/build-tools/xorg/app/xkbcomp/Kconfig
```kconfig
config PACKAGE_BUILD_TOOLS_XORG_APP_XKBCOMP
	bool "xkbcomp"
	select PACKAGE_BUILD_TOOLS_XORG_LIB_XKBFILE
```

## packages/build-tools/xorg/lib/Kconfig
```kconfig
menu "X.Org - Libraries"

source "packages/build-tools/xorg/lib/pthread-stubs/Kconfig"
source "packages/build-tools/xorg/lib/x11/Kconfig"
source "packages/build-tools/xorg/lib/xau/Kconfig"
source "packages/build-tools/xorg/lib/xcb/Kconfig"
source "packages/build-tools/xorg/lib/xdmcp/Kconfig"
source "packages/build-tools/xorg/lib/xkbfile/Kconfig"
source "packages/build-tools/xorg/lib/xtrans/Kconfig"

endmenu
```

## packages/build-tools/xorg/lib/x11/Kconfig
```kconfig
config PACKAGE_BUILD_TOOLS_XORG_LIB_X11
	bool "x11"
	select PACKAGE_BUILD_TOOLS_AUTOCONF
	select PACKAGE_BUILD_TOOLS_XORG_PROTO_INPUT
	select PACKAGE_BUILD_TOOLS_XORG_PROTO_KB
	select PACKAGE_BUILD_TOOLS_XORG_PROTO_X
	select PACKAGE_BUILD_TOOLS_XORG_PROTO_XEXT
	select PACKAGE_BUILD_TOOLS_XORG_LIB_XCB
	select PACKAGE_BUILD_TOOLS_XORG_LIB_XTRANS
	select PACKAGE_BUILD_TOOLS_XORG_UTIL_UTIL_MACROS
```

## packages/build-tools/xorg/lib/xau/Kconfig
```kconfig
config PACKAGE_BUILD_TOOLS_XORG_LIB_XAU
	bool "xau"
	select PACKAGE_BUILD_TOOLS_AUTOCONF
	select PACKAGE_BUILD_TOOLS_XORG_PROTO_X
	select PACKAGE_BUILD_TOOLS_XORG_UTIL_UTIL_MACROS
```

## packages/build-tools/xorg/lib/xkbfile/Kconfig
```kconfig
config PACKAGE_BUILD_TOOLS_XORG_LIB_XKBFILE
	bool "xkbfile"
	select PACKAGE_BUILD_TOOLS_AUTOCONF
	select PACKAGE_BUILD_TOOLS_XORG_PROTO_KB
	select PACKAGE_BUILD_TOOLS_XORG_LIB_X11
```

## packages/build-tools/xorg/proto/Kconfig
```kconfig
menu "X.Org - Protocols"

source "packages/build-tools/xorg/proto/input/Kconfig"
source "packages/build-tools/xorg/proto/kb/Kconfig"
source "packages/build-tools/xorg/proto/x/Kconfig"
source "packages/build-tools/xorg/proto/xcb/Kconfig"
source "packages/build-tools/xorg/proto/xext/Kconfig"

endmenu
```
