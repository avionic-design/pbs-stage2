## packages/build-tools/java-libantlr/Kconfig
```kconfig
config PACKAGE_BUILD_TOOLS_JAVA_LIBANTLR
	bool "java-libantlr"
	help
	  ANTLR, ANother Tool for Language Recognition, is a language tool that
	  provides a framework for constructing recognizers, compilers, and
	  translators from grammatical descriptions containing C++ or Java
	  actions. This package contains the java libraries without a dependency
	  on any runtime.
```

## packages/build-tools/java-stringtemplate/Kconfig
```kconfig
config PACKAGE_BUILD_TOOLS_JAVA_STRINGTEMPLATE
	bool "java-stringtemplate"
	help
	  ST (StringTemplate) is a java template engine for generating source
	  code, web pages, emails, or any other formatted text output. ST is
	  particularly good at multi-targeted code generators, multiple site
	  skins, and internationalization/localization. ST also powers the
	  ANTLR v3 code generator.
```

## packages/build-tools/libcap/Kconfig
```kconfig
config PACKAGE_LIBS_LIBCAP
	bool "libcap"
	select PACKAGE_LIBS_ATTR
	select PACKAGE_LIBS_PAM
```

## packages/build-tools/libgcrypt/Kconfig
```kconfig
config PACKAGE_BUILD_TOOLS_LIBGCRYPT
	bool "libgcrypt"
	select PACKAGE_BUILD_TOOLS_LIBGPG_ERROR
```

## packages/build-tools/libnih/Kconfig
```kconfig
config PACKAGE_BUILD_TOOLS_LIBNIH
	bool "libnih"
	select PACKAGE_BUILD_TOOLS_DBUS
```

## packages/build-tools/librpc/Kconfig
```kconfig
config PACKAGE_BUILD_TOOLS_LIBRPC
	bool "librpc"
	select PACKAGE_BUILD_TOOLS_EXPAT
	default n
```

## packages/build-tools/libtool/Kconfig
```kconfig
config PACKAGE_BUILD_TOOLS_LIBTOOL
	bool "libtool"
	select PACKAGE_BUILD_TOOLS_AUTOMAKE
	select PACKAGE_BUILD_TOOLS_HELP2MAN
	select PACKAGE_BUILD_TOOLS_TEXINFO
```

## packages/build-tools/libxml2/Kconfig
```kconfig
config PACKAGE_BUILD_TOOLS_LIBXML2
	bool "libxml2"
	select PACKAGE_BUILD_TOOLS_AUTOCONF
	select PACKAGE_BUILD_TOOLS_PYTHON
```

## packages/build-tools/libxslt/Kconfig
```kconfig
config PACKAGE_BUILD_TOOLS_LIBXSLT
	bool "libxslt"
	select PACKAGE_BUILD_TOOLS_LIBXML2
```

## packages/build-tools/makedepend/Kconfig
```kconfig
config PACKAGE_BUILD_TOOLS_MAKEDEPEND
	bool "makedepend"
	select PACKAGE_BUILD_TOOLS_XORG_PROTO_X
```

## packages/build-tools/openssl/Kconfig
```kconfig
config PACKAGE_BUILD_TOOLS_OPENSSL
	bool "openssl"
	select PACKAGE_BUILD_TOOLS_ZLIB
```

## packages/build-tools/orbit/Kconfig
```kconfig
config PACKAGE_BUILD_TOOLS_ORBIT
	bool "orbit"
	select PACKAGE_BUILD_TOOLS_LIBIDL
```

## packages/build-tools/pkgconfig/Kconfig
```kconfig
config PACKAGE_BUILD_TOOLS_PKGCONFIG
	bool "pkgconfig"
	select PACKAGE_BUILD_TOOLS_GLIB
```
