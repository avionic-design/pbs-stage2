## packages/libs/eventlog/Kconfig
```kconfig
config PACKAGE_LIBS_EVENTLOG
	bool "eventlog"
	select VIRTUAL_DEVEL_LIBC
	help
	  The EventLog library aims to be a replacement of the simple syslog
	  API provided on UNIX systems. The major difference between EventLog
	  and syslog is that EventLog tries to add structure to messages.
	  EventLog provides an interface to build, format and output an event
	  record. The exact format and output method can be customized by the
	  administrator via a configuration file. This package is the runtime
	  part of the library.
```

## packages/libs/expat/Kconfig
```kconfig
config PACKAGE_LIBS_EXPAT
	bool "expat"
	select VIRTUAL_DEVEL_LIBC
	select PACKAGE_BUILD_TOOLS_AUTOCONF
	select PACKAGE_BUILD_TOOLS_AUTOMAKE
```

## packages/libs/fontconfig/Kconfig
```kconfig
config PACKAGE_LIBS_FONTCONFIG
	bool "fontconfig"
	select PACKAGE_LIBS_EXPAT
	select PACKAGE_LIBS_FREETYPE
```

## packages/libs/freeglut/Kconfig
```kconfig
config PACKAGE_LIBS_FREEGLUT
	bool "freeglut"
	select VIRTUAL_DEVEL_LIBC
	select PACKAGE_BUILD_TOOLS_AUTOCONF
	select PACKAGE_BUILD_TOOLS_AUTOMAKE
	select PACKAGE_LIBS_GLU
	select PACKAGE_XORG_LIB_XI

	help
	  Provides functionality for small OpenGL programs
```

## packages/libs/freetype/Kconfig
```kconfig
config PACKAGE_LIBS_FREETYPE
	bool "freetype"
	select PACKAGE_LIBS_ZLIB
	select PACKAGE_LIBS_LIBPNG
```

## packages/libs/fribidi/Kconfig
```kconfig
config PACKAGE_LIBS_FRIBIDI
	bool "fribidi"
	select VIRTUAL_DEVEL_LIBC
	select PACKAGE_BUILD_TOOLS_AUTOCONF
	select PACKAGE_BUILD_TOOLS_AUTOMAKE
	default n
```

## packages/libs/fuse/Kconfig
```kconfig
config PACKAGE_LIBS_FUSE
	bool "fuse"
	select VIRTUAL_DEVEL_LIBC
	select PACKAGE_BUILD_TOOLS_AUTOCONF
	select PACKAGE_BUILD_TOOLS_AUTOMAKE
	select PACKAGE_BUILD_TOOLS_GETTEXT
	help
	  With FUSE it is possible to implement a fully functional filesystem in a
	  userspace program.
```

## packages/libs/gconf/Kconfig
```kconfig
config PACKAGE_LIBS_GCONF
	bool "gconf"
	select PACKAGE_BUILD_TOOLS_ORBIT
	select PACKAGE_LIBS_DBUS_GLIB
	select PACKAGE_LIBS_LIBXML2
	select PACKAGE_LIBS_ORBIT
```

## packages/libs/gdk-pixbuf/Kconfig
```kconfig
config PACKAGE_LIBS_GDK_PIXBUF
	bool "gdk-pixbuf"
	select PACKAGE_BUILD_TOOLS_GDK_PIXBUF
	select PACKAGE_LIBS_GLIB
	select PACKAGE_LIBS_LIBJPEG
	select PACKAGE_LIBS_LIBPNG
```

## packages/libs/gettext/Kconfig
```kconfig
config PACKAGE_LIBS_GETTEXT
	bool "gettext"
	select PACKAGE_BUILD_TOOLS_AUTOCONF
	select PACKAGE_BUILD_TOOLS_AUTOMAKE
	select PACKAGE_DEVEL_UCLIBC_WITH_LOCALE if UCLIBC
	select PACKAGE_LIBS_ICONV if !GLIBC
	select VIRTUAL_DEVEL_LIBC if GLIBC
```

## packages/libs/gjs/Kconfig
```kconfig
config PACKAGE_LIBS_GJS
	bool "gjs"
	select PACKAGE_WEB_MOZILLA_XULRUNNER
	default n
```

## packages/libs/glew/Kconfig
```kconfig
config PACKAGE_LIBS_GLEW
	bool "glew"
	select VIRTUAL_OPENGL if HAVE_OPENGL
	select VIRTUAL_OPENGL_ES if HAVE_OPENGL_ES && !HAVE_OPENGL
	select PACKAGE_XORG_LIB_XI
	default n
```

## packages/libs/glib-networking/Kconfig
```kconfig
config PACKAGE_LIBS_GLIB_NETWORKING
	bool "glib-networking"
	select PACKAGE_BUILD_TOOLS_INTLTOOL
	select PACKAGE_LIBS_GLIB
	select PACKAGE_LIBS_GNUTLS
	select PACKAGE_LIBS_LIBGCRYPT
	help
	  This package contains modules that extend the networking support in GIO.
	  In particular, it contains libproxy- and GSettings-based GProxyResolver
	  implementations and a gnutls-based GTlsConnection implementation.
```

## packages/libs/glib/Kconfig
```kconfig
config PACKAGE_LIBS_GLIB
	bool "glib"
	select PACKAGE_BUILD_TOOLS_GLIB
	select PACKAGE_LIBS_GETTEXT
	select PACKAGE_LIBS_LIBFFI
	select PACKAGE_LIBS_ZLIB
	help
	  GLib is the low-level core library that forms the basis for projects
	  such as GTK+ and GNOME. It provides data structure handling for C,
	  portability wrappers, and interfaces for such runtime functionality
	  as an event loop, threads, dynamic loading, and an object system.
```

## packages/libs/glibmm/Kconfig
```kconfig
config PACKAGE_LIBS_GLIBMM
	bool "glibmm"
	select PACKAGE_LIBS_GLIB
	select PACKAGE_LIBS_LIBSIGCPP
	default n
```

## packages/libs/glshim/Kconfig
```kconfig
config PACKAGE_LIBS_GLSHIM
	bool "glshim"
	select PACKAGE_BUILD_TOOLS_CMAKE
	select VIRTUAL_OPENGL_ES if HAVE_OPENGL_ES && !HAVE_OPENGL
	help
	  This is a shim providing OpenGL 1.x functionality to OpenGL ES
	  accelerated cards.
```

## packages/libs/gnutls/Kconfig
```kconfig
config PACKAGE_LIBS_GNUTLS
	bool "gnutls"
	select PACKAGE_LIBS_LIBGCRYPT
	select PACKAGE_LIBS_LIBTASN1
	select PACKAGE_LIBS_P11_KIT
	select PACKAGE_LIBS_PAKCHOIS
	default n
```

## packages/libs/gtk/Kconfig
```kconfig
config PACKAGE_LIBS_GTK
	bool "gtk"
	select PACKAGE_BUILD_TOOLS_GDK_PIXBUF
	select PACKAGE_LIBS_ATK
	select PACKAGE_LIBS_GDK_PIXBUF
	select PACKAGE_LIBS_LIBJPEG
	select PACKAGE_LIBS_PANGO
	select PACKAGE_XORG_LIB_XCOMPOSITE
	select PACKAGE_XORG_LIB_XCURSOR
	select PACKAGE_XORG_LIB_XEXT
	select PACKAGE_XORG_LIB_XRANDR
	default n
```

## packages/libs/gtk3/Kconfig
```kconfig
config PACKAGE_LIBS_GTK3
	bool "gtk3 - Gtk+ 3.0"
	select PACKAGE_BUILD_TOOLS_GDK_PIXBUF
	select PACKAGE_LIBS_AT_SPI2_ATK
	select PACKAGE_LIBS_GDK_PIXBUF
	select PACKAGE_LIBS_LIBJPEG
	select PACKAGE_LIBS_PANGO
	select PACKAGE_XORG_LIB_XCOMPOSITE
	select PACKAGE_XORG_LIB_XCURSOR
	select PACKAGE_XORG_LIB_XEXT
	select PACKAGE_XORG_LIB_XRANDR
	select PACKAGE_XORG_LIB_XI
```

## packages/libs/gtkmm/Kconfig
```kconfig
config PACKAGE_LIBS_GTKMM
	bool "gtkmm"
	select PACKAGE_LIBS_GTK
	select PACKAGE_LIBS_ATKMM
	select PACKAGE_LIBS_GLIBMM
	select PACKAGE_LIBS_PANGOMM
```

## packages/libs/gtkosk/Kconfig
```kconfig
config PACKAGE_LIBS_GTKOSK
	bool "gtkosk"
	select PACKAGE_BUILD_TOOLS_GTK_DOC
	select PACKAGE_LIBS_AT_SPI2_ATK
	select VIRTUAL_LIBS_GTK
	select PACKAGE_LIBS_LIBRSVG
	select PACKAGE_XORG_LIB_XTST
```

## packages/libs/hal/Kconfig
```kconfig
config PACKAGE_LIBS_HAL
	bool "hal"
	select PACKAGE_CORE_UTIL_LINUX
	select PACKAGE_LIBS_CONSOLEKIT
	select PACKAGE_LIBS_DBUS_GLIB
	select PACKAGE_LIBS_EXPAT
	select PACKAGE_LIBS_LIBUSB_COMPAT
	default n
```
