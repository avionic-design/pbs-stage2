## packages/libs/readline/Kconfig
```kconfig
config PACKAGE_LIBS_READLINE
	bool "readline"
	select PACKAGE_LIBS_NCURSES
	default n
```

## packages/libs/sdl/Kconfig
```kconfig
menu "Simple DirectMedia Layer"

source "packages/libs/sdl/core/Kconfig"

if PACKAGE_LIBS_SDL_CORE

comment "SDL modules"
	depends on PACKAGE_LIBS_SDL_CORE

source "packages/libs/sdl/image/Kconfig"
source "packages/libs/sdl/mixer/Kconfig"

endif

endmenu
```

## packages/libs/sdl/core/Kconfig
```kconfig
config PACKAGE_LIBS_SDL_CORE
	bool "sdl"
	select PACKAGE_BUILD_TOOLS_AUTOCONF
	select PACKAGE_BUILD_TOOLS_AUTOMAKE
	select PACKAGE_XORG_LIB_XEXT
	default n
```

## packages/libs/sdl/image/Kconfig
```kconfig
config PACKAGE_LIBS_SDL_IMAGE
	bool "SDL_image"
	select PACKAGE_BUILD_TOOLS_AUTOCONF
	select PACKAGE_BUILD_TOOLS_AUTOMAKE
```

## packages/libs/sdl/mixer/Kconfig
```kconfig
config PACKAGE_LIBS_SDL_MIXER
	bool "SDL_mixer"
	select PACKAGE_BUILD_TOOLS_AUTOCONF
	select PACKAGE_BUILD_TOOLS_AUTOMAKE
	default n
```

## packages/libs/sqlite/Kconfig
```kconfig
config PACKAGE_LIBS_SQLITE
	bool "sqlite"
	select VIRTUAL_DEVEL_LIBC
	select PACKAGE_BUILD_TOOLS_AUTOCONF
	select PACKAGE_BUILD_TOOLS_AUTOMAKE
	default n
```

## packages/libs/startup-notification/Kconfig
```kconfig
config PACKAGE_LIBS_STARTUP_NOTIFICATION
	bool "startup-notification"
	select PACKAGE_XORG_LIB_XCB_UTIL
```

## packages/libs/sysfsutils/Kconfig
```kconfig
config PACKAGE_LIBS_SYSFSUTILS
	bool "sysfsutils"
	select VIRTUAL_DEVEL_LIBC
	select PACKAGE_BUILD_TOOLS_AUTOCONF
	select PACKAGE_BUILD_TOOLS_AUTOMAKE
```

## packages/libs/upower/Kconfig
```kconfig
config PACKAGE_LIBS_UPOWER
	bool "upower"
	select PACKAGE_LIBS_POLKIT
	default n
```

## packages/libs/xdgmime/Kconfig
```kconfig
config PACKAGE_LIBS_XDGMIME
	bool "xdgmime"
	select VIRTUAL_DEVEL_LIBC
	default n
```

## packages/multimedia/Kconfig
```kconfig
menu "Multimedia Tools"

source "packages/multimedia/admp.git/Kconfig"
source "packages/multimedia/alsa/Kconfig"
source "packages/multimedia/ffmpeg/Kconfig"
source "packages/multimedia/flac/Kconfig"
source "packages/multimedia/gstreamer/Kconfig"
source "packages/multimedia/libav/Kconfig"
source "packages/multimedia/libdvbpsi/Kconfig"
source "packages/multimedia/libexosip2/Kconfig"
source "packages/multimedia/libid3tag/Kconfig"
source "packages/multimedia/libmad/Kconfig"
source "packages/multimedia/libmms/Kconfig"
source "packages/multimedia/libogg/Kconfig"
source "packages/multimedia/libosip2/Kconfig"
source "packages/multimedia/libsamplerate/Kconfig"
source "packages/multimedia/libtheora/Kconfig"
source "packages/multimedia/libvorbis/Kconfig"
source "packages/multimedia/linphone/Kconfig"
source "packages/multimedia/live/Kconfig"
source "packages/multimedia/mpeg2dec/Kconfig"
source "packages/multimedia/mplayer/Kconfig"
source "packages/multimedia/ortp/Kconfig"
source "packages/multimedia/speex/Kconfig"
source "packages/multimedia/vaapi/Kconfig"
source "packages/multimedia/v4l-utils/Kconfig"
source "packages/multimedia/vlc/Kconfig"
source "packages/multimedia/zvbi/Kconfig"

endmenu
```

## packages/multimedia/admp.git/Kconfig
```kconfig
config PACKAGE_MULTIMEDIA_ADMP
	bool "admp"
	select PACKAGE_MULTIMEDIA_LIBMAD
	select PACKAGE_MULTIMEDIA_MPEG2DEC
	default n
```

## packages/multimedia/alsa/Kconfig
```kconfig
menu "ALSA - Advanced Linux Sound Architecture"

source "packages/multimedia/alsa/core/Kconfig"
source "packages/multimedia/alsa/utils/Kconfig"
source "packages/multimedia/alsa/plugins/Kconfig"

endmenu
```

## packages/multimedia/alsa/core/Kconfig
```kconfig
config PACKAGE_MULTIMEDIA_ALSA_CORE
	bool "alsa-lib"
	select VIRTUAL_DEVEL_LIBC
	select PACKAGE_BUILD_TOOLS_AUTOCONF
	select PACKAGE_BUILD_TOOLS_AUTOMAKE
	default n
```

## packages/multimedia/alsa/plugins/Kconfig
```kconfig
config PACKAGE_MULTIMEDIA_ALSA_PLUGINS
	bool "alsa-plugins"
	select PACKAGE_MULTIMEDIA_ALSA_CORE
	select PACKAGE_LIBS_PULSEAUDIO
	help
	  This package provides addidtional plugins and bindings such
	  as pulseaudio and oss.
```

## packages/multimedia/alsa/utils/Kconfig
```kconfig
config PACKAGE_MULTIMEDIA_ALSA_UTILS
	bool "alsa-utils"
	select PACKAGE_LIBS_NCURSES
	select PACKAGE_MULTIMEDIA_ALSA_CORE
```

## packages/multimedia/bcg729/Kconfig
```kconfig
config PACKAGE_MULTIMEDIA_BCG729
	bool "bcg729"
	select PACKAGE_MULTIMEDIA_LINPHONE
	help
	  Bcg729 is a software G729A encoder and decoder library written in C.
```
