## packages/libs/harfbuzz/Kconfig
```kconfig
config PACKAGE_LIBS_HARFBUZZ
	bool "harfbuzz"
	select PACKAGE_LIBS_CAIRO
	select PACKAGE_LIBS_FREETYPE
	select PACKAGE_LIBS_GLIB
```

## packages/libs/iconv/Kconfig
```kconfig
config PACKAGE_LIBS_ICONV
	bool "iconv"
	select VIRTUAL_DEVEL_LIBC
	select PACKAGE_BUILD_TOOLS_AUTOCONF
	select PACKAGE_BUILD_TOOLS_AUTOMAKE
```

## packages/libs/icu/Kconfig
```kconfig
config PACKAGE_LIBS_ICU
	bool "icu"
	select PACKAGE_BUILD_TOOLS_AUTOCONF
	select PACKAGE_BUILD_TOOLS_AUTOMAKE
	select PACKAGE_BUILD_TOOLS_ICU
	select VIRTUAL_DEVEL_LIBC
```

## packages/libs/imlib2/Kconfig
```kconfig
config PACKAGE_LIBS_IMLIB2
	bool "imlib2"
	select PACKAGE_LIBS_FREETYPE
	select PACKAGE_XORG_LIB_XEXT
```

## packages/libs/json-c/Kconfig
```kconfig
config PACKAGE_LIBS_JSON_C
	bool "json-c"
	select VIRTUAL_DEVEL_LIBC
	select PACKAGE_BUILD_TOOLS_AUTOCONF
	select PACKAGE_BUILD_TOOLS_AUTOMAKE
```

## packages/libs/json-glib/Kconfig
```kconfig
config PACKAGE_LIBS_JSON_GLIB
	bool "json-glib"
	select PACKAGE_LIBS_GLIB
	default n
```

## packages/libs/libantlr3c/Kconfig
```kconfig
config PACKAGE_LIBS_LIBANTLR3C
	bool "libantlr3, C runtime"
	select PACKAGE_BUILD_TOOLS_AUTOCONF
	select PACKAGE_BUILD_TOOLS_AUTOMAKE
	help
	  ANTLR, ANother Tool for Language Recognition, is a language tool that
	  provides a framework for constructing recognizers, compilers, and
	  translators from grammatical descriptions. This package contains the
	  development files needed to build the applications using parsers
	  generated by ANTLR in the C language.
```

## packages/libs/libarinc/Kconfig
```kconfig
config PACKAGE_LIBS_LIBARINC
	bool "libarinc"
	select VIRTUAL_DEVEL_LIBC
	default n
```

## packages/libs/libcanberra/Kconfig
```kconfig
config PACKAGE_LIBS_LIBCANBERRA
	bool "libcanberra"
	select VIRTUAL_LIBS_GTK
	select PACKAGE_LIBS_LIBTOOL
	select PACKAGE_MULTIMEDIA_LIBVORBIS
```

## packages/libs/libcroco/Kconfig
```kconfig
config PACKAGE_LIBS_LIBCROCO
	bool "libcroco"
	select PACKAGE_LIBS_GLIB
	select PACKAGE_LIBS_LIBXML2
```

## packages/libs/libdaemon/Kconfig
```kconfig
config PACKAGE_LIBS_LIBDAEMON
	bool "libdaemon"
	select VIRTUAL_DEVEL_LIBC
	default n
```

## packages/libs/libdrm-poulsbo/Kconfig
```kconfig
config PACKAGE_LIBS_LIBDRM_POULSBO
	bool "libdrm-poulsbo"
	select VIRTUAL_DEVEL_LIBC
	select PACKAGE_BUILD_TOOLS_AUTOCONF
	select PACKAGE_BUILD_TOOLS_AUTOMAKE
```

## packages/libs/libdrm/Kconfig
```kconfig
config PACKAGE_LIBS_LIBDRM
	bool "libdrm"
	select PACKAGE_XORG_LIB_PCIACCESS if ARCH_X86 || ARCH_X86_64
	select PACKAGE_XORG_LIB_PTHREAD_STUBS
```

## packages/libs/libepoxy/Kconfig
```kconfig
config PACKAGE_LIBS_LIBEPOXY
	bool "libepoxy"
	select PACKAGE_LIBS_GLSHIM if !HAVE_OPENGL
	help
	  Epoxy is a library for handling OpenGL function pointer management.
```

## packages/libs/libestr/Kconfig
```kconfig
config PACKAGE_LIBS_LIBESTR
	bool "libestr"
	select VIRTUAL_DEVEL_LIBC
	help
	  This package compiles the string handling essentials library
	  used by the Rsyslog daemon.
```

## packages/libs/libev/Kconfig
```kconfig
config PACKAGE_LIBS_LIBEV
	bool "libev"
	select VIRTUAL_DEVEL_LIBC
	help
	  High-performance event loop/event model with lots of features

	  Libev is modeled (very loosely) after libevent and the Event Perl
	  module, but is faster, scales better and is more correct, and also more
	  featureful. And also smaller.
```

## packages/libs/libevent/Kconfig
```kconfig
config PACKAGE_LIBS_LIBEVENT
	bool "libevent"
	select VIRTUAL_DEVEL_LIBC
	select PACKAGE_BUILD_TOOLS_AUTOCONF
	select PACKAGE_BUILD_TOOLS_AUTOMAKE
	help
	  The libevent API provides a mechanism to execute a callback function
	  when a specific event occurs on a file descriptor or after a timeout
	  has been reached.
	  Furthermore, libevent also support callbacks due to signals or
	  regular timeouts.
```

## packages/libs/libfastjson/Kconfig
```kconfig
config PACKAGE_LIBS_LIBFASTJSON
	bool "libfastjson"
	help
	  Having started as a fork of json-c, libfastjson strives to be a faster
	  alternative with a smaller footprint. Not compatible with json-c.
```

## packages/libs/libffi/Kconfig
```kconfig
config PACKAGE_LIBS_LIBFFI
	bool "libffi"
	select PACKAGE_BUILD_TOOLS_AUTOCONF
	select PACKAGE_BUILD_TOOLS_AUTOMAKE
	help
	  The `libffi' library provides a portable, high level programming
	  interface to various calling conventions.  This allows a programmer
	  to call any function specified by a call interface description at
	  run time.
```
