## packages/libs/at-spi2/Kconfig
```kconfig
menu "at-spi2"

source "packages/libs/at-spi2/atk/Kconfig"
source "packages/libs/at-spi2/core/Kconfig"

endmenu
```

## packages/libs/at-spi2/atk/Kconfig
```kconfig
config PACKAGE_LIBS_AT_SPI2_ATK
	bool "atk"
	select PACKAGE_LIBS_AT_SPI2_CORE
	select PACKAGE_LIBS_ATK
```

## packages/libs/atkmm/Kconfig
```kconfig
config PACKAGE_LIBS_ATKMM
	bool "atkmm"
	select PACKAGE_LIBS_ATK
	select PACKAGE_LIBS_GLIBMM
```

## packages/libs/avahi/Kconfig
```kconfig
config PACKAGE_LIBS_AVAHI
	bool "avahi"
	select PACKAGE_LIBS_EXPAT
	select PACKAGE_LIBS_LIBDAEMON
```

## packages/libs/bluez/Kconfig
```kconfig
config PACKAGE_LIBS_BLUEZ
	bool "bluez"
	select PACKAGE_LIBS_DBUS_GLIB
	select PACKAGE_LIBS_LIBICAL
```

## packages/libs/boost/Kconfig
```kconfig
config PACKAGE_LIBS_BOOST
	bool "boost"
	select PACKAGE_LIBS_BZIP2
	select PACKAGE_LIBS_EXPAT
	select PACKAGE_LIBS_ZLIB
```

## packages/libs/bootstrap-dbus/Kconfig
```kconfig
config PACKAGE_LIBS_BOOTSTRAP_DBUS
	bool "bootstrap dbus"
	select PACKAGE_LIBS_EXPAT
	select PACKAGE_XORG_LIB_X11
	---help---
	  Simple interprocess messaging system. Minimal version to break the
	  cyclic dependency between dbus and systemd.
```

## packages/libs/cairo/Kconfig
```kconfig
config PACKAGE_LIBS_CAIRO
	bool "cairo"
	select PACKAGE_LIBS_FONTCONFIG
	select PACKAGE_LIBS_LIBPNG
	select PACKAGE_LIBS_PIXMAN
	select PACKAGE_XORG_LIB_XEXT
	select PACKAGE_XORG_LIB_XRENDER
	select VIRTUAL_OPENGL_ES if HAVE_OPENGL_ES
	help
	  Cairo is a 2D graphics library designed to provide high-quality display
	  and print output.
	  Cairo is designed to produce consistent output on all output media while
	  taking advantage of display hardware acceleration when available (e.g.
	  through the X Render Extension or OpenGL).
```

## packages/libs/cairomm/Kconfig
```kconfig
config PACKAGE_LIBS_CAIROMM
	bool "cairomm"
	select PACKAGE_LIBS_CAIRO
	select PACKAGE_LIBS_LIBSIGCPP
```

## packages/libs/clutter/Kconfig
```kconfig
config PACKAGE_LIBS_CLUTTER
	bool "clutter"
	select PACKAGE_LIBS_ATK
	select PACKAGE_LIBS_CAIRO
	select PACKAGE_LIBS_PANGO
	select PACKAGE_XORG_LIB_XCOMPOSITE
	select PACKAGE_XORG_LIB_XDAMAGE
	select PACKAGE_XORG_LIB_XEXT
	select VIRTUAL_OPENGL_ES
```

## packages/libs/cogl/Kconfig
```kconfig
config PACKAGE_LIBS_COGL
	bool "cogl"
	select PACKAGE_LIBS_ATK
	select PACKAGE_LIBS_PANGO
	select PACKAGE_XORG_LIB_XCOMPOSITE
	select PACKAGE_XORG_LIB_XDAMAGE
	select PACKAGE_XORG_LIB_XEXT
	select VIRTUAL_OPENGL_ES
	help
	  Cogl is a modern 3D graphics API with associated utility APIs designed to expose the
	  features of 3D graphics hardware using a more object oriented design than OpenGL.
	  The library has primarily been driven by the practical needs of Clutter but it is not
	  tied to any one toolkit or even constrained to developing UI toolkits.
```

## packages/libs/consolekit/Kconfig
```kconfig
config PACKAGE_LIBS_CONSOLEKIT
	bool "consolekit"
	select PACKAGE_LIBS_DBUS_GLIB
```

## packages/libs/curl/Kconfig
```kconfig
config PACKAGE_LIBS_CURL
	bool "curl"
	select VIRTUAL_DEVEL_LIBC
	select PACKAGE_BUILD_TOOLS_AUTOCONF
	select PACKAGE_BUILD_TOOLS_AUTOMAKE
```

## packages/libs/dbus-glib/Kconfig
```kconfig
config PACKAGE_LIBS_DBUS_GLIB
	bool "dbus-glib"
	select PACKAGE_LIBS_DBUS
	select PACKAGE_LIBS_GLIB
	default n
```

## packages/libs/dbus/Kconfig
```kconfig
config PACKAGE_LIBS_DBUS
	bool "dbus"
	select PACKAGE_LIBS_EXPAT
	select PACKAGE_XORG_LIB_X11 if PACKAGE_LIBS_DBUS_X11
	select PACKAGE_CORE_SYSTEMD if PACKAGE_LIBS_DBUS_SYSTEMD
	---help---
	  Simple interprocess messaging system.

config PACKAGE_LIBS_DBUS_X11
	bool "X11 support"
	depends on PACKAGE_LIBS_DBUS

config PACKAGE_LIBS_DBUS_SYSTEMD
	bool "systemd support"
	depends on PACKAGE_LIBS_DBUS
```

## packages/libs/dconf/Kconfig
```kconfig
config PACKAGE_LIBS_DCONF
	bool "dconf"
	select PACKAGE_BUILD_TOOLS_VALA
	select PACKAGE_LIBS_LIBGEE
	select PACKAGE_LIBS_GTK
	default n
```

## packages/libs/directfb/Kconfig
```kconfig
config PACKAGE_LIBS_DIRECTFB
	bool "directfb"
	select VIRTUAL_DEVEL_LIBC
	default n
```

## packages/libs/e2fsprogs/Kconfig
```kconfig
config PACKAGE_LIBS_E2FSPROGS
	bool "e2fsprogs"
	select VIRTUAL_DEVEL_LIBC
	default n
```

## packages/libs/enchant/Kconfig
```kconfig
config PACKAGE_LIBS_ENCHANT
	bool "enchant"
	select VIRTUAL_DEVEL_LIBC
	select PACKAGE_BUILD_TOOLS_AUTOCONF
	select PACKAGE_BUILD_TOOLS_AUTOMAKE
	default n
```
