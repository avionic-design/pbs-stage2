## packages/libs/libgcrypt/Kconfig
```kconfig
config PACKAGE_LIBS_LIBGCRYPT
	bool "libgcrypt"
	select PACKAGE_BUILD_TOOLS_LIBGPG_ERROR
	select PACKAGE_LIBS_LIBGPG_ERROR
	help
	  Libgcrypt is a general purpose crypto library based on the code
	  used in GNU Privacy Guard.
```

## packages/libs/libglade/Kconfig
```kconfig
config PACKAGE_LIBS_LIBGLADE
	bool "libglade"
	select VIRTUAL_LIBS_GTK
	select PACKAGE_LIBS_LIBXML2
```

## packages/libs/libgpg-error/Kconfig
```kconfig
config PACKAGE_LIBS_LIBGPG_ERROR
	bool "libgpg-error"
	select VIRTUAL_DEVEL_LIBC
	select PACKAGE_BUILD_TOOLS_AUTOCONF
	select PACKAGE_BUILD_TOOLS_AUTOMAKE
	default n
```

## packages/libs/libgudev/Kconfig
```kconfig
config PACKAGE_LIBS_GUDEV
	bool "libgudev"
	select PACKAGE_BUILD_TOOLS_PKGCONFIG
	select PACKAGE_LIBS_GLIB
	select PACKAGE_CORE_UDEV if !UDEV_SYSTEMD
	help
	  This is libgudev, a library providing GObject bindings for libudev. It
	  used to be part of udev, then merged into systemd. It is now a project
	  on its own.
```

## packages/libs/libical/Kconfig
```kconfig
config PACKAGE_LIBS_LIBICAL
	bool "libical"
	select PACKAGE_BUILD_TOOLS_CMAKE
	help
	  Libical is an Open Source implementation of the iCalendar protocols
	  and protocol data units.
```

## packages/libs/libidl/Kconfig
```kconfig
config PACKAGE_LIBS_LIBIDL
	bool "libIDL"
	select VIRTUAL_DEVEL_LIBC
	select PACKAGE_BUILD_TOOLS_AUTOCONF
	select PACKAGE_BUILD_TOOLS_AUTOMAKE
```

## packages/libs/libinput/Kconfig
```kconfig
config PACKAGE_LIBS_LININPUT
	bool "libinput"
	select PACKAGE_BUILD_TOOLS_GREP
	select PACKAGE_BUILD_TOOLS_PKGCONFIG
	select PACKAGE_LIBS_LIBEVDEV
	select PACKAGE_LIBS_MTDEV
	select VIRTUAL_UDEV
	help
	  libinput is a library that handles input devices for display servers
	  and other applications that need to directly deal with input devices.
```

## packages/libs/libjpeg/Kconfig
```kconfig
config PACKAGE_LIBS_LIBJPEG
	bool "libjpeg"
	select VIRTUAL_DEVEL_LIBC
	select PACKAGE_BUILD_TOOLS_AUTOCONF
	select PACKAGE_BUILD_TOOLS_AUTOMAKE
```

## packages/libs/liblogging/Kconfig
```kconfig
config PACKAGE_LIBS_LIBLOGGING
	bool "liblogging"
	select VIRTUAL_LIBC
	select PACKAGE_CORE_SYSTEMD if PACKAGE_LIBS_LIBLOGGING_SYSTEMD

config PACKAGE_LIBS_LIBLOGGING_SYSTEMD
	bool "systemd support"
	depends on PACKAGE_LIBS_LIBLOGGING
```

## packages/libs/libmodem/Kconfig
```kconfig
config PACKAGE_LIBS_LIBMODEM
	bool "libmodem"
	select PACKAGE_LIBS_READLINE
	select PACKAGE_MULTIMEDIA_ALSA_CORE
```

## packages/libs/libnftnl/Kconfig
```kconfig
config PACKAGE_LIBS_LIBNFTNL
	bool "libnftnl"
	select VIRTUAL_DEVEL_LIBC
	select PACKAGE_BUILD_TOOLS_AUTOCONF
	select PACKAGE_BUILD_TOOLS_AUTOMAKE
	help
	  libnftnl is a userspace library providing a low-level netlink
	  programming interface (API) to the in-kernel nf_tables subsystem. The
	  library libnftnl has been previously known as libnftables. This
	  library is currently used by nftables. Requires Kernel 3.14 or higher.
```

## packages/libs/libnih/Kconfig
```kconfig
config PACKAGE_LIBS_LIBNIH
	bool "libnih"
	select PACKAGE_LIBS_DBUS
	select PACKAGE_BUILD_TOOLS_LIBNIH
```

## packages/libs/libnl/Kconfig
```kconfig
config PACKAGE_LIBS_LIBNL
	bool "libnl"
	select VIRTUAL_DEVEL_LIBC
	select PACKAGE_BUILD_TOOLS_AUTOCONF
	select PACKAGE_BUILD_TOOLS_AUTOMAKE
```

## packages/libs/libnotify/Kconfig
```kconfig
config PACKAGE_LIBS_LIBNOTIFY
	bool "libnotify"
	select PACKAGE_LIBS_DBUS_GLIB
	select PACKAGE_LIBS_GDK_PIXBUF
	default n
```

## packages/libs/libpcap/Kconfig
```kconfig
config PACKAGE_LIBS_LIBPCAP
	bool "libpcap"
	select VIRTUAL_DEVEL_LIBC
	select PACKAGE_BUILD_TOOLS_AUTOCONF
	select PACKAGE_BUILD_TOOLS_AUTOMAKE
	default n
```

## packages/libs/librsvg/Kconfig
```kconfig
config PACKAGE_LIBS_LIBRSVG
	bool "librsvg"
	select PACKAGE_LIBS_GTK
	select PACKAGE_LIBS_LIBCROCO
```

## packages/libs/libsecret/Kconfig
```kconfig
config PACKAGE_LIBS_LIBSECRET
	bool "libsecret"
	select PACKAGE_LIBS_LIBGCRYPT
	help
	  library for storing and retrieving passwords and other secrets.
```
