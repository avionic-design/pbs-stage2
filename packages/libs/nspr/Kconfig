## packages/libs/nss/Kconfig
```kconfig
config PACKAGE_LIBS_NSS
	bool "nss"
	select PACKAGE_LIBS_NSPR
	select PACKAGE_LIBS_SQLITE
	default n
```

## packages/libs/orbit/Kconfig
```kconfig
config PACKAGE_LIBS_ORBIT
	bool "ORBit"
	select PACKAGE_LIBS_GLIB
	select PACKAGE_LIBS_LIBIDL
```

## packages/libs/orc/Kconfig
```kconfig
config PACKAGE_LIBS_ORC
	bool "ORC - OIL runtime compiler"
	select VIRTUAL_DEVEL_LIBC
	select PACKAGE_BUILD_TOOLS_ORC
	default n
```

## packages/libs/p11-kit/Kconfig
```kconfig
config PACKAGE_LIBS_P11_KIT
	bool "p11-kit"
	select VIRTUAL_DEVEL_LIBC
	select PACKAGE_BUILD_TOOLS_AUTOCONF
	select PACKAGE_BUILD_TOOLS_AUTOMAKE
	default n
```

## packages/libs/pakchois/Kconfig
```kconfig
config PACKAGE_LIBS_PAKCHOIS
	bool "pakchois"
	select VIRTUAL_DEVEL_LIBC
	select PACKAGE_BUILD_TOOLS_AUTOCONF
	select PACKAGE_BUILD_TOOLS_AUTOMAKE
```

## packages/libs/pam/Kconfig
```kconfig
config PACKAGE_LIBS_PAM
	bool "pam"
	select PACKAGE_BUILD_TOOLS_FLEX
	select PACKAGE_DEVEL_FLEX
	select PACKAGE_LIBS_LIBTIRPC
	help
	  PAM (Pluggable Authentication Modules) is a system security tool
	  that allows system administrators to set authentication policy
	  without having to recompile programs that handle authentication.
```

## packages/libs/pango/Kconfig
```kconfig
config PACKAGE_LIBS_PANGO
	bool "pango"
	select PACKAGE_BUILD_TOOLS_GLIB
	select PACKAGE_LIBS_CAIRO
	select PACKAGE_XORG_LIB_XFT
	default n
```

## packages/libs/pangomm/Kconfig
```kconfig
config PACKAGE_LIBS_PANGOMM
	bool "pangomm"
	select PACKAGE_LIBS_CAIROMM
	default n
```

## packages/libs/pcre/Kconfig
```kconfig
config PACKAGE_LIBS_PCRE
	bool "pcre"
	select VIRTUAL_DEVEL_LIBC
	select PACKAGE_BUILD_TOOLS_AUTOCONF
	select PACKAGE_BUILD_TOOLS_AUTOMAKE
```

## packages/libs/pcsc/Kconfig
```kconfig
menu "PC/SC"

source "packages/libs/pcsc/lite/Kconfig"
source "packages/libs/pcsc/tools/Kconfig"
source "packages/libs/pcsc/drivers/Kconfig"

endmenu
```

## packages/libs/pcsc/drivers/Kconfig
```kconfig
menu "Drivers"

source "packages/libs/pcsc/drivers/acsccid/Kconfig"
source "packages/libs/pcsc/drivers/ccid/Kconfig"
source "packages/libs/pcsc/drivers/ifdokrfid/Kconfig"
source "packages/libs/pcsc/drivers/scmccid/Kconfig"

endmenu
```

## packages/libs/pcsc/drivers/acsccid/Kconfig
```kconfig
config PACKAGE_LIBS_PCSC_DRIVERS_ACSCCID
	bool "ACS USB CCID Driver"
	select PACKAGE_LIBS_PCSC_LITE
```

## packages/libs/pcsc/drivers/ccid/Kconfig
```kconfig
config PACKAGE_LIBS_PCSC_DRIVERS_CCID
	bool "Generic USB CCID and ICCD PC/SC Lite Driver"
	select PACKAGE_LIBS_PCSC_LITE
```

## packages/libs/pcsc/drivers/ifdokrfid/Kconfig
```kconfig
config PACKAGE_LIBS_PCSC_DRIVERS_IFDOKRFID
	bool "OmniKey RFID PC/SC Lite Driver"
	select PACKAGE_LIBS_PCSC_LITE
	default n
```

## packages/libs/pcsc/drivers/scmccid/Kconfig
```kconfig
config PACKAGE_LIBS_PCSC_DRIVERS_SCMCCID
	bool "SCM USB CCID Driver"
	select PACKAGE_LIBS_PCSC_LITE
```

## packages/libs/pcsc/lite/Kconfig
```kconfig
config PACKAGE_LIBS_PCSC_LITE
	bool "PC/SC Lite"
	select VIRTUAL_DEVEL_LIBC
	select PACKAGE_BUILD_TOOLS_AUTOCONF
	select PACKAGE_BUILD_TOOLS_AUTOMAKE
	select PACKAGE_LIBS_LIBUSB_COMPAT if !PACKAGE_LIBS_PCSC_LITE_HAL
	default n

config PACKAGE_LIBS_PCSC_LITE_HAL
	bool "HAL support"
	depends on PACKAGE_LIBS_PCSC_LITE
	select PACKAGE_LIBS_HAL
	default n
```

## packages/libs/pcsc/tools/Kconfig
```kconfig
config PACKAGE_LIBS_PCSC_TOOLS
	bool "PC/SC Tools"
	select PACKAGE_LIBS_PCSC_LITE
	default n
```

## packages/libs/polkit/Kconfig
```kconfig
config PACKAGE_LIBS_POLKIT
	bool "polkit"
	select PACKAGE_BUILD_TOOLS_INTLTOOL
	select PACKAGE_LIBS_GLIB
	select PACKAGE_LIBS_PAM
	default n
```

## packages/libs/poppler/Kconfig
```kconfig
config PACKAGE_LIBS_POPPLER
	bool "poppler"
	select PACKAGE_LIBS_CAIRO
	select PACKAGE_LIBS_CURL
	select PACKAGE_LIBS_FONTCONFIG
	select PACKAGE_LIBS_GLIB
	select PACKAGE_LIBS_LIBPNG
```

## packages/libs/pulseaudio/Kconfig
```kconfig
config PACKAGE_LIBS_PULSEAUDIO
	bool "pulseaudio"
	select PACKAGE_LIBS_JSON_C
	select PACKAGE_LIBS_LIBSNDFILE
	select PACKAGE_LIBS_LIBTOOL
	select PACKAGE_MULTIMEDIA_SPEEX
```
