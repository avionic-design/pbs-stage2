## packages/libs/libsigc++/Kconfig
```kconfig
config PACKAGE_LIBS_LIBSIGCPP
	bool "libsigc++"
	select VIRTUAL_DEVEL_LIBC
	select PACKAGE_BUILD_TOOLS_AUTOCONF
	select PACKAGE_BUILD_TOOLS_AUTOMAKE
```

## packages/libs/libsmartcard/Kconfig
```kconfig
config PACKAGE_LIBS_LIBSMARTCARD
	bool "libsmartcard"
	select PACKAGE_LIBS_READLINE
	select PACKAGE_LIBS_LIBSH
	default n
```

## packages/libs/libsndfile/Kconfig
```kconfig
config PACKAGE_LIBS_LIBSNDFILE
	bool "libsndfile"
	select VIRTUAL_DEVEL_LIBC
	default n
```

## packages/libs/libsodium/Kconfig
```kconfig
config PACKAGE_LIBS_LIBSODIUM
	bool "libsodium"
	select VIRTUAL_DEVEL_LIBC
	help
	  Sodium is a modern, easy-to-use software library for encryption,
	  decryption, signatures, password hashing and more. It is a portable,
	  cross-compilable, installable, packageable fork of NaCl, with a
	  compatible API, and an extended API to improve usability even further.
	  Its goal is to provide all of the core operations needed to build
	  higher-level cryptographic tools.
```

## packages/libs/libsoup-git/Kconfig
```kconfig
config PACKAGE_LIBS_LIBSOUP_GIT
	bool "libsoup (git)"
	select PACKAGE_LIBS_GNUTLS
	default n
```

## packages/libs/libsoup/Kconfig
```kconfig
config PACKAGE_LIBS_LIBSOUP
	bool "libsoup"
	select PACKAGE_LIBS_GLIB_NETWORKING
	select PACKAGE_LIBS_LIBXML2
	select PACKAGE_LIBS_SQLITE
	help
	  Libsoup is an HTTP library implementation in C. It was originally part
	  of a SOAP (Simple Object Access Protocol) implementation called Soup, but
	  the SOAP and non-SOAP parts have now been split into separate packages.

	  libsoup uses the Glib main loop and is designed to work well with GTK
	  applications. This enables GNOME applications to access HTTP servers
	  on the network in a completely asynchronous fashion, very similar to
	  the Gtk+ programming model (a synchronous operation mode is also
	  supported for those who want it).
```

## packages/libs/libtasn1/Kconfig
```kconfig
config PACKAGE_LIBS_LIBTASN1
	bool "libtasn1"
	select VIRTUAL_DEVEL_LIBC
	default n
```

## packages/libs/libtool/Kconfig
```kconfig
config PACKAGE_LIBS_LIBTOOL
	bool "libtool"
	select VIRTUAL_DEVEL_LIBC
	default n
```

## packages/libs/liburi/Kconfig
```kconfig
config PACKAGE_LIBS_LIBURI
	bool "liburi"
	select VIRTUAL_DEVEL_LIBC
	select PACKAGE_BUILD_TOOLS_AUTOCONF
	select PACKAGE_BUILD_TOOLS_AUTOMAKE
	default n
```

## packages/libs/libusb-compat/Kconfig
```kconfig
config PACKAGE_LIBS_LIBUSB_COMPAT
	bool "libusb-compat"
	select PACKAGE_LIBS_LIBUSB
```

## packages/libs/libusb/Kconfig
```kconfig
config PACKAGE_LIBS_LIBUSB
	bool "libusb"
	select VIRTUAL_DEVEL_LIBC
	select PACKAGE_BUILD_TOOLS_AUTOCONF
	select PACKAGE_BUILD_TOOLS_AUTOMAKE
	default n
```

## packages/libs/libwebp/Kconfig
```kconfig
config PACKAGE_LIBS_LIBWEBP
	bool "libwebp"
	select PACKAGE_LIBS_LIBPNG
	select PACKAGE_LIBS_LIBJPEG
	help
	  Full C-sources for building the WebP reference encoder and decoder.
```

## packages/libs/libwnck/Kconfig
```kconfig
config PACKAGE_LIBS_LIBWNCK
	bool "libwnck"
	select PACKAGE_LIBS_STARTUP_NOTIFICATION
	select PACKAGE_XORG_LIB_XRES
```

## packages/libs/libxdg-basedir/Kconfig
```kconfig
config PACKAGE_LIBS_LIBXDG_BASEDIR
	bool "libxdg-basedir"
	select VIRTUAL_DEVEL_LIBC
	select PACKAGE_BUILD_TOOLS_AUTOCONF
	select PACKAGE_BUILD_TOOLS_AUTOMAKE
```

## packages/libs/libxkbcommon/Kconfig
```kconfig
config PACKAGE_LIBS_LIBXKBCOMMON
	bool "libxkbcommon"
	select VIRTUAL_DEVEL_LIBC
```

## packages/libs/libxml2/Kconfig
```kconfig
config PACKAGE_LIBS_LIBXML2
	bool "libxml2"
	select VIRTUAL_DEVEL_LIBC
	select PACKAGE_BUILD_TOOLS_AUTOCONF
	select PACKAGE_BUILD_TOOLS_AUTOMAKE
```

## packages/libs/lirc/Kconfig
```kconfig
config PACKAGE_LIBS_LIRC
	bool "lirc"
	select VIRTUAL_DEVEL_LIBC
	select PACKAGE_BUILD_TOOLS_PKGCONFIG
	select PACKAGE_BUILD_TOOLS_LIBXSLT
```

## packages/libs/lzo/Kconfig
```kconfig
config PACKAGE_LIBS_LZO
	bool "lzo"
	select VIRTUAL_DEVEL_LIBC
	select PACKAGE_BUILD_TOOLS_AUTOCONF
	select PACKAGE_BUILD_TOOLS_AUTOMAKE
```

## packages/libs/mesa/Kconfig
```kconfig
menuconfig PACKAGE_LIBS_MESA
	bool "mesa"
	select PACKAGE_BUILD_TOOLS_LIBXML2
	select PACKAGE_BUILD_TOOLS_MAKEDEPEND
	select PACKAGE_LIBS_EXPAT
	select PACKAGE_LIBS_LIBDRM
	select PACKAGE_LIBS_TALLOC
	select PACKAGE_XORG_PROTO_DRI2
	select PACKAGE_XORG_PROTO_DRI3
	select PACKAGE_XORG_PROTO_GL
	select PACKAGE_XORG_LIB_XDAMAGE
	select PACKAGE_XORG_LIB_XSHMFENCE
	select PACKAGE_XORG_LIB_XT
	select PACKAGE_XORG_LIB_XXF86VM

if PACKAGE_LIBS_MESA

comment "DRI drivers"

config PACKAGE_LIBS_MESA_DRI_I810
	bool "i810"

config PACKAGE_LIBS_MESA_DRI_I915
	bool "i915"

config PACKAGE_LIBS_MESA_DRI_I965
	bool "i965"

config PACKAGE_LIBS_MESA_DRI_MACH64
	bool "mach64"

config PACKAGE_LIBS_MESA_DRI_R128
	bool "r128"

config PACKAGE_LIBS_MESA_DRI_R200
	bool "r200"

config PACKAGE_LIBS_MESA_DRI_R300
	bool "r300"

config PACKAGE_LIBS_MESA_DRI_R600
	bool "r600"

config PACKAGE_LIBS_MESA_DRI_RADEON
	bool "radeon"

config PACKAGE_LIBS_MESA_DRI_SAVAGE
	bool "savage"

config PACKAGE_LIBS_MESA_DRI_SIS
	bool "sis"

config PACKAGE_LIBS_MESA_DRI_TDFX
	bool "tdfx"

config PACKAGE_LIBS_MESA_DRI_UNICHROME
	bool "unichrome"

config PACKAGE_LIBS_MESA_DRI_FFB
	bool "ffb"

comment "Optional Features"

config PACKAGE_LIBS_MESA_WAYLAND
	bool "wayland support"
	select PACKAGE_BUILD_TOOLS_WAYLAND
	select PACKAGE_DESKTOP_WAYLAND_WAYLAND

config PACKAGE_LIBS_MESA_GBM
	bool "gbm"

endif
```

## packages/libs/mtdev/Kconfig
```kconfig
config PACKAGE_LIBS_MTDEV
	bool "mtdev"
	select VIRTUAL_DEVEL_LIBC
	select PACKAGE_BUILD_TOOLS_AUTOCONF
	select PACKAGE_BUILD_TOOLS_AUTOMAKE
```

## packages/libs/ncurses/Kconfig
```kconfig
config PACKAGE_LIBS_NCURSES
	bool "ncurses"
	select VIRTUAL_DEVEL_LIBC

if PACKAGE_LIBS_NCURSES

config PACKAGE_LIBS_NCURSES_WIDECHAR
	bool "wide character (unicode) support"
	default y
	help
	  Build ncurses with wide character support. The resulting ncursesw also
	  works for ASCII only, but linking with -lncursesw instead of -lncurses
	  is mandatory.

endif
```

## packages/libs/neon/Kconfig
```kconfig
config PACKAGE_LIBS_NEON
	bool "neon"
	select PACKAGE_LIBS_GNUTLS
	select PACKAGE_LIBS_LIBXML2
	select PACKAGE_LIBS_EXPAT
	select PACKAGE_LIBS_ZLIB
	help
	  neon is an HTTP and WebDAV client library, with a C interface;
	  providing a high-level interface to HTTP and WebDAV methods along
	  with a low-level interface for HTTP request handling.
	  neon supports persistent connections, proxy servers, basic, digest
	  and Kerberos authentication, and has complete SSL support.
```
