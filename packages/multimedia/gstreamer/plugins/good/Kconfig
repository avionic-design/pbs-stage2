## packages/multimedia/gstreamer/plugins/good/Kconfig
```kconfig
config PACKAGE_MULTIMEDIA_GSTREAMER_PLUGINS_GOOD
	bool "good"
	select PACKAGE_MULTIMEDIA_GSTREAMER_PLUGINS_BASE
	help
	  GStreamer Good Plugins is a collection of well-supported plugins of
	  good quality and under the LGPL license.
```

## packages/multimedia/gstreamer/plugins/libav/Kconfig
```kconfig
config PACKAGE_MULTIMEDIA_GSTREAMER_PLUGINS_LIBAV
	bool "libav"
	select PACKAGE_MULTIMEDIA_GSTREAMER_PLUGINS_BASE
	select VIRTUAL_LIBAV
	help
	  This package provides libav-based GStreamer plug-ins.
```

## packages/multimedia/gstreamer/plugins/ugly/Kconfig
```kconfig
config PACKAGE_MULTIMEDIA_GSTREAMER_PLUGINS_UGLY
	bool "ugly"
	select PACKAGE_MULTIMEDIA_GSTREAMER_CORE
	select PACKAGE_MULTIMEDIA_LIBID3TAG
	select PACKAGE_MULTIMEDIA_LIBMAD
	select PACKAGE_MULTIMEDIA_MPEG2DEC
	help
	  This package contains well-written plug-ins that can't be shipped in
	  gstreamer-plugins-good because:
	   - the license is not LGPL
	   - the license of the library is not LGPL
	   - there are possible licensing issues with the code.
```

## packages/multimedia/gstreamer/plugins/v4l2/Kconfig
```kconfig
config PACKAGE_MULTIMEDIA_GSTREAMER_PLUGINS_V4L2
	bool "v4l2"
	select PACKAGE_MULTIMEDIA_GSTREAMER_PLUGINS_BASE
```

## packages/multimedia/libav/Kconfig
```kconfig
config PACKAGE_MULTIMEDIA_LIBAV
	bool "libav"
	select VIRTUAL_DEVEL_LIBC
	help
	  Libav, a fork of FFmpeg, is a friendly and community-driven effort to
	  provide its users with a set of portable, functional and
	  high-performance libraries for dealing with multimedia formats of all
	  sorts.

config PACKAGE_MULTIMEDIA_LIBAV_AVPLAY
	bool "avplay"
	depends on PACKAGE_MULTIMEDIA_LIBAV
	select PACKAGE_LIBS_SDL_CORE
	help
	  avplay is a very simple and portable media player using the Libav
	  libraries and the SDL library. It is mostly used as a testbed for the
	  various Libav APIs.
```

## packages/multimedia/libdvbpsi/Kconfig
```kconfig
config PACKAGE_MULTIMEDIA_LIBDVBPSI
	bool "libdvbpsi"
	select VIRTUAL_DEVEL_LIBC
	select PACKAGE_BUILD_TOOLS_AUTOCONF
	select PACKAGE_BUILD_TOOLS_AUTOMAKE
	default n
```

## packages/multimedia/libexosip2/Kconfig
```kconfig
config PACKAGE_MULTIMEDIA_LIBEXOSIP2
	bool "libeXosip2"
	select PACKAGE_MULTIMEDIA_LIBOSIP2
	default n
```

## packages/multimedia/libid3tag/Kconfig
```kconfig
config PACKAGE_MULTIMEDIA_LIBID3TAG
	bool "libid3tag"
	select PACKAGE_BUILD_TOOLS_AUTOCONF
	select PACKAGE_BUILD_TOOLS_AUTOMAKE
	select PACKAGE_LIBS_ZLIB
	default n
```

## packages/multimedia/libmad/Kconfig
```kconfig
config PACKAGE_MULTIMEDIA_LIBMAD
	bool "libmad"
	select VIRTUAL_DEVEL_LIBC
	select PACKAGE_BUILD_TOOLS_AUTOCONF
	select PACKAGE_BUILD_TOOLS_AUTOMAKE
	default n
```

## packages/multimedia/libmms/Kconfig
```kconfig
config PACKAGE_MULTIMEDIA_LIBMMS
	bool "libmms"
	select PACKAGE_LIBS_GLIB
	help
	  libmms is a library for downloading (streaming) media files using the
	  mmst and mmsh protocols.
```

## packages/multimedia/libogg/Kconfig
```kconfig
config PACKAGE_MULTIMEDIA_LIBOGG
	bool "libogg"
	select VIRTUAL_DEVEL_LIBC
	select PACKAGE_BUILD_TOOLS_AUTOCONF
	select PACKAGE_BUILD_TOOLS_AUTOMAKE
```

## packages/multimedia/libosip2/Kconfig
```kconfig
config PACKAGE_MULTIMEDIA_LIBOSIP2
	bool "libosip2"
	select VIRTUAL_DEVEL_LIBC
	select PACKAGE_BUILD_TOOLS_AUTOCONF
	select PACKAGE_BUILD_TOOLS_AUTOMAKE
	default n
```

## packages/multimedia/libsamplerate/Kconfig
```kconfig
config PACKAGE_MULTIMEDIA_LIBSAMPLERATE
	bool "libsamplerate"
	select VIRTUAL_DEVEL_LIBC
	select PACKAGE_BUILD_TOOLS_AUTOCONF
	select PACKAGE_BUILD_TOOLS_AUTOMAKE
```

## packages/multimedia/libtheora/Kconfig
```kconfig
config PACKAGE_MULTIMEDIA_LIBTHEORA
	bool "libtheora"
	select PACKAGE_MULTIMEDIA_LIBOGG
	default n
```

## packages/multimedia/libtremor/Kconfig
```kconfig
config PACKAGE_MULTIMEDIA_LIBTREMOR
	bool "libtremor"
	select PACKAGES_MULTIMEDIA_LIBOGG
	help
	  The Tremor reference decoder provides an integer-only implementation
	  of the decoder for embedded devices.
```

## packages/multimedia/libvorbis/Kconfig
```kconfig
config PACKAGE_MULTIMEDIA_LIBVORBIS
	bool "libvorbis"
	select PACKAGE_MULTIMEDIA_LIBOGG
```

## packages/multimedia/linphone/Kconfig
```kconfig
config PACKAGE_MULTIMEDIA_LINPHONE
	bool "linphone"
	select PACKAGE_BUILD_TOOLS_INTLTOOL
	select PACKAGE_BUILD_TOOLS_GETTEXT
	select PACKAGE_LIBS_LIBGLADE if LINPHONE_GTK
	select PACKAGE_LIBS_READLINE
	select PACKAGE_MULTIMEDIA_ALSA_CORE
	select PACKAGE_MULTIMEDIA_LIBEXOSIP2
	select PACKAGE_MULTIMEDIA_ORTP

if PACKAGE_MULTIMEDIA_LINPHONE

config PACKAGE_MULTIMEDIA_LINPHONE_GTK
	bool "GTK support"

config PACKAGE_MULTIMEDIA_LINPHONE_SPEEX
	bool "speex support"
	select PACKAGE_MULTIMEDIA_SPEEX

endif
```

## packages/multimedia/live/Kconfig
```kconfig
config PACKAGE_MULTIMEDIA_LIVE
	bool "liveMedia"
	select VIRTUAL_DEVEL_LIBC
	default n
```

## packages/multimedia/mediastreamer/Kconfig
```kconfig
config PACKAGE_MULTIMEDIA_MEDIASTREAMER
	bool "mediastreamer"
	select VIRTUAL_DEVEL_LIBC
	select PACKAGE_BUILD_TOOLS_AUTOCONF
	select PACKAGE_BUILD_TOOLS_AUTOMAKE
	select PACKAGE_MULTIMEDIA_ORTP
	help
	  Mediastreamer is a GPL licensed library to make audio and video
	  real-time streaming and processing. Written in pure C, it is based
	  upon the ortp library.

if PACKAGE_MULTIMEDIA_MEDIASTREAMER

config PACKAGE_MULTIMEDIA_MEDIASTREAMER_SPEEX
	bool "speex support"
	select PACKAGE_MULTIMEDIA_SPEEX

endif
```

## packages/multimedia/mpeg2dec/Kconfig
```kconfig
config PACKAGE_MULTIMEDIA_MPEG2DEC
	bool "mpeg2dec"
	select VIRTUAL_DEVEL_LIBC
	select PACKAGE_BUILD_TOOLS_AUTOCONF
	select PACKAGE_BUILD_TOOLS_AUTOMAKE
	default n
```

## packages/multimedia/mplayer/Kconfig
```kconfig
config PACKAGE_MULTIMEDIA_MPLAYER
	bool "mplayer"
	select PACKAGE_XORG_LIB_XVMC
	default n
```

## packages/multimedia/opengles2/Kconfig
```kconfig
config PACKAGE_MULTIMEDIA_OPENGLES2_BINARY
	bool "opengles2 binaries"
	default n
	help
	  Header and binaries to build gles2 apps.
```

## packages/multimedia/ortp/Kconfig
```kconfig
config PACKAGE_MULTIMEDIA_ORTP
	bool "ortp"
	select VIRTUAL_DEVEL_LIBC
	select PACKAGE_BUILD_TOOLS_AUTOCONF
	select PACKAGE_BUILD_TOOLS_AUTOMAKE
	default n
```

## packages/multimedia/speex/Kconfig
```kconfig
config PACKAGE_MULTIMEDIA_SPEEX
	bool "speex"
	select PACKAGE_MULTIMEDIA_LIBOGG
	default n
```
