## packages/multimedia/belle-sip/Kconfig
```kconfig
config PACKAGE_MULTIMEDIA_BELLE_SIP
	bool "belle-sip"
	select VIRTUAL_DEVEL_LIBC
	select PACKAGE_BUILD_TOOLS_ANTLR3_2
	select PACKAGE_BUILD_TOOLS_INTLTOOL
	select PACKAGE_BUILD_TOOLS_LIBTOOL
	select PACKAGE_LIBS_LIBANTLR3C
	help
	  Belle-sip is a SIP (RFC3261) implementation written in C, with an
	  object oriented API.
```

## packages/multimedia/ffmpeg/Kconfig
```kconfig
config PACKAGE_MULTIMEDIA_FFMPEG
	bool "ffmpeg"
	select VIRTUAL_DEVEL_LIBC
	help
	  FFmpeg is the leading multimedia framework, able to decode, encode,
	  transcode, mux, demux, stream, filter and play pretty much anything
	  that humans and machines have created. It supports the most obscure
	  ancient formats up to the cutting edge.

if PACKAGE_MULTIMEDIA_FFMPEG

config PACKAGE_MULTIMEDIA_FFMPEG_VAAPI
	bool "VA-API support"
	select PACKAGE_MULTIMEDIA_VAAPI_LIBVA
	help
	  Enables support for the Video Acceleration API, providing access to
	  hardware acceleration if the driver supports it.

config PACKAGE_MULTIMEDIA_FFMPEG_FFPLAY
	bool "ffplay"
	select PACKAGE_LIBS_SDL_CORE
	help
	  FFplay is a very simple and portable media player using the FFmpeg
	  libraries and the SDL library. It is mostly used as a testbed for the
	  various FFmpeg APIs.

endif
```

## packages/multimedia/flac/Kconfig
```kconfig
config PACKAGE_MULTIMEDIA_FLAC
	bool "flac"
	select VIRTUAL_DEVEL_LIBC
	select PACKAGE_BUILD_TOOLS_AUTOCONF
	select PACKAGE_BUILD_TOOLS_AUTOMAKE
```

## packages/multimedia/glmark2/Kconfig
```kconfig
config PACKAGE_MULTIMEDIA_GLMARK2
	bool "glmark2"
	select PACKAGE_BUILD_TOOLS_PYTHON
	select PACKAGE_LIBS_LIBPNG
	select VIRTUAL_OPENGL_ES2
	help
	  glmark2 is a benchmark for OpenGL (ES) 2.0. It uses only the subset
	  of the OpenGL 2.0 API that is compatible with OpenGL ES 2.0.
```

## packages/multimedia/gstreamer-0.10/Kconfig
```kconfig
menu "gstreamer-0.10"

source "packages/multimedia/gstreamer-0.10/core/Kconfig"
source "packages/multimedia/gstreamer-0.10/plugins/Kconfig"

if PACKAGE_MULTIMEDIA_GSTREAMER_0_10_CORE

config PACKAGE_MULTIMEDIA_GSTREAMER_0_10_DEBUG
	bool "keep debugsymbols"
	help
	  Do not strip gstreamer files.

endif

endmenu
```

## packages/multimedia/gstreamer-0.10/core/Kconfig
```kconfig
config PACKAGE_MULTIMEDIA_GSTREAMER_0_10_CORE
	bool "core"
	select PACKAGE_LIBS_GLIB
	select PACKAGE_LIBS_LIBXML2
	help
	  core library and elements.
```

## packages/multimedia/gstreamer-0.10/plugins/Kconfig
```kconfig
menu "gstreamer-0.10 - Plugins"

source "packages/multimedia/gstreamer-0.10/plugins/base/Kconfig"
source "packages/multimedia/gstreamer-0.10/plugins/good/Kconfig"
source "packages/multimedia/gstreamer-0.10/plugins/bad/Kconfig"
source "packages/multimedia/gstreamer-0.10/plugins/ugly/Kconfig"
source "packages/multimedia/gstreamer-0.10/plugins/v4l2/Kconfig"
source "packages/multimedia/gstreamer-0.10/plugins/ffmpeg/Kconfig"
source "packages/multimedia/gstreamer-0.10/plugins/gl/Kconfig"
source "packages/multimedia/gstreamer-0.10/plugins/gles/Kconfig"
source "packages/multimedia/gstreamer-0.10/plugins/omx/Kconfig"

endmenu
```

## packages/multimedia/gstreamer-0.10/plugins/bad/Kconfig
```kconfig
config PACKAGE_MULTIMEDIA_GSTREAMER_0_10_PLUGINS_BAD
	bool "bad"
	select PACKAGE_MULTIMEDIA_GSTREAMER_0_10_CORE
	select PACKAGE_MULTIMEDIA_GSTREAMER_0_10_PLUGINS_FFMPEG
	help
	  A set of plug-ins that need more quality, testing or documentation.
```

## packages/multimedia/gstreamer-0.10/plugins/base/Kconfig
```kconfig
config PACKAGE_MULTIMEDIA_GSTREAMER_0_10_PLUGINS_BASE
	bool "base"
	select PACKAGE_MULTIMEDIA_GSTREAMER_0_10_CORE
	select PACKAGE_MULTIMEDIA_ALSA_CORE
	select PACKAGE_LIBS_LIBOIL
	select STABLE_ABI
	help
	  An essential exemplary set of elements.
```

## packages/multimedia/gstreamer-0.10/plugins/ffmpeg/Kconfig
```kconfig
config PACKAGE_MULTIMEDIA_GSTREAMER_0_10_PLUGINS_FFMPEG
	bool "ffmpeg"
	select PACKAGE_LIBS_ORC if PACKAGE_MULTIMEDIA_GSTREAMER_0_10_PLUGINS_FFMPEG_ORC
	select PACKAGE_MULTIMEDIA_GSTREAMER_0_10_CORE
	select PACKAGE_MULTIMEDIA_GSTREAMER_0_10_PLUGINS_BASE
	select VIRTUAL_LIBAV

config PACKAGE_MULTIMEDIA_GSTREAMER_0_10_PLUGINS_FFMPEG_ORC
	bool "ORC support"
	depends on PACKAGE_MULTIMEDIA_GSTREAMER_0_10_PLUGINS_FFMPEG
```

## packages/multimedia/gstreamer-0.10/plugins/gl/Kconfig
```kconfig
config PACKAGE_MULTIMEDIA_GSTREAMER_0_10_PLUGINS_GL
	bool "gl"
	select PACKAGE_MULTIMEDIA_GSTREAMER_0_10_CORE
	select PACKAGE_LIBS_GLEW if HAVE_OPENGL
	select VIRTUAL_OPENGL_ES if HAVE_OPENGL_ES
	help
	  This module contains integration libraries and plug-ins for using OpenGL within GStreamer pipelines.
```

## packages/multimedia/gstreamer-0.10/plugins/gles/Kconfig
```kconfig
config PACKAGE_MULTIMEDIA_GSTREAMER_0_10_PLUGINS_GLES
	bool "gles"
	select PACKAGE_MULTIMEDIA_GSTREAMER_0_10_CORE
	select VIRTUAL_OPENGL_ES
	help
	  This module contains integration libraries and plug-ins for using
	  OpenGL ES within GStreamer pipelines.
```

## packages/multimedia/gstreamer-0.10/plugins/good/Kconfig
```kconfig
config PACKAGE_MULTIMEDIA_GSTREAMER_0_10_PLUGINS_GOOD
	bool "good"
	select PACKAGE_MULTIMEDIA_GSTREAMER_0_10_CORE
	help
	  A set of good-quality plug-ins under our preferred license, LGPL.
```

## packages/multimedia/gstreamer-0.10/plugins/nvxvimagesink/Kconfig
```kconfig
config PACKAGE_MULTIMEDIA_GSTREAMER_0_10_PLUGINS_NVXVIMAGESINK
	bool "nvxvimakesink"
	select PACKAGE_MULTIMEDIA_GSTREAMER_0_10_BASE
	select PACKAGE_XORG_LIB_XV
	help
	  NVidias omx videosink, derived from xvimagesink.
```

## packages/multimedia/gstreamer-0.10/plugins/omx/Kconfig
```kconfig
config PACKAGE_MULTIMEDIA_GSTREAMER_0_10_PLUGINS_OMX
	bool "omx"
	select PACKAGE_MULTIMEDIA_GSTREAMER_0_10_CORE
	select PACKAGE_VENDOR_NVIDIA_TEGRA2_OPENGLES if ARCH_TEGRA_2x_SOC
	help
	  gst-openmax is a GStreamer plug-in that allows communication with OpenMAX IL components.
	  OpenMAX IL is an industry standard that provides an abstraction layer for computer
	  graphics, video, and sound routines.
```

## packages/multimedia/gstreamer-0.10/plugins/ugly/Kconfig
```kconfig
config PACKAGE_MULTIMEDIA_GSTREAMER_0_10_PLUGINS_UGLY
	bool "ugly"
	select PACKAGE_MULTIMEDIA_GSTREAMER_0_10_PLUGINS_BASE
	select PACKAGE_MULTIMEDIA_LIBID3TAG
	select PACKAGE_MULTIMEDIA_LIBMAD
	select PACKAGE_MULTIMEDIA_MPEG2DEC
	help
	  A set of good-quality plug-ins that might pose distribution problems.
```

## packages/multimedia/gstreamer-0.10/plugins/v4l2/Kconfig
```kconfig
config PACKAGE_MULTIMEDIA_GSTREAMER_0_10_PLUGINS_V4L2
	bool "v4l2"
	select PACKAGE_MULTIMEDIA_GSTREAMER_0_10_PLUGINS_BASE
```

## packages/multimedia/gstreamer/Kconfig
```kconfig
menu "gstreamer"

source "packages/multimedia/gstreamer/core/Kconfig"
source "packages/multimedia/gstreamer/plugins/Kconfig"

if PACKAGE_MULTIMEDIA_GSTREAMER_CORE

config PACKAGE_MULTIMEDIA_GSTREAMER_DISABLE_ORC
	bool "disable ORC support"
	help
	  Orc is a library and set of tools for compiling and executing very
	  simple programs that operate on arrays of data.  The "language" is
	  a generic assembly language that represents many of the features
	  available in SIMD architectures, including saturated addition and
	  subtraction, and many arithmetic operations.

config PACKAGE_MULTIMEDIA_GSTREAMER_DISABLE_RARE
	bool "disable rare plugins"
	help
	  Disable all plugins we normaly not use.

config PACKAGE_MULTIMEDIA_GSTREAMER_DEBUG
	bool "keep debugsymbols"
	help
	  Do not strip gstreamer files.

endif

endmenu
```

## packages/multimedia/gstreamer/core/Kconfig
```kconfig
config PACKAGE_MULTIMEDIA_GSTREAMER_CORE
	bool "core"
	select PACKAGE_BUILD_TOOLS_GTK_DOC
	select PACKAGE_LIBS_GLIB
	select PACKAGE_LIBS_LIBXML2
```

## packages/multimedia/gstreamer/plugins/Kconfig
```kconfig
menu "gstreamer - Plugins"

source "packages/multimedia/gstreamer/plugins/base/Kconfig"
source "packages/multimedia/gstreamer/plugins/good/Kconfig"
source "packages/multimedia/gstreamer/plugins/bad/Kconfig"
source "packages/multimedia/gstreamer/plugins/ugly/Kconfig"
source "packages/multimedia/gstreamer/plugins/v4l2/Kconfig"
source "packages/multimedia/gstreamer/plugins/ffmpeg/Kconfig"
source "packages/multimedia/gstreamer/plugins/libav/Kconfig"
source "packages/multimedia/gstreamer/plugins/gles/Kconfig"
source "packages/multimedia/gstreamer/plugins/omx/Kconfig"

endmenu
```

## packages/multimedia/gstreamer/plugins/bad/Kconfig
```kconfig
config PACKAGE_MULTIMEDIA_GSTREAMER_PLUGINS_BAD
	bool "bad"
	select PACKAGE_MULTIMEDIA_GSTREAMER_PLUGINS_LIBAV
	help
	  This package contains plug-ins that aren't tested well enough, or the code
	  is not of good enough quality.
```

## packages/multimedia/gstreamer/plugins/base/Kconfig
```kconfig
config PACKAGE_MULTIMEDIA_GSTREAMER_PLUGINS_BASE
	bool "base"
	select PACKAGE_MULTIMEDIA_GSTREAMER_CORE
	select PACKAGE_MULTIMEDIA_ALSA_CORE
	select PACKAGE_LIBS_LIBOIL
	select PACKAGE_LIBS_ORC if !PACKAGE_MULTIMEDIA_GSTREAMER_DISABLE_ORC
	help
	  This package contains a set of well-maintained base plug-ins.
```

## packages/multimedia/gstreamer/plugins/ffmpeg/Kconfig
```kconfig
config PACKAGE_MULTIMEDIA_GSTREAMER_PLUGINS_FFMPEG
	bool "ffmpeg"
	select PACKAGE_LIBS_ORC if PACKAGE_MULTIMEDIA_GSTREAMER_PLUGINS_FFMPEG_ORC
	select PACKAGE_MULTIMEDIA_GSTREAMER_CORE
	select PACKAGE_MULTIMEDIA_GSTREAMER_PLUGINS_BASE
	select PACKAGE_MULTIMEDIA_FFMPEG
	default n

config PACKAGE_MULTIMEDIA_GSTREAMER_PLUGINS_FFMPEG_ORC
	bool "ORC support"
	depends on PACKAGE_MULTIMEDIA_GSTREAMER_PLUGINS_FFMPEG
	default n
```

## packages/multimedia/gstreamer/plugins/gl/Kconfig
```kconfig
config PACKAGE_MULTIMEDIA_GSTREAMER_PLUGINS_GL
	bool "gl"
	select PACKAGE_MULTIMEDIA_GSTREAMER_CORE
	select PACKAGE_LIBS_GLEW if HAVE_OPENGL
	select VIRTUAL_OPENGL_ES if HAVE_OPENGL_ES
	default n
	help
	  This module contains integration libraries and plug-ins for using OpenGL within GStreamer pipelines.
```

## packages/multimedia/gstreamer/plugins/gles/Kconfig
```kconfig
config PACKAGE_MULTIMEDIA_GSTREAMER_PLUGINS_GLES
	bool "gles"
	select PACKAGE_MULTIMEDIA_GSTREAMER_CORE
	select VIRTUAL_OPENGL_ES
	default n
	help
	  This module contains integration libraries and plug-ins for using
	  OpenGL ES within GStreamer pipelines.
```
