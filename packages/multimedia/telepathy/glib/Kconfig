## packages/multimedia/telepathy/glib/Kconfig
```kconfig
config PACKAGE_MULTIMEDIA_TELEPATHY_GLIB
	bool "telepathy-glib"
	select PACKAGE_LIBS_GLIB
```

## packages/multimedia/v4l-utils/Kconfig
```kconfig
config PACKAGE_MULTIMEDIA_V4L_UTILS
	bool "v4l-utils"
	select VIRTUAL_DEVEL_LIBC
	select PACKAGE_LIBS_LIBJPEG
```

## packages/multimedia/vaapi/Kconfig
```kconfig
menu "Video Acceleration (VA) API"

source "packages/multimedia/vaapi/libva/Kconfig"
source "packages/multimedia/vaapi/libva-drv-intel/Kconfig"
source "packages/multimedia/vaapi/libva-drv-vdpau/Kconfig"

endmenu
```

## packages/multimedia/vaapi/libva-drv-intel/Kconfig
```kconfig
config PACKAGE_MULTIMEDIA_VAAPI_LIBVA_INTEL
	bool "libva-driver-intel"
	select PACKAGE_MULTIMEDIA_VAAPI_LIBVA
	help
	  HW video decode support for Intel integrated graphics.
```

## packages/multimedia/vaapi/libva-drv-vdpau/Kconfig
```kconfig
config PACKAGE_MULTIMEDIA_VAAPI_LIBVA_VDPAU
	bool "libva-driver-vdpau"
	select PACKAGE_MULTIMEDIA_VAAPI_LIBVA
	help
	  HW video decode support for VDPAU platforms.
```

## packages/multimedia/vaapi/libva/Kconfig
```kconfig
config PACKAGE_MULTIMEDIA_VAAPI_LIBVA
	bool "libva"
	select PACKAGE_LIBS_LIBDRM
	help
	  Libva is a library providing the VA API video acceleration API.
```

## packages/multimedia/vlc-plugin-gles2/Kconfig
```kconfig
config PACKAGE_MULTIMEDIA_VLC_PLUGIN_GLES2
	bool "vlc-plugin-gles2"
	select PACKAGE_MULTIMEDIA_VLC
	select VIRTUAL_OPENGL_ES2
	help
	  OpenGL ES2 Video Output plugin with linear deinterlacing.
```

## packages/multimedia/vlc/Kconfig
```kconfig
config PACKAGE_MULTIMEDIA_VLC
	bool "vlc"
	select PACKAGE_LIBS_DBUS
	select PACKAGE_LIBS_FRIBIDI
	select PACKAGE_LIBS_ICONV if !GLIBC
	select VIRTUAL_LIBS_GTK
	select PACKAGE_MULTIMEDIA_ALSA_CORE
	select PACKAGE_MULTIMEDIA_LIBDVBPSI
	select PACKAGE_MULTIMEDIA_LIBMAD
	select PACKAGE_MULTIMEDIA_LIBSAMPLERATE
	select PACKAGE_MULTIMEDIA_LIVE
	select PACKAGE_MULTIMEDIA_V4L_UTILS
	select PACKAGE_MULTIMEDIA_ZVBI if PACKAGE_MULTIMEDIA_VLC_TELETEXT
	select PACKAGE_XORG_LIB_XCB_UTIL_KEYSYMS
	select VIRTUAL_LIBAV
	select VIRTUAL_OPENGL if HAVE_OPENGL
	select VIRTUAL_OPENGL_ES if HAVE_OPENGL_ES

if PACKAGE_MULTIMEDIA_VLC

config PACKAGE_MULTIMEDIA_VLC_VLC2X
	bool "vlc 2.x"
	default y if PACKAGE_VENDOR_NVIDIA_TEGRA2_L4T
	help
	  Build VLC 2 instead of 3. More suitable for T20 targets but also
	  requires legacy versions of libdvbpsi and libav, which in turn are
	  incompatible to gstreamer-1.

config PACKAGE_MULTIMEDIA_VLC_TELETEXT
	bool "teletext support"

config PACKAGE_MULTIMEDIA_VLC_VAAPI
	bool "VA-API support"
	select PACKAGE_MULTIMEDIA_FFMPEG
	select PACKAGE_MULTIMEDIA_FFMPEG_VAAPI

endif
```

## packages/multimedia/wscan/Kconfig
```kconfig
config PACKAGE_MULTIMEDIA_WSCAN
	bool "wscan"
	help
	  Universal ATSC and DVB blind scanner
```

## packages/multimedia/zvbi/Kconfig
```kconfig
config PACKAGE_MULTIMEDIA_ZVBI
	bool "zvbi"
	select VIRTUAL_DEVEL_LIBC
	select PACKAGE_XORG_LIB_X11
```

## packages/net/Kconfig
```kconfig
menu "Networking"

source "packages/net/bind-libs/Kconfig"
source "packages/net/cifs-utils/Kconfig"
source "packages/net/ddip/Kconfig"
source "packages/net/dhcpcd/Kconfig"
source "packages/net/dnsmasq/Kconfig"
source "packages/net/dropbear/Kconfig"
source "packages/net/etherdump/Kconfig"
source "packages/net/ethtool/Kconfig"
source "packages/net/hostapd/Kconfig"
source "packages/net/iflinkd/Kconfig"
source "packages/net/ifplugd/Kconfig"
source "packages/net/iperf/Kconfig"
source "packages/net/iputils/Kconfig"
source "packages/net/isc-dhcp/Kconfig"
source "packages/net/iw/Kconfig"
source "packages/net/lighttpd/Kconfig"
source "packages/net/lldpd/Kconfig"
source "packages/net/netcat/Kconfig"
source "packages/net/net-snmp/Kconfig"
source "packages/net/net-tools/Kconfig"
source "packages/net/ntpd/Kconfig"
source "packages/net/openntpd/Kconfig"
source "packages/net/openssh/Kconfig"
source "packages/net/ppp/Kconfig"
source "packages/net/remote-control/Kconfig"
source "packages/net/rum/Kconfig"
source "packages/net/sshfs-fuse/Kconfig"
source "packages/net/tcpdump/Kconfig"
source "packages/net/updated/Kconfig"
source "packages/net/wireless-tools/Kconfig"
source "packages/net/wpa-supplicant/Kconfig"

endmenu
```

## packages/net/bind-libs/Kconfig
```kconfig
config PACKAGE_NET_BIND_LIBS
	bool "bind-libs"
	select VIRTUAL_DEVEL_LIBC
	select PACKAGE_BUILD_TOOLS_AUTOCONF
	select PACKAGE_BUILD_TOOLS_AUTOMAKE
	default n
```

## packages/net/bridge-utils/Kconfig
```kconfig
config PACKAGE_NET_BRIDGE_UTILS
	bool "bridge-utils"
	select VIRTUAL_DEVEL_LIBC
	select PACKAGE_BUILD_TOOLS_AUTOCONF
	select PACKAGE_BUILD_TOOLS_AUTOMAKE
```

## packages/net/ca-certificates/Kconfig
```kconfig
config PACKAGE_NET_CA_CERTIFICATES
	bool "ca-certificates"
	select PACKAGE_BUILD_TOOLS_AUTOMAKE
	select PACKAGE_LIBS_OPENSSL
	help
	  This packages contains trusted CA Certificate signatures needed to
	  check authenticity of SSL/TLS connections. Contains CAs trusted by
	  Mozilla and Debian.
```

## packages/net/dnsmasq/Kconfig
```kconfig
config PACKAGE_NET_DNSMASQ
	bool "dnsmasq"
	select VIRTUAL_DEVEL_LIBC
	default n
```

## packages/net/dropbear/Kconfig
```kconfig
config PACKAGE_NET_DROPBEAR
	bool "dropbear"
	select VIRTUAL_DEVEL_LIBC
	select PACKAGE_BUILD_TOOLS_AUTOCONF
	select PACKAGE_BUILD_TOOLS_AUTOMAKE
	default n
```

## packages/net/ebtables/Kconfig
```kconfig
config PACKAGE_NET_EBTABLES
	bool "ebtables"
	help
	  The ebtables program is a filtering tool for a Linux-based bridging firewall.
```

## packages/net/etherdump/Kconfig
```kconfig
config PACKAGE_NET_ETHERDUMP
	bool "etherdump"
	default n
	help
	  etherdump is an extremely small packet sniffer. It can be used to dump raw
	  ethernet frames for parsing (optimally with Ethereal's text2pcap), or for
	  viewing the network traffic of a few common TCP/IP protocols. On a uClibc
	  system a dynamically-linked version is about 8kB and a statically linked
	  version is about 30kB because it does not depend on libpcap.
```

## packages/net/ethtool/Kconfig
```kconfig
config PACKAGE_NET_ETHTOOL
	bool "ethtool"
	select VIRTUAL_DEVEL_LIBC
	default n
```

## packages/net/hostapd/Kconfig
```kconfig
config PACKAGE_NET_HOSTAPD
	bool "hostapd"
	select PACKAGE_LIBS_LIBNL_1
	help
	  hostapd is a user space daemon for access point and authentication servers.
	  It implements IEEE 802.11 access point management, IEEE 802.1X/WPA/WPA2/EAP
	  Authenticators, RADIUS client, EAP server, and RADIUS authentication server.
```

## packages/net/iflinkd/Kconfig
```kconfig
config PACKAGE_NET_IFLINKD
	bool "iflinkd"
	select PACKAGE_LIBS_LIBNL
	select PACKAGE_BUILD_TOOLS_DOCBOOK_XSL
```
