## packages/devel/uclibc/Kconfig
```kconfig
if UCLIBC

config PACKAGE_DEVEL_UCLIBC
	bool
	select VIRTUAL_KERNEL_LINUX_LIBC
	select PACKAGE_DEVEL_GCC_LIBS
	select STABLE_ABI

config LIBC
	string
	default "uclibc"

if PACKAGE_DEVEL_UCLIBC
config PACKAGE_DEVEL_UCLIBC_WITH_LOCALE
	bool "uclibc with locale support"

if !PACKAGE_DEVEL_UCLIBC_WITH_LOCALE
config PACKAGE_DEVEL_UCLIBC_WITH_ICONV
	bool "uclibc with iconv support"
endif
endif
endif
```

## packages/devel/valgrind/Kconfig
```kconfig
config PACKAGE_DEVEL_VALGRIND
	bool "valgrind"
	select VIRTUAL_DEVEL_LIBC
	depends on ARCH_X86 || ARCH_X86_64 || ARCH_POWERPC || ARCH_MIPS || ARCH_ARM_ARCH_V7
```

## packages/disk/Kconfig
```kconfig
menu "Disk Utilities"

config PACKAGE_DISK_MTD_TOOLS
	bool "mtd-tools"
	select VIRTUAL_DEVEL_LIBC
	default n

endmenu
```

## packages/editors/Kconfig
```kconfig
menu "Editors"

source "packages/editors/nano/Kconfig"
source "packages/editors/vim/Kconfig"

endmenu
```

## packages/editors/nano/Kconfig
```kconfig
config PACKAGE_EDITORS_NANO
	bool "nano"
	select PACKAGE_LIBS_NCURSES
	help
	  GNU nano - an enhanced clone of the Pico text editor.
```

## packages/editors/vim/Kconfig
```kconfig
config PACKAGE_EDITORS_VIM
	bool "vim"
	select VIRTUAL_DEVEL_LIBC
	select PACKAGE_LIBS_NCURSES
```

## packages/fonts/Kconfig
```kconfig
menu "Fonts"

source "packages/fonts/ttf-arphic-uming/Kconfig"
source "packages/fonts/ttf-bitstream-vera/Kconfig"
source "packages/fonts/ttf-freefont/Kconfig"
source "packages/fonts/ttf-liberation/Kconfig"

endmenu
```

## packages/games/Kconfig
```kconfig
menu "Games"

source "packages/games/pingus/Kconfig"
source "packages/games/teeworlds/Kconfig"

endmenu
```

## packages/games/pingus/Kconfig
```kconfig
config PACKAGE_GAMES_PINGUS
	bool "pingus"
	select PACKAGE_LIBS_BOOST
	select PACKAGE_LIBS_LIBPNG
	select PACKAGE_LIBS_SDL_CORE
	select PACKAGE_LIBS_SDL_IMAGE
	select PACKAGE_LIBS_SDL_MIXER
	default n
```

## packages/java/Kconfig
```kconfig
menu "Java"

source "packages/java/icedtea/Kconfig"
source "packages/java/icedtea-build/Kconfig"

endmenu
```

## packages/java/icedtea/Kconfig
```kconfig
config PACKAGE_JAVA_ICEDTEA
	bool "icedtea"
	select PACKAGE_JAVA_ICEDTEA_BUILD
	select PACKAGE_LIBS_CUPS
	select PACKAGE_LIBS_FREETYPE
	select PACKAGE_LIBS_LIBJPEG
	select PACKAGE_LIBS_LIBPNG
	select PACKAGE_XORG_PROTO_X
	select PACKAGE_LIBS_LIBGIF
	select PACKAGE_LIBS_ZLIB
	select PACKAGE_MULTIMEDIA_ALSA_CORE
	select PACKAGE_XORG_LIB_XINERAMA
	select PACKAGE_XORG_LIB_XP
	select PACKAGE_XORG_LIB_XRENDER
	select PACKAGE_XORG_LIB_XT
	select PACKAGE_XORG_LIB_XTST
	default n

config PACKAGE_JAVA_ICEDTEA_PLUGIN
	bool "plugin"
	depends on PACKAGE_JAVA_ICEDTEA
	select PACKAGE_LIBS_GTK
	#select PACKAGE_LIBS_LIBFFI
	select PACKAGE_WEB_MOZILLA_XULRUNNER
	default n
```

## packages/kernel/Kconfig
```kconfig
menu "Operating System Kernel"

source "packages/kernel/kmod/Kconfig"
source "packages/kernel/linux/Kconfig"
source "packages/kernel/psb-kernel-source/Kconfig"

endmenu
```

## packages/kernel/kmod/Kconfig
```kconfig
config PACKAGE_KERNEL_KMOD
	bool "kmod - library and utilities to handle Linux kernel modules"
	select VIRTUAL_DEVEL_LIBC
	select PACKAGE_BUILD_TOOLS_AUTOCONF
	select PACKAGE_BUILD_TOOLS_AUTOMAKE
```

## packages/kernel/linux.git/Kconfig
```kconfig
config OS
	string
	default "linux"

config VIRTUAL_KERNEL_LINUX_LIBC
	bool
	select PACKAGE_KERNEL_LINUX_KERNEL
	default n

config PACKAGE_KERNEL_LINUX_KERNEL
	bool "linux: Linux kernel"
	select PACKAGE_BUILD_TOOLS_UBOOT if ARCH_HAS_UBOOT
	select STABLE_ABI
	default n

config KERNEL_SOURCE
	string "Kernel source tree"
	depends on PACKAGE_KERNEL_LINUX_KERNEL
	default "../kernel/linux-2.6.git"

config KERNEL_CONFIG
	string "Kernel configuration"
	depends on PACKAGE_KERNEL_LINUX_KERNEL
	default "defconfig"

config KERNEL_DTB
	string "Flattened Device Tree blob"
	depends on PACKAGE_KERNEL_LINUX_KERNEL
	default ""
```

## packages/kernel/linux/Kconfig
```kconfig
config OS
	string
	default "linux"

config VIRTUAL_KERNEL_LINUX_LIBC
	bool
	select PACKAGE_KERNEL_LINUX

config PACKAGE_KERNEL_LINUX
	bool "Linux kernel"
	select PACKAGE_BUILD_TOOLS_DTC if PACKAGE_KERNEL_LINUX_DTB
	select PACKAGE_BUILD_TOOLS_KMOD
	select PACKAGE_BUILD_TOOLS_UBOOT if ARCH_HAS_UBOOT
	select STABLE_ABI

if PACKAGE_KERNEL_LINUX

choice PACKAGE_KERNEL_LINUX_SOURCE
	prompt "source"

config PACKAGE_KERNEL_LINUX_SOURCE_TARBALL
	bool "tarball"

config PACKAGE_KERNEL_LINUX_SOURCE_GIT
	bool "git repository"

config PACKAGE_KERNEL_LINUX_SOURCE_LOCAL
	bool "local directory"

endchoice

if PACKAGE_KERNEL_LINUX_SOURCE_TARBALL

config PACKAGE_KERNEL_LINUX_SOURCE_TARBALL_URL
	string "URL of tarball to download"

endif

if PACKAGE_KERNEL_LINUX_SOURCE_GIT

config PACKAGE_KERNEL_LINUX_SOURCE_GIT_URL
	string "URL of repository to check out"

config PACKAGE_KERNEL_LINUX_SOURCE_GIT_CHECKOUT
	string "git ref to check out"

endif

if PACKAGE_KERNEL_LINUX_SOURCE_LOCAL

config PACKAGE_KERNEL_LINUX_SOURCE_LOCAL_PATH
	string "path to local directory"

endif

config PACKAGE_KERNEL_LINUX_CONFIG
	string "configuration"

config PACKAGE_KERNEL_LINUX_BUILD_DTBS
	bool "Build the Flattened Device Tree blobs"

config PACKAGE_KERNEL_LINUX_DTB
	string "Default Flattened Device Tree blob"
	depends on PACKAGE_KERNEL_LINUX_BUILD_DTBS

config PACKAGE_KERNEL_LINUX_IMAGE
	string "Image type (zImage, bzImage, etc)"

config PACKAGE_KERNEL_LINUX_INSTALL_TARGET
	string "Install target (zinstall, install, etc)"

endif
```

## packages/kernel/module-init-tools/Kconfig
```kconfig
config PACKAGE_KERNEL_MODULE_INIT_TOOLS
	bool "module-init-tools: Linux kernel - module init tools"
	select PACKAGE_CORE_BUSYBOX
	default n
```

## packages/kernel/psb-kernel-source/Kconfig
```kconfig
config PACKAGE_KERNEL_PSB_KERNEL_SOURCE
	bool "Intel SCH (Poulsbo) DRM module"
	default n
```

## packages/libs/Kconfig
```kconfig
menu "Libraries"

source "packages/libs/appfs/Kconfig"
source "packages/libs/atk/Kconfig"
source "packages/libs/atkmm/Kconfig"
source "packages/libs/attr/Kconfig"
source "packages/libs/bluez/Kconfig"
source "packages/libs/boost/Kconfig"
source "packages/libs/bzip2/Kconfig"
source "packages/libs/cairo/Kconfig"
source "packages/libs/cairomm/Kconfig"
source "packages/libs/clutter/Kconfig"
source "packages/libs/consolekit/Kconfig"
source "packages/libs/cups/Kconfig"
source "packages/libs/curl/Kconfig"
source "packages/libs/dbus/Kconfig"
source "packages/libs/dbus-glib/Kconfig"
source "packages/libs/dconf/Kconfig"
source "packages/libs/e2fsprogs/Kconfig"
source "packages/libs/enchant/Kconfig"
source "packages/libs/eventlog/Kconfig"
source "packages/libs/expat/Kconfig"
source "packages/libs/fontconfig/Kconfig"
source "packages/libs/freetype/Kconfig"
source "packages/libs/fribidi/Kconfig"
source "packages/libs/fuse/Kconfig"
source "packages/libs/garcon/Kconfig"
source "packages/libs/gconf/Kconfig"
source "packages/libs/gdk-pixbuf/Kconfig"
source "packages/libs/gettext/Kconfig"
source "packages/libs/gjs/Kconfig"
source "packages/libs/glew/Kconfig"
source "packages/libs/glib/Kconfig"
source "packages/libs/glibmm/Kconfig"
source "packages/libs/gnutls/Kconfig"
source "packages/libs/gtk/Kconfig"
source "packages/libs/gtkmm/Kconfig"
source "packages/libs/hal/Kconfig"
source "packages/libs/iconv/Kconfig"
source "packages/libs/imlib2/Kconfig"
source "packages/libs/json-glib/Kconfig"
source "packages/libs/libarinc/Kconfig"
source "packages/libs/libcanberra/Kconfig"
source "packages/libs/libcap/Kconfig"
source "packages/libs/libdaemon/Kconfig"
source "packages/libs/libdrm/Kconfig"
source "packages/libs/libdrm-poulsbo/Kconfig"
source "packages/libs/libev/Kconfig"
source "packages/libs/libffi/Kconfig"
source "packages/libs/libgcrypt/Kconfig"
source "packages/libs/libgee/Kconfig"
source "packages/libs/libgif/Kconfig"
source "packages/libs/libglade/Kconfig"
source "packages/libs/libgpg-error/Kconfig"
source "packages/libs/libgpio/Kconfig"
source "packages/libs/libidl/Kconfig"
source "packages/libs/libjpeg/Kconfig"
source "packages/libs/libnih/Kconfig"
source "packages/libs/libnl/Kconfig"
source "packages/libs/libnotify/Kconfig"
source "packages/libs/liboil/Kconfig"
source "packages/libs/libpcap/Kconfig"
source "packages/libs/libpng/Kconfig"
source "packages/libs/librpc/Kconfig"
source "packages/libs/libsh/Kconfig"
source "packages/libs/libsigc++/Kconfig"
source "packages/libs/libsmartcard/Kconfig"
source "packages/libs/libsndfile/Kconfig"
source "packages/libs/libsoup/Kconfig"
source "packages/libs/libtasn1/Kconfig"
source "packages/libs/libtool/Kconfig"
source "packages/libs/libusb/Kconfig"
source "packages/libs/libusb-compat/Kconfig"
source "packages/libs/libwnck/Kconfig"
source "packages/libs/libxdg-basedir/Kconfig"
source "packages/libs/libxml2/Kconfig"
source "packages/libs/libxslt/Kconfig"
source "packages/libs/lirc/Kconfig"
source "packages/libs/mesa/Kconfig"
source "packages/libs/ncurses/Kconfig"
source "packages/libs/nspr/Kconfig"
source "packages/libs/nss/Kconfig"
source "packages/libs/openssl/Kconfig"
source "packages/libs/orbit/Kconfig"
source "packages/libs/pam/Kconfig"
source "packages/libs/pango/Kconfig"
source "packages/libs/pangomm/Kconfig"
source "packages/libs/pcre/Kconfig"
source "packages/libs/pcsc/Kconfig"
source "packages/libs/pixman/Kconfig"
source "packages/libs/polkit/Kconfig"
source "packages/libs/pulseaudio/Kconfig"
source "packages/libs/readline/Kconfig"
source "packages/libs/sdl/Kconfig"
source "packages/libs/sqlite/Kconfig"
source "packages/libs/startup-notification/Kconfig"
source "packages/libs/sysfsutils/Kconfig"
source "packages/libs/talloc/Kconfig"
source "packages/libs/upower/Kconfig"
source "packages/libs/zlib/Kconfig"

endmenu
```
