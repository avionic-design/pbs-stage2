## Kconfig
```kconfig
mainmenu "Platform Build System"

config SHELL
	string
	default "/bin/sh"
	---help---

menu "Target Configuration"
source "arch/Kconfig"
endmenu

# The platforms are sourced before the packages to allow them to define
# their own default values for the packages options.
source "platforms/Kconfig"
source "packages/Kconfig"
```

## arch/Kconfig
```kconfig
choice
	prompt "Architecture"

config ARCH_ALPHA
	bool "alpha"

config ARCH_X86
	bool "x86"
	select ARCH_HAS_HARD_FLOAT

config ARCH_X86_64
	bool "x86_64"
	select ARCH_HAS_HARD_FLOAT

config ARCH_ARM
	bool "arm"
	select ARCH_HAS_UBOOT

config ARCH_BLACKFIN
	bool "blackfin"

config ARCH_IA64
	bool "ia64"
	select ARCH_HAS_HARD_FLOAT

config ARCH_M68K
	bool "m68k"

config ARCH_MIPS
	bool "mips"

config ARCH_POWERPC
	bool "powerpc"

config ARCH_SH
	bool "sh"

config ARCH_SPARC
	bool "sparc"

config ARCH_TILE
	bool "tile"

config ARCH_UNICORE32
	bool "unicore32"

endchoice

config MARCH
        string "Machine architecture (-march)"

config ARCH_HAS_UBOOT
	bool

config ARCH_HAS_HARD_FLOAT
	bool

source "arch/alpha/Kconfig"
source "arch/x86/Kconfig"
source "arch/x86_64/Kconfig"
source "arch/arm/Kconfig"
source "arch/blackfin/Kconfig"
source "arch/ia64/Kconfig"
source "arch/m68k/Kconfig"
source "arch/mips/Kconfig"
source "arch/powerpc/Kconfig"
source "arch/sh/Kconfig"
source "arch/sparc/Kconfig"
source "arch/tile/Kconfig"
source "arch/unicore32/Kconfig"

choice
	prompt "Operating System"

config OS_NONE
	bool "None"

config OS_LINUX
	bool "Linux"

endchoice

if OS_NONE
config OS
	string
	default "none"
endif

if OS_LINUX
config OS
	string
	default "linux"

choice
	prompt "C runtime library"

config UCLIBC
	bool "uclibc: uClibc"
	depends on OS_LINUX

config GLIBC
	bool "glibc: GNU libc"
	depends on OS_LINUX

endchoice
endif
```

## arch/arm/Kconfig
```kconfig
if ARCH_ARM

config ARCH
	string
	default "arm"

#
# ARM CPU selection
#
choice
	prompt "CPU"

config ARCH_ARM_CPU_GENERIC
	bool "generic"

config ARCH_ARM_CPU_XSCALE
	bool "Xscale"

config ARCH_ARM_CPU_CORTEX_A9
	bool "Cortex-A9"

endchoice

source "arch/arm/generic/Kconfig"
source "arch/arm/xscale/Kconfig"
source "arch/arm/cortex-a9/Kconfig"

#
# Endianness configuration
#
choice
	prompt "Endianness"

config ARCH_ARM_ENDIAN_LITTLE
	bool "little endian"

config ARCH_ARM_ENDIAN_BIG
	bool "big endian"

endchoice

#
# Floating point configuration
#
choice
	prompt "Floating point unit"

config ARCH_ARM_FPU_NONE
	bool "none"
	depends on ARCH_ARM_CPU_GENERIC || ARCH_ARM_CPU_XSCALE

config ARCH_ARM_FPU_NEON_VFP4
	bool "neon-vfpv4"
	depends on ARCH_ARM_CPU_GENERIC || (ARCH_ARM_EXT_NEON && ARCH_ARM_EXT_VFPV4)

config ARCH_ARM_FPU_VFPV4
	bool "vfpv4"
	depends on ARCH_ARM_CPU_GENERIC || ARCH_ARM_EXT_VFPV4

config ARCH_ARM_FPU_VFPV4_D16
	bool "vfpv4-d16"
	depends on ARCH_ARM_CPU_GENERIC || ARCH_ARM_EXT_VFPV4_D16

config ARCH_ARM_FPU_NEON
	bool "neon"
	depends on ARCH_ARM_CPU_GENERIC || ARCH_ARM_EXT_NEON

config ARCH_ARM_FPU_VFPV3
	bool "vfpv3"
	depends on ARCH_ARM_CPU_GENERIC || ARCH_ARM_EXT_VFPV3

config ARCH_ARM_FPU_VFPV3_D16
	bool "vfpv3-d16"
	depends on ARCH_ARM_CPU_GENERIC || ARCH_ARM_EXT_VFPV3_D16

config ARCH_ARM_FPU_VFP
	bool "vfp"
	depends on ARCH_ARM_CPU_GENERIC || ARCH_ARM_EXT_VFP

endchoice

choice
	prompt "Floating point ABI"

config ARCH_ARM_FLOAT_ABI_HARDFP
	bool "hardfp"
	depends on !ARCH_ARM_FPU_NONE
	select ARCH_HAS_HARD_FLOAT

config ARCH_ARM_FLOAT_ABI_SOFTFP
	bool "softfp"
	depends on !ARCH_ARM_FPU_NONE
	select ARCH_HAS_HARD_FLOAT

config ARCH_ARM_FLOAT_ABI_SOFT
	bool "soft"

endchoice


#
# ABI configuration
#
choice
	prompt "ABI"

config ARCH_ARM_ABI_OABI
	bool "OABI"

config ARCH_ARM_ABI_EABI
	bool "EABI"

endchoice

if ARCH_ARM_ABI_OABI
config ABI
	string
	default ""
endif

if ARCH_ARM_ABI_EABI
config ABI
	string
	default "eabi"
endif

#
# CPU Extensions
#
config ARCH_ARM_EXT_A
       bool

config ARCH_ARM_EXT_T
       bool

config ARCH_ARM_EXT_T2
       bool

config ARCH_ARM_EXT_E
       bool

config ARCH_ARM_EXT_J
       bool

config ARCH_ARM_EXT_Z
       bool

config ARCH_ARM_EXT_ZK
       bool

config ARCH_ARM_EXT_VFP
       bool

config ARCH_ARM_EXT_VFPV3
       bool

config ARCH_ARM_EXT_VFPV3_D16
       bool

config ARCH_ARM_EXT_NEON
       bool

config ARCH_ARM_EXT_VFPV4
       bool

config ARCH_ARM_EXT_VFPV4_D16
       bool

#
# CPU Type
#

choice
        prompt "ARM architecture"

config ARCH_ARM_ARCH_V1
       bool "v1"
       depends on ARCH_ARM_CPU_GENERIC

config ARCH_ARM_ARCH_V2
       bool "v2"
       depends on ARCH_ARM_CPU_GENERIC

config ARCH_ARM_ARCH_V3
       bool "v3"
       depends on ARCH_ARM_CPU_GENERIC

config ARCH_ARM_ARCH_V4
       bool "v4"
       depends on ARCH_ARM_CPU_GENERIC

config ARCH_ARM_ARCH_V5
       bool "v5"
       depends on ARCH_ARM_CPU_GENERIC || ARCH_ARM_CPU_XSCALE

config ARCH_ARM_ARCH_V6
       bool "v6"
       depends on ARCH_ARM_CPU_GENERIC

config ARCH_ARM_ARCH_V7
       bool "v7"
       depends on ARCH_ARM_CPU_GENERIC || ARCH_ARM_CPU_CORTEX_A9

endchoice

config ARCH_ARM_ARCH_VERSION
       string
       default "7" if ARCH_ARM_ARCH_V7
       default "6" if ARCH_ARM_ARCH_V6
       default "5" if ARCH_ARM_ARCH_V5
       default "4" if ARCH_ARM_ARCH_V4
       default "3" if ARCH_ARM_ARCH_V3
       default "2" if ARCH_ARM_ARCH_V2
       default "1" if ARCH_ARM_ARCH_V1

choice
        prompt "ARM architecture variant"

config ARCH_ARM_ARCH_NO_EXT
       bool "none"
       depends on ARCH_ARM_CPU_GENERIC

config ARCH_ARM_ARCH_V2A
       bool "armv2a" if ARCH_ARM_ARCH_V2
       select ARCH_ARM_EXT_A
       depends on ARCH_ARM_CPU_GENERIC

config ARCH_ARM_ARCH_V3M
       bool "armv3m" if ARCH_ARM_ARCH_V3
       select ARCH_ARM_EXT_M
       depends on ARCH_ARM_CPU_GENERIC

config ARCH_ARM_ARCH_V4T
       bool "armv4t" if ARCH_ARM_ARCH_V4
       select ARCH_ARM_EXT_T
       depends on ARCH_ARM_CPU_GENERIC

config ARCH_ARM_ARCH_V5T
       bool "armv5t" if ARCH_ARM_ARCH_V5
       select ARCH_ARM_EXT_T
       depends on ARCH_ARM_CPU_GENERIC

config ARCH_ARM_ARCH_V5E
       bool "armv5e" if ARCH_ARM_ARCH_V5
       select ARCH_ARM_EXT_E
       depends on ARCH_ARM_CPU_GENERIC

config ARCH_ARM_ARCH_V5TE
       bool "armv5te" if ARCH_ARM_ARCH_V5
       select ARCH_ARM_EXT_T
       select ARCH_ARM_EXT_E
       depends on ARCH_ARM_CPU_GENERIC || ARCH_ARM_CPU_XSCALE

config ARCH_ARM_ARCH_V6J
       bool "armv6j" if ARCH_ARM_ARCH_V6
       select ARCH_ARM_EXT_J
       depends on ARCH_ARM_CPU_GENERIC

config ARCH_ARM_ARCH_V6T2
       bool "armv6t2" if ARCH_ARM_ARCH_V6
       select ARCH_ARM_EXT_T2
       depends on ARCH_ARM_CPU_GENERIC

config ARCH_ARM_ARCH_V6Z
       bool "armv6z" if ARCH_ARM_ARCH_V6
       select ARCH_ARM_EXT_Z
       depends on ARCH_ARM_CPU_GENERIC

config ARCH_ARM_ARCH_V6ZK
       bool "armv6zk" if ARCH_ARM_ARCH_V6
       select ARCH_ARM_EXT_ZK
       depends on ARCH_ARM_CPU_GENERIC

endchoice


config MARCH
       default "armv7"      if ARCH_ARM_ARCH_V7
       default "armv6zk"    if ARCH_ARM_ARCH_V6ZK
       default "armv6z"     if ARCH_ARM_ARCH_V6Z
       default "armv6t2"    if ARCH_ARM_ARCH_V6T2
       default "armv6j"     if ARCH_ARM_ARCH_V6J
       default "armv6"      if ARCH_ARM_ARCH_V6
       default "armv5te"    if ARCH_ARM_ARCH_V5TE
       default "armv5e"     if ARCH_ARM_ARCH_V5E
       default "armv5t"     if ARCH_ARM_ARCH_V5T
       default "armv5"      if ARCH_ARM_ARCH_V5
       default "armv4t"     if ARCH_ARM_ARCH_V4T
       default "armv4"      if ARCH_ARM_ARCH_V4
       default "armv3m"     if ARCH_ARM_ARCH_V3M
       default "armv3"      if ARCH_ARM_ARCH_V3
       default "armv2a"     if ARCH_ARM_ARCH_V2A
       default "armv2"      if ARCH_ARM_ARCH_V2

endif
```

## arch/arm/configs/adx-medcom-wide-initrd.defconfig
```kconfig
CONFIG_ARCH_ARM=y
CONFIG_ARCH_ARM_CPU_CORTEX_A9=y
CONFIG_ARCH_ARM_ABI_EABI=y
CONFIG_OS_LINUX=y
CONFIG_PLATFORM_AVIONIC_DESIGN=y
CONFIG_PLATFORM_AVIONIC_DESIGN_MEDCOM_WIDE=y
CONFIG_KERNEL_CONFIG="medcom-wide_modularized_defconfig"
CONFIG_KERNEL_SOURCE="../kernel/linux-avionic.git"
CONFIG_PACKAGE_CORE_E2FSPROGS=y
CONFIG_PACKAGE_UTIL_ADAK=y
```

## arch/arm/configs/adx-medcom-wide-rootfs.defconfig
```kconfig
CONFIG_ARCH_ARM=y
CONFIG_ARCH_ARM_CPU_CORTEX_A9=y
CONFIG_ARCH_ARM_ABI_EABI=y
CONFIG_OS_LINUX=y
CONFIG_GLIBC=y
CONFIG_PLATFORM_AVIONIC_DESIGN=y
CONFIG_PLATFORM_AVIONIC_DESIGN_MEDCOM_WIDE=y
CONFIG_KERNEL_CONFIG="medcom-wide_modularized_defconfig"
CONFIG_KERNEL_SOURCE="../kernel/linux-avionic.git"
CONFIG_PACKAGE_DEVEL_GDB=y
CONFIG_PACKAGE_DEVEL_STRACE=y
CONFIG_PACKAGE_CORE_COREUTILS=y
CONFIG_PACKAGE_CORE_E2FSPROGS=y
CONFIG_PACKAGE_CORE_GREP=y
CONFIG_PACKAGE_CORE_LESS=y
CONFIG_PACKAGE_CORE_PROCPS=y
CONFIG_PACKAGE_CORE_PSMISC=y
CONFIG_PACKAGE_CORE_RSYSLOG=y
CONFIG_PACKAGE_CORE_SYSTEMD=y
CONFIG_PACKAGE_LIBS_GLIB_NETWORKING=y
CONFIG_PACKAGE_SHELLS_BASH=y
CONFIG_PACKAGE_NET_DDIP=y
CONFIG_PACKAGE_NET_DHCPCD=y
CONFIG_PACKAGE_NET_ETHTOOL=y
CONFIG_PACKAGE_NET_IFLINKD=y
CONFIG_PACKAGE_NET_IPERF=y
CONFIG_PACKAGE_NET_LLDPD=y
CONFIG_PACKAGE_NET_NTPD=y
CONFIG_PACKAGE_NET_REMOTE_CONTROL=y
CONFIG_PACKAGE_NET_REMOTE_CONTROL_AUDIO_ALSA=y
CONFIG_PACKAGE_NET_REMOTE_CONTROL_BACKLIGHT_SYSFS=y
CONFIG_PACKAGE_NET_REMOTE_CONTROL_VIDEO_GST=y
CONFIG_PACKAGE_NET_REMOTE_CONTROL_SMARTCARD_LIBSMARTCARD=y
CONFIG_PACKAGE_NET_REMOTE_CONTROL_VOIP_LINPHONE=y
CONFIG_PACKAGE_NET_REMOTE_CONTROL_MODEM_LIBMODEM=y
CONFIG_PACKAGE_NET_REMOTE_CONTROL_GPIO_SYSFS=y
CONFIG_PACKAGE_NET_REMOTE_CONTROL_JAVASCRIPT=y
CONFIG_PACKAGE_NET_RUM=y
CONFIG_PACKAGE_NET_FUSE_SSHFS=y
CONFIG_PACKAGE_NET_TCPDUMP=y
CONFIG_PACKAGE_CONSOLE_KBD=y
CONFIG_PACKAGE_CONSOLE_TMUX=y
CONFIG_PACKAGE_EDITORS_NANO=y
CONFIG_PACKAGE_EDITORS_VIM=y
CONFIG_PACKAGE_MULTIMEDIA_ALSA_UTILS=y
CONFIG_PACKAGE_MULTIMEDIA_GSTREAMER_PLUGINS_GOOD=y
CONFIG_PACKAGE_MULTIMEDIA_GSTREAMER_PLUGINS_BAD=y
CONFIG_PACKAGE_MULTIMEDIA_GSTREAMER_PLUGINS_UGLY=y
CONFIG_PACKAGE_MULTIMEDIA_GSTREAMER_PLUGINS_GLES=y
CONFIG_PACKAGE_WEB_X11VNC=y
CONFIG_PACKAGE_XORG_DRIVER_INPUT_EVDEV=y
CONFIG_PACKAGE_XORG_DRIVER_INPUT_KEYBOARD=y
CONFIG_PACKAGE_XORG_DRIVER_INPUT_MOUSE=y
CONFIG_PACKAGE_XORG_APP_EVTEST=y
CONFIG_PACKAGE_XORG_APP_SETXKBMAP=y
CONFIG_PACKAGE_XORG_APP_XINIT=y
CONFIG_PACKAGE_XORG_APP_XKBCOMP=y
CONFIG_PACKAGE_XORG_APP_XRANDR=y
CONFIG_PACKAGE_XORG_APP_XTERM=y
CONFIG_PACKAGE_XORG_DATA_XKEYBOARD_CONFIG=y
CONFIG_XORG_XV=y
CONFIG_PACKAGE_DESKTOP_EVDEV_CALIBRATE=y
CONFIG_PACKAGE_DESKTOP_ICONS_TANGO=y
CONFIG_PACKAGE_DESKTOP_NODM=y
CONFIG_PACKAGE_WM_AWESOME=y
CONFIG_PACKAGE_UTIL_ADAK=y
CONFIG_PACKAGE_UTIL_HTOP=y
CONFIG_PACKAGE_UTIL_I2C_TOOLS=y
CONFIG_PACKAGE_FONTS_TTF_BITSTREAM_VERA=y
CONFIG_PACKAGE_FONTS_TTF_FREEFONT=y
CONFIG_PACKAGE_FONTS_TTF_LIBERATION=y
CONFIG_PACKAGE_VENDOR_AVIONIC_DESIGN_MEDCOM_WIDE_UTILS=y
CONFIG_PACKAGE_VENDOR_NVIDIA_TEGRA2_FLASHPLAYER=y
CONFIG_PACKAGE_VENDOR_NVIDIA_TEGRA2_L4T=y
CONFIG_OPENGL_MESA_OPENGL_ES2=y
```

## arch/arm/cortex-a15/Kconfig
```kconfig
if ARCH_ARM_CPU_CORTEX_A15

config CPU
	string
	default "unknown"

choice
	prompt "Silicon"

config ARCH_CORTEX_A15_UNSPECIFIED
	bool "Unspecified"
	select ARCH_ARM_EXT_NEON
	select ARCH_ARM_EXT_VFPV4

config ARCH_TEGRA_124_SOC
	bool "Nvidia Tegra 124 (K1)"
	select ARCH_ARM_EXT_NEON
	select ARCH_ARM_EXT_VFPV4

endchoice

endif
```

## arch/arm/cortex-a9/Kconfig
```kconfig
if ARCH_ARM_CPU_CORTEX_A9

config CPU
	string
	default "unknown"

choice
	prompt "Silicon"

config ARCH_UNSPECIFIED
	bool "Unspecified"
	select ARCH_ARM_EXT_NEON
	select ARCH_ARM_EXT_VFPV3

config ARCH_TEGRA_2x_SOC
	bool "Nvidia Tegra 2"
	select ARCH_ARM_EXT_VFPV3_D16

config ARCH_TEGRA_3x_SOC
	bool "Nvidia Tegra 3"
	select ARCH_ARM_EXT_NEON
	select ARCH_ARM_EXT_VFPV3

endchoice

endif
```

## arch/blackfin/Kconfig
```kconfig
if ARCH_BLACKFIN

config ARCH
	string
	default "blackfin"

config MACHINE
	string
	default "bfin"

endif
```

## arch/mips/Kconfig
```kconfig
if ARCH_MIPS

config ARCH
	string
	default "mips"

config MACHINE
	string
	default "mipsel" if ARCH_MIPS_ENDIAN_LITTLE
	default "mips"

choice
	prompt "Endianness"

config ARCH_MIPS_ENDIAN_BIG
	bool "big endian"

config ARCH_MIPS_ENDIAN_LITTLE
	bool "little endian"

endchoice

endif
```

## arch/powerpc/Kconfig
```kconfig
if ARCH_POWERPC

config ARCH
	string
	default "powerpc"

config VENDOR
	string
	default "unknown" if !OS_NONE

endif
```

## arch/sh/Kconfig
```kconfig
if ARCH_SH

config ARCH
	string
	default "sh"

config MACHINE
	string
	default "sh4"

endif
```

## arch/x86/Kconfig
```kconfig
if ARCH_X86

config ARCH
	string
	default "x86"

config MACHINE
	string
	default "i786" if ARCH_X86_I786
	default "i686" if ARCH_X86_I686
	default "i386"

config VENDOR
	string
	default "pc" if !OS_NONE

config MARCH
	default "i686" if ARCH_X86_I686 || ARCH_X86_I786
	default "i386" if ARCH_X86_I386

#
# x86 CPU selection
#
choice
	prompt "CPU"

config ARCH_X86_I386
	bool "i386"

config ARCH_X86_I686
	bool "i686"

config ARCH_X86_I786
	bool "i786"

endchoice

endif
```
