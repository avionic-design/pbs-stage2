## configs/skidata-carrier-rootfs_defconfig
```kconfig
CONFIG_ARCH_ARM=y
CONFIG_ARCH_ARM_CPU_CORTEX_A9=y
CONFIG_ARCH_ARM_ABI_EABI=y
CONFIG_ARCH_ARM_ARCH_V7=y
CONFIG_OS_LINUX=y
CONFIG_GLIBC=y
CONFIG_PLATFORM_SKIDATA=y
CONFIG_PACKAGE_KERNEL_LINUX_CONFIG="skidata-carrier_defconfig"
CONFIG_PLATFORM_SKIDATA_CARRIER_ROOTFS=y
CONFIG_PACKAGE_BUILD_TOOLS_GTK_DOC=y
CONFIG_PACKAGE_BUILD_TOOLS_INTLTOOL=y
CONFIG_PACKAGE_KERNEL_LINUX_SOURCE_LOCAL=y
CONFIG_PACKAGE_KERNEL_LINUX_SOURCE_LOCAL_PATH="../kernel/linux-nvidia.git"
CONFIG_PACKAGE_DEVEL_GDB=y
CONFIG_PACKAGE_DEVEL_STRACE=y
CONFIG_PACKAGE_CORE_BUSYBOX=y
CONFIG_PACKAGE_CORE_COREUTILS=y
CONFIG_PACKAGE_CORE_E2FSPROGS=y
CONFIG_PACKAGE_CORE_GREP=y
CONFIG_PACKAGE_CORE_LESS=y
CONFIG_PACKAGE_CORE_LM_SENSORS=y
CONFIG_PACKAGE_CORE_PROCPS=y
CONFIG_PACKAGE_CORE_PSMISC=y
CONFIG_PACKAGE_CORE_SYSLOG_NG=y
CONFIG_PACKAGE_LIBS_CURL=y
CONFIG_PACKAGE_LIBS_GLIB_NETWORKING=y
CONFIG_PACKAGE_LIBS_LIBDRM=y
CONFIG_PACKAGE_LIBS_LIBRSVG=y
CONFIG_PACKAGE_LIBS_LIBSOUP=y
CONFIG_PACKAGE_LIBS_LIBXSLT=y
CONFIG_PACKAGE_SHELLS_BASH=y
CONFIG_PACKAGE_NET_DHCPCD=y
CONFIG_PACKAGE_NET_ETHTOOL=y
CONFIG_PACKAGE_NET_IFLINKD=y
CONFIG_PACKAGE_NET_IPERF=y
CONFIG_PACKAGE_NET_LLDPD=y
CONFIG_PACKAGE_NET_LLDPD_SNMP=y
CONFIG_PACKAGE_NET_NTPD=y
CONFIG_PACKAGE_NET_FUSE_SSHFS=y
CONFIG_PACKAGE_NET_TCPDUMP=y
CONFIG_PACKAGE_CONSOLE_KBD=y
CONFIG_PACKAGE_EDITORS_NANO=y
CONFIG_PACKAGE_EDITORS_VIM=y
CONFIG_PACKAGE_MULTIMEDIA_ALSA_UTILS=y
CONFIG_PACKAGE_MULTIMEDIA_GSTREAMER_PLUGINS_GOOD=y
CONFIG_PACKAGE_MULTIMEDIA_GSTREAMER_PLUGINS_BAD=y
CONFIG_PACKAGE_MULTIMEDIA_GSTREAMER_PLUGINS_UGLY=y
CONFIG_PACKAGE_WEB_FREERDP=y
CONFIG_PACKAGE_WEB_X11VNC=y
CONFIG_PACKAGE_XORG_PROTO_DRI2=y
CONFIG_PACKAGE_XORG_LIB_XTST=y
CONFIG_PACKAGE_XORG_LIB_XXF86VM=y
CONFIG_PACKAGE_XORG_DRIVER_INPUT_EVDEV=y
CONFIG_PACKAGE_XORG_DRIVER_INPUT_KEYBOARD=y
CONFIG_PACKAGE_XORG_DRIVER_INPUT_MOUSE=y
CONFIG_PACKAGE_XORG_APP_EVTEST=y
CONFIG_PACKAGE_XORG_APP_SETXKBMAP=y
CONFIG_PACKAGE_XORG_APP_XINIT=y
CONFIG_PACKAGE_XORG_APP_XKBCOMP=y
CONFIG_PACKAGE_XORG_APP_XRANDR=y
CONFIG_PACKAGE_XORG_APP_XTERM=y
CONFIG_PACKAGE_XORG_DATA_XKEYBOARD_CONFIG=y
CONFIG_XORG_XV=y
CONFIG_PACKAGE_DESKTOP_EVDEV_CALIBRATE=y
CONFIG_PACKAGE_DESKTOP_ICONS_TANGO=y
CONFIG_PACKAGE_DESKTOP_NODM=y
CONFIG_PACKAGE_DESKTOP_SHARED_MIME_INFO=y
CONFIG_PACKAGE_WM_AWESOME=y
CONFIG_PACKAGE_UTIL_ADAK=y
CONFIG_PACKAGE_UTIL_HTOP=y
CONFIG_PACKAGE_UTIL_I2C_TOOLS=y
CONFIG_PACKAGE_FONTS_TTF_BITSTREAM_VERA=y
CONFIG_PACKAGE_FONTS_TTF_FREEFONT=y
CONFIG_PACKAGE_FONTS_TTF_LIBERATION=y
CONFIG_PACKAGE_VENDOR_NVIDIA_TEGRA2_FLASHPLAYER=y
CONFIG_PACKAGE_VENDOR_NVIDIA_TEGRA2_L4T=y
CONFIG_LIBAV_LIBAV=y
CONFIG_OPENGL_NVIDIA_L4T=y
CONFIG_UDEV_SYSTEMD=y
```

## configs/skidata-carrier-setup_defconfig
```kconfig
CONFIG_ARCH_ARM=y
CONFIG_MARCH=""
CONFIG_ARCH_ARM_CPU_CORTEX_A9=y
CONFIG_ARCH_TEGRA_2x_SOC=y
CONFIG_ARCH_ARM_HARD_FP=y
CONFIG_ARCH_ARM_ABI_EABI=y
CONFIG_ARCH_ARM_ARCH_V7=y
CONFIG_OS_LINUX=y
CONFIG_PLATFORM_SKIDATA=y
CONFIG_PLATFORM_SKIDATA_CARRIER=y
CONFIG_PLATFORM_SKIDATA_CARRIER_SETUP=y
CONFIG_PACKAGE_KERNEL_LINUX_CONFIG="skidata-carrier_defconfig"
CONFIG_PACKAGE_KERNEL_LINUX_SOURCE_GIT=y
CONFIG_PACKAGE_KERNEL_LINUX_SOURCE_GIT_URL="git@github.com:avionic-design/skidata-linux.git"
CONFIG_PACKAGE_KERNEL_LINUX_SOURCE_GIT_CHECKOUT="skidata/tamonten/l4t-r16-3"
CONFIG_PACKAGE_CORE_E2FSPROGS=y
# CONFIG_PACKAGE_CORE_UTIL_LINUX_NCURSES is not set
CONFIG_PACKAGE_LIBS_SYSFSUTILS=y
CONFIG_PACKAGE_CONSOLE_FBSET=y
CONFIG_PACKAGE_UTIL_ADAK=y
CONFIG_PACKAGE_UTIL_MTD_UTILS=y
```

## configs/tec-ng-initrd_defconfig
```kconfig
CONFIG_ARCH_ARM=y
CONFIG_MARCH=""
CONFIG_ARCH_ARM_CPU_CORTEX_A9=y
CONFIG_ARCH_TEGRA_3x_SOC=y
CONFIG_ARCH_ARM_HARD_FP=y
CONFIG_ARCH_ARM_ABI_EABI=y
CONFIG_ARCH_ARM_ARCH_V7=y
CONFIG_OS_LINUX=y
CONFIG_PLATFORM_AVIONIC_DESIGN=y
CONFIG_PLATFORM_AVIONIC_DESIGN_TAMONTEN=y
CONFIG_PLATFORM_AVIONIC_DESIGN_TAMONTEN_TEC=y
CONFIG_PACKAGE_KERNEL_LINUX_SOURCE_GIT=y
CONFIG_PACKAGE_KERNEL_LINUX_SOURCE_GIT_URL="https://github.com/avionic-design/linux-l4t.git"
CONFIG_PACKAGE_KERNEL_LINUX_SOURCE_GIT_CHECKOUT="tamonten/l4t-r16-3"
CONFIG_PACKAGE_KERNEL_LINUX_CONFIG="tegra_tec_ng_defconfig"
CONFIG_PACKAGE_CORE_BASE_FILES=y
# CONFIG_PACKAGE_CORE_UTIL_LINUX_NCURSES is not set
CONFIG_PACKAGE_UTIL_ADAK=y
CONFIG_OPENGL_NVIDIA_L4T_T3=y
```

## configs/tec-ng-rootfs_defconfig
```kconfig
CONFIG_ARCH_ARM=y
CONFIG_ARCH_ARM_CPU_CORTEX_A9=y
CONFIG_ARCH_TEGRA_3x_SOC=y
CONFIG_ARCH_ARM_HARD_FP=y
CONFIG_ARCH_ARM_ABI_EABI=y
CONFIG_ARCH_ARM_ARCH_V7=y
CONFIG_OS_LINUX=y
CONFIG_GLIBC=y
CONFIG_PLATFORM_AVIONIC_DESIGN=y
CONFIG_PLATFORM_AVIONIC_DESIGN_TAMONTEN=y
CONFIG_PLATFORM_AVIONIC_DESIGN_TAMONTEN_TEC=y
CONFIG_PLATFORM_AVIONIC_DESIGN_TAMONTEN_TEC_ROOTFS=y
CONFIG_PACKAGE_BUILD_TOOLS_SQUASHFS=y
CONFIG_PACKAGE_KERNEL_LINUX_SOURCE_GIT=y
CONFIG_PACKAGE_KERNEL_LINUX_SOURCE_GIT_URL="https://github.com/avionic-design/linux-l4t.git"
CONFIG_PACKAGE_KERNEL_LINUX_SOURCE_GIT_CHECKOUT="tamonten/l4t-r16-3"
CONFIG_PACKAGE_KERNEL_LINUX_CONFIG="tegra_tec_ng_defconfig"
CONFIG_PACKAGE_CORE_BASE_FILES=y
CONFIG_PACKAGE_CORE_BUSYBOX=y
CONFIG_PACKAGE_CORE_COREUTILS=y
CONFIG_PACKAGE_CORE_DMIDECODE=y
CONFIG_PACKAGE_CORE_E2FSPROGS=y
CONFIG_PACKAGE_CORE_GREP=y
CONFIG_PACKAGE_CORE_LESS=y
CONFIG_PACKAGE_CORE_LM_SENSORS=y
CONFIG_PACKAGE_CORE_LOGROTATE=y
CONFIG_PACKAGE_CORE_PCIUTILS=y
CONFIG_PACKAGE_CORE_PROCPS=y
CONFIG_PACKAGE_CORE_PSMISC=y
CONFIG_PACKAGE_CORE_RSYSLOG=y
CONFIG_PACKAGE_CORE_UTIL_LINUX_PAM=y
CONFIG_PACKAGE_LIBS_JSON_GLIB=y
CONFIG_PACKAGE_SHELLS_BASH=y
CONFIG_PACKAGE_NET_BRIDGE_UTILS=y
CONFIG_PACKAGE_NET_DHCPCD=y
CONFIG_PACKAGE_NET_ETHTOOL=y
CONFIG_PACKAGE_NET_IFLINKD=y
CONFIG_PACKAGE_NET_IPERF=y
CONFIG_PACKAGE_NET_IPUTILS=y
CONFIG_PACKAGE_NET_IW=y
CONFIG_PACKAGE_NET_NET_TOOLS=y
CONFIG_PACKAGE_NET_NTPD=y
CONFIG_PACKAGE_NET_OPENSSH=y
CONFIG_PACKAGE_NET_TCPDUMP=y
CONFIG_PACKAGE_NET_WIRELESS_TOOLS=y
CONFIG_PACKAGE_NET_WPA_SUPPLICANT=y
CONFIG_PACKAGE_CONSOLE_FBSET=y
CONFIG_PACKAGE_CONSOLE_KBD=y
CONFIG_PACKAGE_CONSOLE_TMUX=y
CONFIG_PACKAGE_EDITORS_NANO=y
CONFIG_PACKAGE_EDITORS_VIM=y
CONFIG_PACKAGE_MULTIMEDIA_ALSA_UTILS=y
CONFIG_PACKAGE_MULTIMEDIA_ALSA_PLUGINS=y
CONFIG_PACKAGE_MULTIMEDIA_GLMARK2=y
CONFIG_PACKAGE_MULTIMEDIA_VLC_PLUGIN_GLES2=y
CONFIG_PACKAGE_WEB_WEBKIT_GTK_UNICODE_BACKEND_ICU=y
CONFIG_PACKAGE_WEB_WEBKIT_GTK_ENABLE_ACCELERATED_COMPOSITING=y
CONFIG_PACKAGE_WEB_X11VNC=y
CONFIG_PACKAGE_XORG_APP_EVTEST=y
CONFIG_PACKAGE_XORG_APP_SETXKBMAP=y
CONFIG_PACKAGE_XORG_APP_XAUTH=y
CONFIG_PACKAGE_XORG_APP_XINIT=y
CONFIG_PACKAGE_XORG_APP_XKBCOMP=y
CONFIG_PACKAGE_XORG_APP_XRANDR=y
CONFIG_PACKAGE_XORG_APP_XRDB=y
CONFIG_PACKAGE_XORG_APP_XSETROOT=y
CONFIG_PACKAGE_XORG_APP_XTERM=y
CONFIG_PACKAGE_XORG_DATA_XKEYBOARD_CONFIG=y
CONFIG_PACKAGE_XORG_DRIVER_INPUT_EVDEV=y
CONFIG_PACKAGE_XORG_LIB_XDAMAGE=y
CONFIG_XORG_XV=y
CONFIG_PACKAGE_DESKTOP_EVDEV_CALIBRATE=y
CONFIG_PACKAGE_DESKTOP_GTK_ENGINES=y
CONFIG_PACKAGE_DESKTOP_ICONS_TANGO=y
CONFIG_PACKAGE_DESKTOP_NODM=y
CONFIG_PACKAGE_DESKTOP_XFCE_XFCE4_SESSION=y
CONFIG_PACKAGE_DESKTOP_XFCE_XFCE4_SETTINGS=y
CONFIG_PACKAGE_DESKTOP_XFCE_XFDESKTOP=y
CONFIG_PACKAGE_DESKTOP_XFCE_XFWM4=y
CONFIG_PACKAGE_WM_OPENBOX=y
CONFIG_PACKAGE_UTIL_ADAK=y
CONFIG_PACKAGE_UTIL_FLASHTOOL=y
CONFIG_PACKAGE_UTIL_HTOP=y
CONFIG_PACKAGE_UTIL_I2C_TOOLS=y
CONFIG_PACKAGE_UTIL_MTD_UTILS=y
CONFIG_PACKAGE_FONTS_TTF_BITSTREAM_VERA=y
CONFIG_PACKAGE_FONTS_TTF_FREEFONT=y
CONFIG_PACKAGE_FONTS_TTF_LIBERATION=y
CONFIG_PACKAGE_VENDOR_AVIONIC_DESIGN_REMOTE_CONTROL=y
CONFIG_PACKAGE_VENDOR_AVIONIC_DESIGN_REMOTE_CONTROL_VIDEO_VLC=y
CONFIG_PACKAGE_VENDOR_AVIONIC_DESIGN_REMOTE_CONTROL_JAVASCRIPT=y
CONFIG_OPENGL_NVIDIA_L4T_T3=y
CONFIG_UDEV_SYSTEMD=y
```

## packages/Kconfig
```kconfig
menu "Packages"

source "packages/toolchain/Kconfig"
source "packages/build-tools/Kconfig"
source "packages/boot/Kconfig"
source "packages/kernel/Kconfig"
source "packages/devel/Kconfig"
source "packages/core/Kconfig"
source "packages/libs/Kconfig"
source "packages/shells/Kconfig"
source "packages/net/Kconfig"
source "packages/console/Kconfig"
source "packages/editors/Kconfig"
source "packages/multimedia/Kconfig"
source "packages/web/Kconfig"
source "packages/xorg/Kconfig"
source "packages/desktop/Kconfig"
source "packages/wm/Kconfig"
source "packages/util/Kconfig"
source "packages/fonts/Kconfig"
source "packages/games/Kconfig"
source "packages/java/Kconfig"
source "packages/ti/Kconfig"
source "packages/vendor/Kconfig"

endmenu
```

## packages/boot/Kconfig
```kconfig
menu "Boot loaders"

source "packages/boot/u-boot/Kconfig"
source "packages/boot/ubl-sft/Kconfig"

endmenu
```

## packages/boot/u-boot/Kconfig
```kconfig
config PACKAGE_BOOT_U_BOOT
	bool "u-boot"
	select VIRTUAL_DEVEL_LIBC

config U_BOOT_BOARD
	string "u-boot board"
        default ""
        depends on PACKAGE_BOOT_U_BOOT

config U_BOOT_BRANCH
	string "u-boot repository branch"
        default ""
        depends on PACKAGE_BOOT_U_BOOT

config U_BOOT_NAND_SPL
	bool "build a NAND SPL"
	depends on PACKAGE_BOOT_U_BOOT

config U_BOOT_MMC_SPL
	bool "build a MMC SPL"
	depends on PACKAGE_BOOT_U_BOOT
```

## packages/boot/ubl-sft/Kconfig
```kconfig
config PACKAGE_BOOT_UBL_SFT
	bool "UBL and SFT"

config UBL_SFT_BRANCH
	string "ubl-sft repository branch"
	default ""
	depends on PACKAGE_BOOT_UBL_SFT
```
