## arch/x86_64/Kconfig
```kconfig
if ARCH_X86_64

config ARCH
	string
	default "x86_64"

config VENDOR
	string
	default "unknown" if !OS_NONE

#
# x86-64 CPU selection
#
choice
	prompt "CPU"

config ARCH_X86_64_GENERIC
	bool "generic"

endchoice

endif
```

## configs/csc_defconfig
```kconfig
CONFIG_ARCH_ARM=y
CONFIG_ARCH_ARM_ABI_EABI=y
CONFIG_OS_LINUX=y
CONFIG_PLATFORM_LUFTHANSA=y
CONFIG_PLATFORM_LUFTHANSA_CSC=y
CONFIG_PLATFORM_LUFTHANSA_CSC_ROOTFS=y
CONFIG_PACKAGE_KERNEL_LINUX_SOURCE_LOCAL=y
CONFIG_PACKAGE_KERNEL_LINUX_SOURCE_LOCAL_PATH="../kernel/linux-csc.git"
```

## configs/medatom-initrd_defconfig
```kconfig
CONFIG_ARCH_X86_I786=y
CONFIG_OS_LINUX=y
CONFIG_PLATFORM_AVIONIC_DESIGN=y
CONFIG_PLATFORM_AVIONIC_DESIGN_MEDATOM=y
CONFIG_KERNEL_CONFIG="medatom_defconfig"
CONFIG_KERNEL_SOURCE="../kernel/linux-medatom.git"
CONFIG_PACKAGE_CORE_E2FSPROGS=y
CONFIG_PACKAGE_CORE_UDEV_DISABLE_EXTRAS=y
# CONFIG_PACKAGE_CORE_UTIL_LINUX_NCURSES is not set
CONFIG_PACKAGE_LIBS_LIBUSB=y
CONFIG_PACKAGE_LIBS_ZLIB=y
```

## configs/medatom-rootfs_defconfig
```kconfig
CONFIG_ARCH_X86_I786=y
CONFIG_OS_LINUX=y
CONFIG_GLIBC=y
CONFIG_PLATFORM_AVIONIC_DESIGN=y
CONFIG_PLATFORM_AVIONIC_DESIGN_MEDATOM=y
CONFIG_PLATFORM_AVIONIC_DESIGN_MEDATOM_ROOTFS=y
CONFIG_PACKAGE_BUILD_TOOLS_DBUS_GLIB=y
CONFIG_PACKAGE_KERNEL_LINUX_SOURCE_LOCAL=y
CONFIG_PACKAGE_KERNEL_LINUX_SOURCE_LOCAL_PATH="../kernel/linux-medatom.git"
CONFIG_PACKAGE_KERNEL_LINUX_CONFIG="medatom_defconfig"
CONFIG_PACKAGE_DEVEL_GDB=y
CONFIG_PACKAGE_DEVEL_STRACE=y
CONFIG_PACKAGE_CORE_BUSYBOX=y
CONFIG_PACKAGE_CORE_COREUTILS=y
CONFIG_PACKAGE_CORE_CPUFREQUTILS=y
CONFIG_PACKAGE_CORE_DMIDECODE=y
CONFIG_PACKAGE_CORE_E2FSPROGS=y
CONFIG_PACKAGE_CORE_GREP=y
CONFIG_PACKAGE_CORE_LM_SENSORS=y
CONFIG_PACKAGE_CORE_PROCPS=y
CONFIG_PACKAGE_CORE_SED=y
CONFIG_PACKAGE_CORE_SYSLINUX=y
# CONFIG_PACKAGE_CORE_SYSTEMD_ENABLE_BINFMT is not set
# CONFIG_PACKAGE_CORE_SYSTEMD_ENABLE_GTK is not set
CONFIG_PACKAGE_LIBS_CONSOLEKIT=y
CONFIG_PACKAGE_LIBS_DBUS_X11=y
CONFIG_PACKAGE_LIBS_GLIB_NETWORKING=y
CONFIG_PACKAGE_LIBS_LIBGPIO=y
CONFIG_PACKAGE_LIBS_LIBOIL=y
CONFIG_PACKAGE_LIBS_LIBSMARTCARD=y
CONFIG_PACKAGE_LIBS_LIBUSB_COMPAT=y
CONFIG_PACKAGE_LIBS_MESA_DRI_I915=y
CONFIG_PACKAGE_LIBS_SYSFSUTILS=y
CONFIG_PACKAGE_SHELLS_BASH=y
CONFIG_PACKAGE_NET_DDIP=y
CONFIG_PACKAGE_NET_DHCPCD=y
CONFIG_PACKAGE_NET_ETHTOOL=y
CONFIG_PACKAGE_NET_IFLINKD=y
CONFIG_PACKAGE_NET_LLDPD=y
CONFIG_PACKAGE_NET_LLDPD_SNMP=y
CONFIG_PACKAGE_NET_NTPD=y
CONFIG_PACKAGE_NET_PROXYCONF=y
CONFIG_PACKAGE_NET_REMOTE_CONTROL_BACKLIGHT_MEDATOM=y
CONFIG_PACKAGE_NET_REMOTE_CONTROL_VIDEO_VLC=y
CONFIG_PACKAGE_NET_REMOTE_CONTROL_SMARTCARD_LIBCCID=y
CONFIG_PACKAGE_NET_REMOTE_CONTROL_VOIP_LINPHONE=y
CONFIG_PACKAGE_NET_REMOTE_CONTROL_MODEM_LIBMODEM=y
CONFIG_PACKAGE_NET_REMOTE_CONTROL_HANDSET_PTIP=y
CONFIG_PACKAGE_NET_REMOTE_CONTROL_GPIO_GPIODEV=y
CONFIG_PACKAGE_NET_REMOTE_CONTROL_JAVASCRIPT=y
CONFIG_PACKAGE_NET_RUM=y
CONFIG_PACKAGE_NET_FUSE_SSHFS=y
CONFIG_PACKAGE_NET_TCPDUMP=y
CONFIG_PACKAGE_CONSOLE_KBD=y
CONFIG_PACKAGE_EDITORS_VIM=y
CONFIG_PACKAGE_MULTIMEDIA_ALSA_UTILS=y
CONFIG_PACKAGE_MULTIMEDIA_FFMPEG_FFPLAY=y
CONFIG_PACKAGE_MULTIMEDIA_LIBVORBIS=y
CONFIG_PACKAGE_MULTIMEDIA_LINPHONE_GTK=y
CONFIG_PACKAGE_MULTIMEDIA_MPLAYER=y
CONFIG_PACKAGE_MULTIMEDIA_V4L_UTILS=y
CONFIG_PACKAGE_MULTIMEDIA_VLC_TELETEXT=y
CONFIG_PACKAGE_WEB_FLASHPLUGIN=y
CONFIG_PACKAGE_WEB_FREERDP=y
CONFIG_PACKAGE_WEB_X11VNC=y
CONFIG_PACKAGE_XORG_LIB_XRES=y
CONFIG_PACKAGE_XORG_DRIVER_INPUT_EVDEV=y
CONFIG_PACKAGE_XORG_DRIVER_INPUT_KEYBOARD=y
CONFIG_PACKAGE_XORG_DRIVER_INPUT_MOUSE=y
CONFIG_PACKAGE_XORG_DRIVER_VIDEO_FBDEV=y
CONFIG_PACKAGE_XORG_DRIVER_VIDEO_INTEL=y
CONFIG_PACKAGE_XORG_APP_EVTEST=y
CONFIG_PACKAGE_XORG_APP_ICEAUTH=y
CONFIG_PACKAGE_XORG_APP_SETXKBMAP=y
CONFIG_PACKAGE_XORG_APP_TWM=y
CONFIG_PACKAGE_XORG_APP_XAUTH=y
CONFIG_PACKAGE_XORG_APP_XBACKLIGHT=y
CONFIG_PACKAGE_XORG_APP_XEV=y
CONFIG_PACKAGE_XORG_APP_XINIT=y
CONFIG_PACKAGE_XORG_APP_XINPUT=y
CONFIG_PACKAGE_XORG_APP_XKBCOMP=y
CONFIG_PACKAGE_XORG_APP_XPROP=y
CONFIG_PACKAGE_XORG_APP_XRDB=y
CONFIG_PACKAGE_XORG_APP_XSET=y
CONFIG_PACKAGE_XORG_APP_XTERM=y
CONFIG_PACKAGE_XORG_APP_XWININFO=y
CONFIG_PACKAGE_XORG_DATA_XKEYBOARD_CONFIG=y
CONFIG_XORG_AIGLX=y
CONFIG_XORG_DRI=y
CONFIG_XORG_GLX=y
CONFIG_XORG_XV=y
CONFIG_PACKAGE_DESKTOP_EVDEV_CALIBRATE=y
CONFIG_PACKAGE_DESKTOP_GTK_ENGINES=y
CONFIG_PACKAGE_DESKTOP_ICONS_TANGO=y
CONFIG_PACKAGE_DESKTOP_NODM=y
CONFIG_PACKAGE_WM_AWESOME=y
CONFIG_PACKAGE_UTIL_FLASHROM=y
CONFIG_PACKAGE_UTIL_FLASHTOOL=y
CONFIG_PACKAGE_UTIL_HTOP=y
CONFIG_PACKAGE_UTIL_I2C_TOOLS=y
CONFIG_PACKAGE_UTIL_IRKEY=y
CONFIG_PACKAGE_UTIL_MEDATOM_UTILS=y
CONFIG_PACKAGE_UTIL_MESA_DEMOS=y
CONFIG_PACKAGE_FONTS_TTF_BITSTREAM_VERA=y
CONFIG_PACKAGE_FONTS_TTF_FREEFONT=y
CONFIG_PACKAGE_FONTS_TTF_LIBERATION=y
CONFIG_OPENGL_MESA_OPENGL_ES1=y
CONFIG_OPENGL_MESA_OPENGL_ES2=y
CONFIG_OPENGL_MESA_OPENGL=y
```

## configs/medcom-wide-initrd_defconfig
```kconfig
CONFIG_ARCH_ARM=y
CONFIG_MARCH=""
CONFIG_ARCH_ARM_CPU_CORTEX_A9=y
CONFIG_ARCH_ARM_SOFT_FP=y
CONFIG_ARCH_ARM_ABI_EABI=y
CONFIG_ARCH_ARM_ARCH_V7=y
CONFIG_OS_LINUX=y
CONFIG_PLATFORM_AVIONIC_DESIGN=y
CONFIG_PACKAGE_KERNEL_LINUX_CONFIG="medcom-wide_defconfig"
CONFIG_PLATFORM_AVIONIC_DESIGN_MEDCOM_WIDE=y
CONFIG_PACKAGE_KERNEL_LINUX_SOURCE_LOCAL=y
CONFIG_PACKAGE_KERNEL_LINUX_SOURCE_LOCAL_PATH="../kernel/linux-l4t-r16.git"
CONFIG_PACKAGE_CORE_E2FSPROGS=y
CONFIG_PACKAGE_CORE_UDEV_DISABLE_EXTRAS=y
# CONFIG_PACKAGE_CORE_UTIL_LINUX_NCURSES is not set
CONFIG_PACKAGE_UTIL_ADAK=y
```

## configs/medcom-wide-rootfs_defconfig
```kconfig
CONFIG_ARCH_ARM=y
CONFIG_ARCH_ARM_CPU_CORTEX_A9=y
CONFIG_ARCH_ARM_ABI_EABI=y
CONFIG_ARCH_ARM_ARCH_V7=y
CONFIG_OS_LINUX=y
CONFIG_GLIBC=y
CONFIG_PLATFORM_AVIONIC_DESIGN=y
CONFIG_PACKAGE_KERNEL_LINUX_CONFIG="medcom-wide_defconfig"
CONFIG_PLATFORM_AVIONIC_DESIGN_MEDCOM_WIDE=y
CONFIG_PLATFORM_AVIONIC_DESIGN_MEDCOM_WIDE_ROOTFS=y
CONFIG_PLATFORM_AVIONIC_DESIGN_MEDCOM_WIDE_ROOTFS_DEVEL=y
CONFIG_PLATFORM_AVIONIC_DESIGN_MEDCOM_WIDE_ROOTFS_DEBUG=y
CONFIG_PACKAGE_KERNEL_LINUX_SOURCE_LOCAL=y
CONFIG_PACKAGE_KERNEL_LINUX_SOURCE_LOCAL_PATH="../kernel/linux-l4t-r16.git"
CONFIG_PACKAGE_CORE_BUSYBOX=y
CONFIG_PACKAGE_CORE_COREUTILS=y
CONFIG_PACKAGE_CORE_LOGROTATE=y
CONFIG_PACKAGE_CORE_PROCPS=y
CONFIG_PACKAGE_CORE_RSYSLOG=y
CONFIG_PACKAGE_CORE_UTIL_LINUX_PAM=y
CONFIG_PACKAGE_LIBS_GLIB_NETWORKING=y
CONFIG_PACKAGE_LIBS_LIBGPIO=y
CONFIG_PACKAGE_LIBS_NSS=y
CONFIG_PACKAGE_SHELLS_BASH=y
CONFIG_PACKAGE_NET_DDIP=y
CONFIG_PACKAGE_NET_DHCPCD=y
CONFIG_PACKAGE_NET_IFLINKD=y
CONFIG_PACKAGE_NET_LLDPD=y
CONFIG_PACKAGE_NET_NTPD=y
CONFIG_PACKAGE_NET_PROXYCONF=y
CONFIG_PACKAGE_CONSOLE_KBD=y
CONFIG_PACKAGE_EDITORS_NANO=y
CONFIG_PACKAGE_MULTIMEDIA_ALSA_UTILS=y
CONFIG_PACKAGE_MULTIMEDIA_GSTREAMER_PLUGINS_GOOD=y
CONFIG_PACKAGE_MULTIMEDIA_GSTREAMER_PLUGINS_BAD=y
CONFIG_PACKAGE_MULTIMEDIA_GSTREAMER_PLUGINS_UGLY=y
CONFIG_PACKAGE_MULTIMEDIA_GSTREAMER_PLUGINS_LIBAV_ORC=y
CONFIG_PACKAGE_MULTIMEDIA_GSTREAMER_PLUGINS_GLES=y
CONFIG_PACKAGE_MULTIMEDIA_GSTREAMER_DISABLE_RARE=y
CONFIG_PACKAGE_MULTIMEDIA_GSTREAMER_DEBUG=y
CONFIG_PACKAGE_WEB_FREERDP=y
CONFIG_PACKAGE_WEB_WEBKIT_GTK_UNICODE_BACKEND_ICU=y
CONFIG_PACKAGE_WEB_X11VNC=y
CONFIG_PACKAGE_XORG_PROTO_DRI2=y
CONFIG_PACKAGE_XORG_LIB_XXF86VM=y
CONFIG_PACKAGE_XORG_DRIVER_INPUT_EVDEV=y
CONFIG_PACKAGE_XORG_DRIVER_INPUT_KEYBOARD=y
CONFIG_PACKAGE_XORG_DRIVER_INPUT_MOUSE=y
CONFIG_PACKAGE_XORG_APP_SETXKBMAP=y
CONFIG_PACKAGE_XORG_APP_XINIT=y
CONFIG_PACKAGE_XORG_APP_XKBCOMP=y
CONFIG_PACKAGE_XORG_DATA_XKEYBOARD_CONFIG=y
CONFIG_XORG_XV=y
CONFIG_PACKAGE_DESKTOP_EVDEV_CALIBRATE=y
CONFIG_PACKAGE_DESKTOP_GTK_ENGINES=y
CONFIG_PACKAGE_DESKTOP_ICONS_TANGO=y
CONFIG_PACKAGE_DESKTOP_NODM=y
CONFIG_PACKAGE_WM_AWESOME=y
CONFIG_PACKAGE_UTIL_ADAK=y
CONFIG_PACKAGE_FONTS_TTF_BITSTREAM_VERA=y
CONFIG_PACKAGE_FONTS_TTF_FREEFONT=y
CONFIG_PACKAGE_FONTS_TTF_LIBERATION=y
CONFIG_PACKAGE_VENDOR_AVIONIC_DESIGN_MEDCOM_WIDE_UTILS=y
CONFIG_PACKAGE_VENDOR_AVIONIC_DESIGN_REMOTE_CONTROL=y
CONFIG_PACKAGE_VENDOR_AVIONIC_DESIGN_REMOTE_CONTROL_AUDIO_ALSA=y
CONFIG_PACKAGE_VENDOR_AVIONIC_DESIGN_REMOTE_CONTROL_BACKLIGHT_SYSFS=y
CONFIG_PACKAGE_VENDOR_AVIONIC_DESIGN_REMOTE_CONTROL_VIDEO_GST=y
CONFIG_PACKAGE_VENDOR_AVIONIC_DESIGN_REMOTE_CONTROL_SMARTCARD_LIBSMARTCARD=y
CONFIG_PACKAGE_VENDOR_AVIONIC_DESIGN_REMOTE_CONTROL_VOIP_LINPHONE=y
CONFIG_PACKAGE_VENDOR_AVIONIC_DESIGN_REMOTE_CONTROL_MODEM_LIBMODEM=y
CONFIG_PACKAGE_VENDOR_AVIONIC_DESIGN_REMOTE_CONTROL_GPIO_SYSFS=y
CONFIG_PACKAGE_VENDOR_AVIONIC_DESIGN_REMOTE_CONTROL_JAVASCRIPT=y
CONFIG_PACKAGE_VENDOR_AVIONIC_DESIGN_REMOTE_CONTROL_JAVASCRIPT_APP_WATCHDOG=y
CONFIG_PACKAGE_VENDOR_AVIONIC_DESIGN_REMOTE_CONTROL_WATCHDOG=y
CONFIG_PACKAGE_VENDOR_AVIONIC_DESIGN_RUM=y
CONFIG_LIBAV_LIBAV=y
CONFIG_OPENGL_NVIDIA_L4T=y
CONFIG_UDEV_SYSTEMD=y
```

## configs/net4801_defconfig
```kconfig
CONFIG_ARCH_X86_I686=y
CONFIG_OS_LINUX=y
CONFIG_GLIBC=y
CONFIG_PACKAGE_KERNEL_LINUX_SOURCE_LOCAL=y
CONFIG_PACKAGE_KERNEL_LINUX_SOURCE_LOCAL_PATH="../kernel/linux-net4801.git"
CONFIG_PACKAGE_KERNEL_LINUX_CONFIG="net4801_defconfig"
CONFIG_PACKAGE_CORE_BUSYBOX=y
CONFIG_PACKAGE_NET_DNSMASQ=y
```

## configs/plutux-initrd_defconfig
```kconfig
CONFIG_ARCH_ARM=y
CONFIG_MARCH=""
CONFIG_ARCH_ARM_CPU_CORTEX_A9=y
CONFIG_ARCH_ARM_ABI_EABI=y
CONFIG_ARCH_ARM_ARCH_V7=y
CONFIG_OS_LINUX=y
CONFIG_PLATFORM_AVIONIC_DESIGN=y
CONFIG_PLATFORM_AVIONIC_DESIGN_PLUTUX=y
CONFIG_PACKAGE_KERNEL_LINUX_CONFIG="plutux_modularized_defconfig"
CONFIG_PACKAGE_KERNEL_LINUX_SOURCE_LOCAL=y
CONFIG_PACKAGE_KERNEL_LINUX_SOURCE_LOCAL_PATH="../kernel/linux-avionic.git"
CONFIG_PACKAGE_CORE_E2FSPROGS=y
CONFIG_PACKAGE_UTIL_ADAK=y
```

## configs/plutux-rootfs_defconfig
```kconfig
CONFIG_ARCH_ARM=y
CONFIG_MARCH=""
CONFIG_ARCH_ARM_CPU_CORTEX_A9=y
CONFIG_ARCH_ARM_ABI_EABI=y
CONFIG_ARCH_ARM_ARCH_V7=y
CONFIG_OS_LINUX=y
CONFIG_GLIBC=y
CONFIG_PLATFORM_AVIONIC_DESIGN=y
CONFIG_PACKAGE_KERNEL_LINUX_CONFIG="plutux_defconfig"
CONFIG_PLATFORM_AVIONIC_DESIGN_PLUTUX=y
CONFIG_PLATFORM_AVIONIC_DESIGN_PLUTUX_ROOTFS=y
CONFIG_PACKAGE_KERNEL_LINUX_SOURCE_LOCAL=y
CONFIG_PACKAGE_KERNEL_LINUX_SOURCE_LOCAL_PATH="../kernel/linux-l4t-r16.git"
CONFIG_PACKAGE_DEVEL_GDB=y
CONFIG_PACKAGE_DEVEL_STRACE=y
CONFIG_PACKAGE_CORE_BASE_FILES=y
CONFIG_PACKAGE_CORE_BUSYBOX=y
CONFIG_PACKAGE_CORE_COREUTILS=y
CONFIG_PACKAGE_CORE_E2FSPROGS=y
CONFIG_PACKAGE_CORE_LOGROTATE=y
CONFIG_PACKAGE_CORE_PCIUTILS=y
CONFIG_PACKAGE_CORE_PROCPS=y
CONFIG_PACKAGE_CORE_PSMISC=y
CONFIG_PACKAGE_CORE_RSYSLOG=y
# CONFIG_PACKAGE_CORE_SYSTEMD_ENABLE_BINFMT is not set
CONFIG_PACKAGE_LIBS_BZIP2=y
CONFIG_PACKAGE_LIBS_GLIB_NETWORKING=y
CONFIG_PACKAGE_LIBS_LZO=y
CONFIG_PACKAGE_LIBS_NEON=y
CONFIG_PACKAGE_LIBS_NSS=y
CONFIG_PACKAGE_LIBS_SYSFSUTILS=y
CONFIG_PACKAGE_LIBS_XDGMIME=y
CONFIG_PACKAGE_SHELLS_BASH=y
CONFIG_PACKAGE_NET_DHCPCD=y
CONFIG_PACKAGE_NET_ETHTOOL=y
CONFIG_PACKAGE_NET_IFLINKD=y
CONFIG_PACKAGE_NET_LLDPD=y
CONFIG_PACKAGE_NET_NTPD=y
CONFIG_PACKAGE_NET_FUSE_SSHFS=y
CONFIG_PACKAGE_NET_TCPDUMP=y
CONFIG_PACKAGE_NET_WIRELESS_TOOLS=y
CONFIG_PACKAGE_NET_WPA_SUPPLICANT=y
CONFIG_PACKAGE_CONSOLE_KBD=y
CONFIG_PACKAGE_CONSOLE_TMUX=y
CONFIG_PACKAGE_MULTIMEDIA_ALSA_UTILS=y
CONFIG_PACKAGE_MULTIMEDIA_GSTREAMER_PLUGINS_GOOD=y
CONFIG_PACKAGE_MULTIMEDIA_GSTREAMER_PLUGINS_BAD=y
CONFIG_PACKAGE_MULTIMEDIA_GSTREAMER_PLUGINS_UGLY=y
CONFIG_PACKAGE_MULTIMEDIA_GSTREAMER_PLUGINS_LIBAV=y
CONFIG_PACKAGE_MULTIMEDIA_GSTREAMER_PLUGINS_GLES=y
CONFIG_PACKAGE_MULTIMEDIA_VLC_PLUGIN_GLES2=y
CONFIG_PACKAGE_WEB_FREERDP=y
CONFIG_PACKAGE_WEB_WEBKIT_GTK_UNICODE_BACKEND_ICU=y
CONFIG_PACKAGE_WEB_X11VNC=y
CONFIG_PACKAGE_XORG_PROTO_DRI2=y
CONFIG_PACKAGE_XORG_LIB_XXF86VM=y
CONFIG_PACKAGE_XORG_DRIVER_INPUT_EVDEV=y
CONFIG_PACKAGE_XORG_APP_EVTEST=y
CONFIG_PACKAGE_XORG_APP_SETXKBMAP=y
CONFIG_PACKAGE_XORG_APP_XAUTH=y
CONFIG_PACKAGE_XORG_APP_XINIT=y
CONFIG_PACKAGE_XORG_APP_XINPUT=y
CONFIG_PACKAGE_XORG_APP_XKBCOMP=y
CONFIG_PACKAGE_XORG_APP_XRANDR=y
CONFIG_PACKAGE_XORG_APP_XTERM=y
CONFIG_PACKAGE_XORG_APP_XWININFO=y
CONFIG_PACKAGE_XORG_DATA_XKEYBOARD_CONFIG=y
CONFIG_XORG_XV=y
CONFIG_XORG_XINERAMA=y
CONFIG_PACKAGE_DESKTOP_ICONS_TANGO=y
CONFIG_PACKAGE_DESKTOP_NODM=y
CONFIG_PACKAGE_WM_AWESOME=y
CONFIG_PACKAGE_UTIL_ADAK=y
CONFIG_PACKAGE_UTIL_HTOP=y
CONFIG_PACKAGE_FONTS_TTF_BITSTREAM_VERA=y
CONFIG_PACKAGE_FONTS_TTF_FREEFONT=y
CONFIG_PACKAGE_FONTS_TTF_LIBERATION=y
CONFIG_PACKAGE_VENDOR_AVIONIC_DESIGN_MEDCOM_WIDE_UTILS=y
CONFIG_PACKAGE_VENDOR_AVIONIC_DESIGN_REMOTE_CONTROL=y
CONFIG_PACKAGE_VENDOR_AVIONIC_DESIGN_REMOTE_CONTROL_BACKLIGHT_DPMS=y
CONFIG_PACKAGE_VENDOR_AVIONIC_DESIGN_REMOTE_CONTROL_VIDEO_VLC=y
CONFIG_PACKAGE_VENDOR_AVIONIC_DESIGN_REMOTE_CONTROL_VOIP_LINPHONE=y
CONFIG_PACKAGE_VENDOR_AVIONIC_DESIGN_REMOTE_CONTROL_JAVASCRIPT=y
CONFIG_PACKAGE_VENDOR_AVIONIC_DESIGN_REMOTE_CONTROL_JAVASCRIPT_IR=y
CONFIG_PACKAGE_VENDOR_AVIONIC_DESIGN_REMOTE_CONTROL_JAVASCRIPT_APP_WATCHDOG=y
CONFIG_PACKAGE_VENDOR_AVIONIC_DESIGN_REMOTE_CONTROL_JAVASCRIPT_LCD=y
CONFIG_PACKAGE_VENDOR_AVIONIC_DESIGN_REMOTE_CONTROL_WATCHDOG=y
CONFIG_PACKAGE_VENDOR_AVIONIC_DESIGN_RUM=y
CONFIG_LIBAV_LIBAV=y
CONFIG_OPENGL_NVIDIA_L4T=y
CONFIG_UDEV_SYSTEMD=y
```

## configs/ptip-classic_defconfig
```kconfig
# CPU config
CONFIG_ARCH_ARM=y
CONFIG_ARCH_ARM_ABI_EABI=y
CONFIG_ARCH_ARM_ARCH_V5=y
CONFIG_ARCH_ARM_ARCH_V5TE=y
# OS
CONFIG_OS_LINUX=y
# Platform
CONFIG_PLATFORM_HONEYWELL=y
CONFIG_PLATFORM_HONEYWELL_PTIP=y
CONFIG_PLATFORM_HONEYWELL_PTIP_CLASSIC=y
# Kernel
CONFIG_PACKAGE_KERNEL_LINUX=y
CONFIG_PACKAGE_KERNEL_LINUX_SOURCE_GIT=y
CONFIG_PACKAGE_KERNEL_LINUX_SOURCE_GIT_URL="git://git.adnet.avionic-design.de/kernel/linux.git"
CONFIG_PACKAGE_KERNEL_LINUX_SOURCE_GIT_CHECKOUT="lpc32xx/ptip/3.6"
# Other apps
CONFIG_PACKAGE_VENDOR_AVIONIC_DESIGN_PTIP_DEVBUSD=y
# Debug utils
CONFIG_PACKAGE_DEVEL_GDB=y
CONFIG_PACKAGE_DEVEL_STRACE=y
CONFIG_PACKAGE_NET_TCPDUMP=y
CONFIG_PACKAGE_MULTIMEDIA_ALSA_UTILS=y
CONFIG_PACKAGE_XORG_APP_EVTEST=y
CONFIG_PACKAGE_UTIL_I2C_TOOLS=y
```

## configs/ptip-murnau_defconfig
```kconfig
CONFIG_ARCH_ARM=y
CONFIG_ARCH_ARM_ABI_EABI=y
CONFIG_OS_LINUX=y
CONFIG_PLATFORM_HONEYWELL=y
CONFIG_PLATFORM_HONEYWELL_PTIP=y
CONFIG_PLATFORM_HONEYWELL_PTIP_MURNAU=y
CONFIG_PACKAGE_KERNEL_LINUX_SOURCE_LOCAL=y
CONFIG_PACKAGE_KERNEL_LINUX_SOURCE_LOCAL_PATH="../kernel/linux-ptip.git"
CONFIG_PACKAGE_KERNEL_LINUX_CONFIG="ptip_defconfig"
CONFIG_PACKAGE_CORE_BUSYBOX=y
# CONFIG_PACKAGE_CORE_UTIL_LINUX_NCURSES is not set
CONFIG_PACKAGE_XORG_APP_EVTEST=y
CONFIG_PACKAGE_UTIL_MTD_UTILS=y
CONFIG_PACKAGE_VENDOR_AVIONIC_DESIGN_PTIP_MURNAU=y
```

## configs/skidata-carrier-initrd_defconfig
```kconfig
CONFIG_ARCH_ARM=y
CONFIG_MARCH=""
CONFIG_ARCH_ARM_CPU_CORTEX_A9=y
CONFIG_ARCH_ARM_ABI_EABI=y
CONFIG_ARCH_ARM_ARCH_V7=y
CONFIG_OS_LINUX=y
CONFIG_PLATFORM_SKIDATA=y
CONFIG_PACKAGE_KERNEL_LINUX_CONFIG="skidata-carrier_defconfig"
CONFIG_PLATFORM_SKIDATA_CARRIER_INITRD=y
CONFIG_PACKAGE_KERNEL_LINUX_SOURCE_LOCAL=y
CONFIG_PACKAGE_KERNEL_LINUX_SOURCE_LOCAL_PATH="../kernel/linux-avionic.git"
CONFIG_PACKAGE_CORE_E2FSPROGS=y
CONFIG_PACKAGE_UTIL_ADAK=y
CONFIG_OPENGL_NVIDIA_L4T=y
CONFIG_UDEV_SYSTEMD=y
```
